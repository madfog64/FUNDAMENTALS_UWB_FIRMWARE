## tests/twr_responder/testcase.yaml
```yaml
tests:
  # Twister test ID: twr.responder
  # type: unit  => runs on the 'unit_testing' platform (native-hosted, no kernel).
  # extra_args: M64_MODE=1 => compile as 64-bit (Zephyr's unittest.cmake defaults
  #   to -m32, which requires gcc-multilib; M64_MODE=1 switches to -m64).
  # CI invocation: west twister -p unit_testing -T tests/twr_responder -v
  twr.responder:
    type: unit
    extra_args: M64_MODE=1
    tags: dw1000 twr responder uwb-232
```

## tests/uwb_cycle_ref/testcase.yaml
```yaml
tests:
  # Twister test ID: uwb.cycle_ref
  # type: unit  => runs on the 'unit_testing' platform (native-hosted, no kernel).
  # extra_args: M64_MODE=1 => compile as 64-bit (Zephyr's unittest.cmake defaults
  #   to -m32, which requires gcc-multilib; M64_MODE=1 switches to -m64).
  # CI invocation: west twister -p unit_testing -T tests/uwb_cycle_ref -v
  uwb.cycle_ref:
    type: unit
    extra_args: M64_MODE=1
    tags: dw1000 uwb-243
```
