## CMakeLists.txt
```
cmake_minimum_required(VERSION 3.20.0)

# Zephyr unit test build for the uwb_slot_timing module (UWB-251).
#
# Mirrors tests/dw1000_ranging's unit_testing pattern: uwb_slot_timing.c is
# pure arithmetic, but its only external call is dw1000_delayed_tx_time()
# (UWB-231, dw1000_ranging.c) -- linking the real dw1000_ranging.c (instead of
# re-deriving the truncation independently in the test) exercises the actual
# low-9-bit truncation path the acceptance criteria call for. dw1000_ranging.c
# also compiles dw1000_rx()/dw1000_tx_at(), which call into deca_driver, so
# the same mocked deca_driver as tests/dw1000_ranging is linked here purely to
# satisfy those symbols -- this test suite does not exercise them.
#
# What is compiled:
#   uwb_slot_timing.c      — the module under test (UWB-251)
#   dw1000_ranging.c       — real dw1000_delayed_tx_time() (UWB-231)
#   mock_deca_driver.c     — satisfies dw1000_ranging.c's deca_driver calls
#                            (dw1000_rx()/dw1000_tx_at() are compiled but not
#                            exercised by this suite)
#   mock_log.c             — stubs z_log_minimal_printk() (same rationale as
#                            tests/dw1000_ranging/src/mock_log.c)
#   test_slot_timing.c     — ztest assertions
#
# Platform: unit_testing  (native host executable, no emulation)
# Run:  west twister -p unit_testing -T tests/slot_timing -v

project(test_slot_timing)
find_package(Zephyr COMPONENTS unittest REQUIRED HINTS $ENV{ZEPHYR_BASE})

set(DW1000_DIR ${CMAKE_CURRENT_SOURCE_DIR}/../../drivers/dw1000)

target_sources(testbinary PRIVATE
    src/test_slot_timing.c
    src/mock_deca_driver.c
    src/mock_log.c
    ${DW1000_DIR}/uwb_slot_timing.c
    ${DW1000_DIR}/dw1000_ranging.c
)

target_include_directories(testbinary PRIVATE
    ${DW1000_DIR}/deca_driver        # deca_device_api.h, deca_regs.h
    ${DW1000_DIR}                    # uwb_slot_timing.h, dw1000_ranging.h
    ${CMAKE_CURRENT_SOURCE_DIR}/src  # mock_deca_driver.h
)
```

## prj.conf
```kconfig
# tests/slot_timing/prj.conf
# Minimal config for the unit_testing platform — only ztest is needed.
CONFIG_ZTEST=y
```

## src/mock_deca_driver.c
```c
/*! ----------------------------------------------------------------------------
 * @file    mock_deca_driver.c
 * @brief   Mock implementations of deca_driver API functions called by
 *          dw1000_ranging.c, linked into the uwb_slot_timing unit test
 *          (UWB-251) purely to satisfy dw1000_ranging.c's dw1000_rx()/
 *          dw1000_tx_at() symbols -- this suite only exercises
 *          dw1000_delayed_tx_time(), which does not touch deca_driver at all.
 *          Identical to tests/dw1000_ranging/src/mock_deca_driver.c.
 *
 * These stubs have no hardware or SPI dependencies. Register reads
 * (dwt_read32bitoffsetreg, via the dwt_read32bitreg() macro) return the
 * test-configured mock_reg_state.sys_status / mock_reg_state.rx_finfo values
 * depending on the requested register file ID (SYS_STATUS_ID / RX_FINFO_ID).
 * Register writes are captured, and additionally applied as a bit-clear
 * against mock_reg_state.sys_status when regFileID == SYS_STATUS_ID, mirroring
 * the DW1000's write-1-to-clear semantics for that register — this keeps a
 * test's pre-configured status word self-consistent if a test inspects it
 * again after the call under test returns.
 *
 * @attention
 * SPDX-License-Identifier: MIT
 * Copyright (c) 2024 Fundamentals UWB project contributors.
 */

#include <string.h>

#include "deca_device_api.h"
#include "deca_regs.h"
#include "mock_deca_driver.h"

/* ---------------------------------------------------------------------------
 * Captured / configurable state (inspected and pre-configured by tests)
 * --------------------------------------------------------------------------- */
struct mock_rxtimeout_state       mock_rxtimeout_state;
struct mock_rxenable_state        mock_rxenable_state;
struct mock_forcetrxoff_state     mock_forcetrxoff_state;
struct mock_reg_state             mock_reg_state;
struct mock_readrxdata_state      mock_readrxdata_state;
struct mock_timestamp_state       mock_timestamp_state;
struct mock_delayedtrxtime_state  mock_delayedtrxtime_state;
struct mock_tx_state              mock_tx_state;
struct mock_starttx_state         mock_starttx_state;

void mock_deca_reset(void)
{
    memset(&mock_rxtimeout_state,      0, sizeof(mock_rxtimeout_state));
    memset(&mock_rxenable_state,       0, sizeof(mock_rxenable_state));
    memset(&mock_forcetrxoff_state,    0, sizeof(mock_forcetrxoff_state));
    memset(&mock_reg_state,            0, sizeof(mock_reg_state));
    memset(&mock_readrxdata_state,     0, sizeof(mock_readrxdata_state));
    memset(&mock_timestamp_state,      0, sizeof(mock_timestamp_state));
    memset(&mock_delayedtrxtime_state, 0, sizeof(mock_delayedtrxtime_state));
    memset(&mock_tx_state,             0, sizeof(mock_tx_state));
    memset(&mock_starttx_state,        0, sizeof(mock_starttx_state));

    /* Defaults: every deca_driver call that can fail reports success. */
    mock_rxenable_state.return_value      = DWT_SUCCESS;
    mock_tx_state.writetxdata_return_value = DWT_SUCCESS;
    mock_starttx_state.return_value        = DWT_SUCCESS;
}

/* ---------------------------------------------------------------------------
 * Mock dwt_setrxtimeout
 * --------------------------------------------------------------------------- */
void dwt_setrxtimeout(uint16 time)
{
    mock_rxtimeout_state.called = 1;
    mock_rxtimeout_state.time   = time;
}

/* ---------------------------------------------------------------------------
 * Mock dwt_rxenable
 * --------------------------------------------------------------------------- */
int dwt_rxenable(int mode)
{
    mock_rxenable_state.called = 1;
    mock_rxenable_state.mode   = mode;
    return mock_rxenable_state.return_value;
}

/* ---------------------------------------------------------------------------
 * Mock dwt_forcetrxoff
 * --------------------------------------------------------------------------- */
void dwt_forcetrxoff(void)
{
    mock_forcetrxoff_state.called++;
}

/* ---------------------------------------------------------------------------
 * Mock dwt_read32bitoffsetreg (backs the dwt_read32bitreg() macro)
 *
 * Returns mock_reg_state.sys_status for SYS_STATUS_ID, mock_reg_state.rx_finfo
 * for RX_FINFO_ID, and 0 for anything else.
 * --------------------------------------------------------------------------- */
uint32 dwt_read32bitoffsetreg(int regFileID, int regOffset)
{
    (void)regOffset;

    if (regFileID == SYS_STATUS_ID) {
        return mock_reg_state.sys_status;
    }
    if (regFileID == RX_FINFO_ID) {
        return mock_reg_state.rx_finfo;
    }
    return 0u;
}

/* ---------------------------------------------------------------------------
 * Mock dwt_write32bitoffsetreg (backs the dwt_write32bitreg() macro)
 *
 * Captures the last register/value written. When writing SYS_STATUS_ID,
 * clears the written bits from mock_reg_state.sys_status (write-1-to-clear,
 * matching real DW1000 SYS_STATUS semantics).
 * --------------------------------------------------------------------------- */
void dwt_write32bitoffsetreg(int regFileID, int regOffset, uint32 regval)
{
    (void)regOffset;

    mock_reg_state.last_write_reg = (uint32)regFileID;
    mock_reg_state.last_write_val = regval;
    mock_reg_state.write_count++;

    if (regFileID == SYS_STATUS_ID) {
        mock_reg_state.sys_status &= ~regval;
    }
}

/* ---------------------------------------------------------------------------
 * Mock dwt_readrxdata
 *
 * Captures length/offset and copies the test-injected payload bytes into the
 * caller's buffer.
 * --------------------------------------------------------------------------- */
void dwt_readrxdata(uint8 *buffer, uint16 length, uint16 rxBufferOffset)
{
    uint16 copy_len = length;

    mock_readrxdata_state.called = 1;
    mock_readrxdata_state.length = length;
    mock_readrxdata_state.offset = rxBufferOffset;

    if (copy_len > MOCK_MAX_FRAME_LEN) {
        copy_len = MOCK_MAX_FRAME_LEN;
    }
    if (buffer != NULL) {
        memcpy(buffer, mock_readrxdata_state.injected_payload, copy_len);
    }
}

/* ---------------------------------------------------------------------------
 * Mock dwt_readrxtimestamp / dwt_readtxtimestamp
 * --------------------------------------------------------------------------- */
void dwt_readrxtimestamp(uint8 *timestamp)
{
    mock_timestamp_state.rx_called++;
    if (timestamp != NULL) {
        memcpy(timestamp, mock_timestamp_state.rx_ts_bytes, 5);
    }
}

void dwt_readtxtimestamp(uint8 *timestamp)
{
    mock_timestamp_state.tx_called++;
    if (timestamp != NULL) {
        memcpy(timestamp, mock_timestamp_state.tx_ts_bytes, 5);
    }
}

/* ---------------------------------------------------------------------------
 * Mock dwt_setdelayedtrxtime
 * --------------------------------------------------------------------------- */
void dwt_setdelayedtrxtime(uint32 starttime)
{
    mock_delayedtrxtime_state.called    = 1;
    mock_delayedtrxtime_state.starttime = starttime;
}

/* ---------------------------------------------------------------------------
 * Mock dwt_writetxdata
 * --------------------------------------------------------------------------- */
int dwt_writetxdata(uint16 txFrameLength, uint8 *txFrameBytes, uint16 txBufferOffset)
{
    uint16 copy_len = txFrameLength;

    mock_tx_state.writetxdata_called = 1;
    mock_tx_state.writetxdata_len    = txFrameLength;
    mock_tx_state.writetxdata_offset = txBufferOffset;

    if (copy_len > MOCK_MAX_FRAME_LEN) {
        copy_len = MOCK_MAX_FRAME_LEN;
    }
    if (txFrameBytes != NULL) {
        memcpy(mock_tx_state.writetxdata_buf, txFrameBytes, copy_len);
    }

    return mock_tx_state.writetxdata_return_value;
}

/* ---------------------------------------------------------------------------
 * Mock dwt_writetxfctrl
 * --------------------------------------------------------------------------- */
void dwt_writetxfctrl(uint16 txFrameLength, uint16 txBufferOffset, int ranging)
{
    mock_tx_state.writetxfctrl_called  = 1;
    mock_tx_state.writetxfctrl_len     = txFrameLength;
    mock_tx_state.writetxfctrl_offset  = txBufferOffset;
    mock_tx_state.writetxfctrl_ranging = ranging;
}

/* ---------------------------------------------------------------------------
 * Mock dwt_starttx
 * --------------------------------------------------------------------------- */
int dwt_starttx(uint8 mode)
{
    mock_starttx_state.called = 1;
    mock_starttx_state.mode   = mode;
    return mock_starttx_state.return_value;
}
```

## src/mock_deca_driver.h
```c
/*! ----------------------------------------------------------------------------
 * @file    mock_deca_driver.h
 * @brief   Mock state for the deca_driver API functions called by
 *          dw1000_ranging.c, linked into the uwb_slot_timing unit test
 *          (UWB-251) purely to satisfy dw1000_ranging.c's link-time symbols.
 *          Identical to tests/dw1000_ranging/src/mock_deca_driver.h.
 *
 * Captured/configurable state is reset by mock_deca_reset() before each test.
 * Tests pre-configure the register-read state (mock_reg_state, injected
 * timestamp/payload bytes) before calling the function under test, then
 * assert on the captured call arguments.
 *
 * @attention
 * SPDX-License-Identifier: MIT
 * Copyright (c) 2024 Fundamentals UWB project contributors.
 */

#ifndef MOCK_DECA_DRIVER_H_
#define MOCK_DECA_DRIVER_H_

#include "deca_device_api.h"

/** Size of the scratch buffers used to capture RX/TX payload bytes. */
#define MOCK_MAX_FRAME_LEN  128

/**
 * State captured from mock dwt_setrxtimeout() call.
 */
struct mock_rxtimeout_state {
    int    called;   /**< Non-zero if dwt_setrxtimeout() was called. */
    uint16 time;     /**< The 'time' argument passed (DW1000 RX_FWTO units). */
};

/**
 * State captured from mock dwt_rxenable() call, and its configurable
 * return value.
 */
struct mock_rxenable_state {
    int called;         /**< Non-zero if dwt_rxenable() was called. */
    int mode;            /**< The 'mode' argument passed. */
    int return_value;   /**< Value dwt_rxenable() should return (default DWT_SUCCESS). */
};

/**
 * Call counter for mock dwt_forcetrxoff().
 */
struct mock_forcetrxoff_state {
    int called;
};

/**
 * Configurable register-read values and captured register writes, used for
 * both dw1000_rx()'s and dw1000_tx_at()'s SYS_STATUS/RX_FINFO polling.
 *
 * Set sys_status / rx_finfo BEFORE calling the function under test to drive
 * a specific scenario (good frame / RX error / RX timeout / TXFRS / HPDWARN).
 */
struct mock_reg_state {
    uint32 sys_status;       /**< Value returned for dwt_read32bitreg(SYS_STATUS_ID). */
    uint32 rx_finfo;          /**< Value returned for dwt_read32bitreg(RX_FINFO_ID). */
    uint32 last_write_reg;    /**< Last regFileID written via dwt_write32bit{,offset}reg. */
    uint32 last_write_val;    /**< Last value written. */
    int    write_count;       /**< Number of register writes captured. */
};

/**
 * Captured dwt_readrxdata() call arguments, plus the payload bytes the mock
 * copies into the caller's buffer (set injected_payload before the call).
 */
struct mock_readrxdata_state {
    int    called;
    uint16 length;
    uint16 offset;
    uint8  injected_payload[MOCK_MAX_FRAME_LEN];
};

/**
 * Injected 5-byte RX/TX timestamp buffers returned by
 * dwt_readrxtimestamp() / dwt_readtxtimestamp(), plus call counters.
 */
struct mock_timestamp_state {
    uint8 rx_ts_bytes[5];
    uint8 tx_ts_bytes[5];
    int   rx_called;
    int   tx_called;
};

/**
 * State captured from mock dwt_setdelayedtrxtime() call.
 */
struct mock_delayedtrxtime_state {
    int    called;
    uint32 starttime;
};

/**
 * State captured from mock dwt_writetxdata() and dwt_writetxfctrl() calls,
 * and dwt_writetxdata()'s configurable return value.
 */
struct mock_tx_state {
    int    writetxdata_called;
    uint16 writetxdata_len;
    uint8  writetxdata_buf[MOCK_MAX_FRAME_LEN];
    uint16 writetxdata_offset;
    int    writetxdata_return_value;

    int    writetxfctrl_called;
    uint16 writetxfctrl_len;
    uint16 writetxfctrl_offset;
    int    writetxfctrl_ranging;
};

/**
 * State captured from mock dwt_starttx() call, and its configurable return
 * value (set to DWT_ERROR to simulate a missed/HPDWARN slot).
 */
struct mock_starttx_state {
    int    called;
    uint8  mode;
    int    return_value;
};

extern struct mock_rxtimeout_state       mock_rxtimeout_state;
extern struct mock_rxenable_state        mock_rxenable_state;
extern struct mock_forcetrxoff_state     mock_forcetrxoff_state;
extern struct mock_reg_state             mock_reg_state;
extern struct mock_readrxdata_state      mock_readrxdata_state;
extern struct mock_timestamp_state       mock_timestamp_state;
extern struct mock_delayedtrxtime_state  mock_delayedtrxtime_state;
extern struct mock_tx_state              mock_tx_state;
extern struct mock_starttx_state         mock_starttx_state;

/** Reset all captured/configurable state to defaults (all-success, all-zero). */
void mock_deca_reset(void);

#endif /* MOCK_DECA_DRIVER_H_ */
```

## src/mock_log.c
```c
/*! ----------------------------------------------------------------------------
 * @file    mock_log.c
 * @brief   Zephyr minimal-log stub for the uwb_slot_timing unit test
 *          (UWB-251).
 *
 * Mirrors tests/dw1000_ranging/src/mock_log.c: the unit_testing defconfig
 * enables CONFIG_LOG=y, which causes the LOG_ERR() / LOG_DBG() macros in the
 * linked-in dw1000_ranging.c to call z_log_minimal_printk() at link time.
 * That function lives in Zephyr's log_minimal.c, which is not compiled in
 * the minimal unit_testing link set. Stub it out here — unit tests do not
 * need real log output, only assertion correctness.
 *
 * @attention
 * SPDX-License-Identifier: MIT
 * Copyright (c) 2024 Fundamentals UWB project contributors.
 */

#include <stdarg.h>

void z_log_minimal_printk(const char *fmt, ...)
{
    (void)fmt;
    /* No-op: discard log messages in unit tests. */
}
```

## src/test_slot_timing.c
```c
/*! ----------------------------------------------------------------------------
 * @file    test_slot_timing.c
 * @brief   ztest suite: TDMA slot-timing computation for tag blink TX
 *          (UWB-251)
 *
 * Platform: unit_testing (native-hosted, no Zephyr kernel, no real SPI).
 * Links the real dw1000_ranging.c so dw1000_delayed_tx_time() (UWB-231) is
 * exercised for real -- see tests/slot_timing/CMakeLists.txt.
 *
 * Covers, per the UWB-251 acceptance criteria:
 *   - slot_idx = 0 yields dw1000_delayed_tx_time(sync_rx_ts, 0).
 *   - slot_idx = k (k = 1, a mid slot, slot_count-1) yields exactly
 *     dw1000_delayed_tx_time(sync_rx_ts, k * slot_duration_dtu).
 *   - Monotonic separation: consecutive slot_idx values produce a
 *     pre-truncation delay separated by exactly slot_duration_dtu.
 *   - slot_idx >= slot_count returns -EINVAL and leaves *tx_time_dtu
 *     untouched (the driver is not called).
 *   - slot_idx * slot_duration_dtu overflowing the 32-bit delay the driver
 *     accepts returns -ERANGE, not a wrapped value (including the exact
 *     UINT32_MAX boundary: fits -> succeeds, one tick over -> -ERANGE).
 *   - NULL tx_time_dtu returns -EINVAL.
 *
 * @attention
 * SPDX-License-Identifier: MIT
 * Copyright (c) 2024 Fundamentals UWB project contributors.
 */

#include <errno.h>
#include <stddef.h>
#include <stdint.h>

#include <zephyr/ztest.h>

#include "dw1000_ranging.h"
#include "uwb_slot_timing.h"

/* Sentinel used to confirm *tx_time_dtu is left untouched on error paths. */
#define SENTINEL_TX_TIME  ((uint64_t)0xDEADBEEFDEULL)

ZTEST_SUITE(uwb_slot_timing, NULL, NULL, NULL, NULL, NULL);

/* =============================================================================
 * slot_idx = 0 -> the SYNC-referenced boundary itself
 * ========================================================================= */
ZTEST(uwb_slot_timing, test_slot_zero_is_sync_boundary)
{
    const uint64_t sync_rx_ts = 0x0123456789ULL;
    const uint32_t slot_duration_dtu = 32000000u; /* ~0.5 ms superframe slot */
    const uint32_t slot_count = 24u;
    uint64_t tx_time_dtu = 0;

    int ret = uwb_slot_tx_time(sync_rx_ts, 0u, slot_duration_dtu, slot_count,
                                &tx_time_dtu);

    zassert_equal(ret, 0, "expected success; got %d", ret);
    zassert_equal(tx_time_dtu, dw1000_delayed_tx_time(sync_rx_ts, 0u),
        "slot_idx=0: expected dw1000_delayed_tx_time(sync_rx_ts, 0)");
}

/* =============================================================================
 * slot_idx = k -> delay fed to dw1000_delayed_tx_time is exactly
 * k * slot_duration_dtu (k = 1, a mid slot, slot_count - 1)
 * ========================================================================= */
ZTEST(uwb_slot_timing, test_slot_k_matches_k_times_slot_duration)
{
    const uint64_t sync_rx_ts = 0x0555555555ULL;
    const uint32_t slot_duration_dtu = 32000000u;
    const uint32_t slot_count = 24u;
    const uint32_t ks[] = {1u, 12u /* mid slot */, slot_count - 1u};

    for (size_t i = 0; i < sizeof(ks) / sizeof(ks[0]); i++) {
        uint32_t k = ks[i];
        uint64_t tx_time_dtu = 0;

        int ret = uwb_slot_tx_time(sync_rx_ts, k, slot_duration_dtu,
                                    slot_count, &tx_time_dtu);

        zassert_equal(ret, 0, "k=%u: expected success; got %d",
            (unsigned)k, ret);

        uint64_t expected =
            dw1000_delayed_tx_time(sync_rx_ts, k * slot_duration_dtu);

        zassert_equal(tx_time_dtu, expected,
            "k=%u: expected 0x%010llX; got 0x%010llX",
            (unsigned)k, (unsigned long long)expected,
            (unsigned long long)tx_time_dtu);
    }
}

/* =============================================================================
 * Monotonic separation: consecutive slot_idx values are separated by
 * exactly slot_duration_dtu in the pre-truncation delay (adjacent slots
 * never overlap for valid inputs).
 * ========================================================================= */
ZTEST(uwb_slot_timing, test_consecutive_slots_separated_by_slot_duration)
{
    const uint64_t sync_rx_ts = 0x1000ULL;
    const uint32_t slot_duration_dtu = 32000000u;
    const uint32_t slot_count = 24u;

    for (uint32_t k = 0; k + 1 < slot_count; k++) {
        uint64_t tx_k = 0;
        uint64_t tx_k1 = 0;

        zassert_equal(
            uwb_slot_tx_time(sync_rx_ts, k, slot_duration_dtu, slot_count, &tx_k),
            0, "k=%u: expected success", (unsigned)k);
        zassert_equal(
            uwb_slot_tx_time(sync_rx_ts, k + 1u, slot_duration_dtu, slot_count, &tx_k1),
            0, "k=%u: expected success", (unsigned)(k + 1u));

        /* Compare against the driver call directly on the pre-truncation
         * delay (k * D vs (k+1) * D) -- i.e. the two calls must agree with
         * what dw1000_delayed_tx_time() would produce for delays exactly
         * slot_duration_dtu apart. */
        uint64_t expected_k =
            dw1000_delayed_tx_time(sync_rx_ts, k * slot_duration_dtu);
        uint64_t expected_k1 =
            dw1000_delayed_tx_time(sync_rx_ts, (k + 1u) * slot_duration_dtu);

        zassert_equal(tx_k, expected_k, "k=%u mismatch", (unsigned)k);
        zassert_equal(tx_k1, expected_k1, "k=%u mismatch", (unsigned)(k + 1u));

        /* The underlying pre-truncation delays themselves (not the
         * post-truncation TX times) are separated by exactly
         * slot_duration_dtu -- this is what guarantees adjacent slots never
         * overlap for valid inputs. */
        uint64_t delay_k = (uint64_t)k * slot_duration_dtu;
        uint64_t delay_k1 = (uint64_t)(k + 1u) * slot_duration_dtu;

        zassert_equal(delay_k1 - delay_k, (uint64_t)slot_duration_dtu,
            "k=%u: pre-truncation delay separation must equal slot_duration_dtu",
            (unsigned)k);
    }
}

/* =============================================================================
 * slot_idx >= slot_count is rejected before the driver is called
 * ========================================================================= */
ZTEST(uwb_slot_timing, test_slot_idx_out_of_range_rejected)
{
    const uint32_t slot_count = 24u;
    uint64_t tx_time_dtu = SENTINEL_TX_TIME;

    int ret = uwb_slot_tx_time(0x1000ULL, slot_count, 32000000u, slot_count,
                                &tx_time_dtu);

    zassert_equal(ret, -EINVAL,
        "slot_idx == slot_count: expected -EINVAL; got %d", ret);
    zassert_equal(tx_time_dtu, SENTINEL_TX_TIME,
        "*tx_time_dtu must be left untouched (driver not called) on error");

    /* Comfortably past slot_count too. */
    tx_time_dtu = SENTINEL_TX_TIME;
    ret = uwb_slot_tx_time(0x1000ULL, slot_count + 100u, 32000000u, slot_count,
                            &tx_time_dtu);

    zassert_equal(ret, -EINVAL,
        "slot_idx > slot_count: expected -EINVAL; got %d", ret);
    zassert_equal(tx_time_dtu, SENTINEL_TX_TIME,
        "*tx_time_dtu must be left untouched (driver not called) on error");
}

/* =============================================================================
 * Overflow guard: slot_idx * slot_duration_dtu too large to hand to the
 * driver returns -ERANGE, not a wrapped/garbage value.
 * ========================================================================= */
ZTEST(uwb_slot_timing, test_overflow_guard_returns_erange)
{
    uint64_t tx_time_dtu = SENTINEL_TX_TIME;

    /* slot_idx must stay strictly below slot_count (0xFFFFFFFEu <
     * 0xFFFFFFFFu) so the slot_idx>=slot_count check does not fire first --
     * the product is still comfortably beyond both the 32-bit delay
     * parameter and the 40-bit DW1000 system time width. */
    int ret = uwb_slot_tx_time(0x1000ULL, 0xFFFFFFFEu, 0xFFFFFFFFu, 0xFFFFFFFFu,
                                &tx_time_dtu);

    zassert_equal(ret, -ERANGE,
        "expected -ERANGE on gross overflow; got %d", ret);
    zassert_equal(tx_time_dtu, SENTINEL_TX_TIME,
        "*tx_time_dtu must be left untouched (driver not called) on overflow");
}

/* ---------------------------------------------------------------------------
 * Boundary: delay == UINT32_MAX fits (succeeds); one tick over does not.
 * --------------------------------------------------------------------------- */
ZTEST(uwb_slot_timing, test_overflow_guard_boundary_at_uint32_max)
{
    const uint64_t sync_rx_ts = 0x2000ULL;
    uint64_t tx_time_dtu = 0;

    /* slot_idx=1, slot_duration_dtu=UINT32_MAX -> delay = UINT32_MAX exactly:
     * fits the driver's 32-bit delay parameter, must succeed. */
    int ret = uwb_slot_tx_time(sync_rx_ts, 1u, 0xFFFFFFFFu, 2u, &tx_time_dtu);

    zassert_equal(ret, 0,
        "delay == UINT32_MAX must fit and succeed; got %d", ret);
    zassert_equal(tx_time_dtu, dw1000_delayed_tx_time(sync_rx_ts, 0xFFFFFFFFu),
        "boundary success case: unexpected truncated TX time");

    /* slot_idx=2, same slot_duration_dtu -> delay = 2 * UINT32_MAX, which
     * does not fit in 32 bits -- must be rejected, not silently truncated. */
    tx_time_dtu = SENTINEL_TX_TIME;
    ret = uwb_slot_tx_time(sync_rx_ts, 2u, 0xFFFFFFFFu, 3u, &tx_time_dtu);

    zassert_equal(ret, -ERANGE,
        "delay == 2*UINT32_MAX must be rejected; got %d", ret);
    zassert_equal(tx_time_dtu, SENTINEL_TX_TIME,
        "*tx_time_dtu must be left untouched (driver not called) on overflow");
}

/* =============================================================================
 * NULL tx_time_dtu is rejected
 * ========================================================================= */
ZTEST(uwb_slot_timing, test_null_out_param_rejected)
{
    int ret = uwb_slot_tx_time(0x1000ULL, 0u, 32000000u, 24u, NULL);

    zassert_equal(ret, -EINVAL,
        "NULL tx_time_dtu: expected -EINVAL; got %d", ret);
}
```
