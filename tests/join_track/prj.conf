## CMakeLists.txt
```
cmake_minimum_required(VERSION 3.20.0)

# Zephyr unit test build for the join -> tracking orchestration seam
# (UWB-263).
#
# Mirrors tests/join's and tests/tracking's unit_testing pattern: a mocked
# deca_driver so assertions can inspect the exact register/API arguments the
# composed dw1000_sync_rx() / dw1000_rx() / dw1000_tx_at() calls drive,
# without any real SPI/hardware. A single uwb_join_track_step() call forwards
# to exactly one of uwb_join_step() or uwb_tracking_run_cycle(), each of
# which itself drives at most one RX-family call and one TX call -- so the
# simple single-shot mock state from tests/join/ / tests/tracking/ suffices,
# no RX queueing is needed.
#
# What is compiled:
#   uwb_join_track.c        — the module under test (UWB-263)
#   uwb_join.c               — tag-side Aloha join state machine (UWB-261),
#                              reused (not reimplemented)
#   uwb_join_codec.c         — Aloha join frame build/parse codec (UWB-259)
#   uwb_tracking.c           — tag-side per-cycle TDoA tracking loop (UWB-252),
#                              reused (not reimplemented)
#   dw1000_sync.c            — tag-side SYNC RX + validate/parse (UWB-242)
#   dw1000_ranging.c         — dw1000_rx() / dw1000_tx_at() / delayed-TX time
#                              helpers (UWB-231)
#   uwb_cycle_ref.c          — tag-side maintained cycle reference (UWB-243)
#   uwb_slot_timing.c        — TDMA slot-timing computation (UWB-251)
#   uwb_blink_codec.c        — TDoA tag-blink frame build/parse codec (UWB-250)
#   mock_deca_driver.c       — mocks the deca_driver API surface (copied
#                              verbatim from tests/tracking/ / tests/join/)
#   mock_log.c               — stubs z_log_minimal_printk()
#   test_join_track.c        — ztest assertions
#
# Platform: unit_testing  (native host executable, no emulation)
# Run:  west twister -p unit_testing -T tests/join_track -v

project(test_join_track)
find_package(Zephyr COMPONENTS unittest REQUIRED HINTS $ENV{ZEPHYR_BASE})

set(DW1000_DIR ${CMAKE_CURRENT_SOURCE_DIR}/../../drivers/dw1000)

target_sources(testbinary PRIVATE
    src/test_join_track.c
    src/mock_deca_driver.c
    src/mock_log.c
    ${DW1000_DIR}/uwb_join_track.c
    ${DW1000_DIR}/uwb_join.c
    ${DW1000_DIR}/uwb_join_codec.c
    ${DW1000_DIR}/uwb_tracking.c
    ${DW1000_DIR}/dw1000_sync.c
    ${DW1000_DIR}/dw1000_ranging.c
    ${DW1000_DIR}/uwb_cycle_ref.c
    ${DW1000_DIR}/uwb_slot_timing.c
    ${DW1000_DIR}/uwb_blink_codec.c
)

target_include_directories(testbinary PRIVATE
    ${DW1000_DIR}/deca_driver        # deca_device_api.h, deca_regs.h
    ${DW1000_DIR}                    # uwb_join_track.h, uwb_join.h, uwb_tracking.h, etc.
    ${CMAKE_CURRENT_SOURCE_DIR}/src  # mock_deca_driver.h
)

# CONFIG_UWB_SYNC_MAX_MISSED is injected as a compile-time constant rather
# than via Kconfig, because the unit_testing platform's Kconfig root does not
# include the drivers/dw1000/Kconfig hierarchy (same rationale as
# tests/tracking's identical injection -- uwb_cycle_ref.c reads it). Value
# matches the Kconfig default in drivers/dw1000/Kconfig.
target_compile_definitions(testbinary PRIVATE
    CONFIG_UWB_SYNC_MAX_MISSED=3
)
```

## prj.conf
```kconfig
# tests/join_track/prj.conf
# Minimal config for the unit_testing platform — only ztest is needed.
CONFIG_ZTEST=y
```

## src/mock_deca_driver.c
```c
/*! ----------------------------------------------------------------------------
 * @file    mock_deca_driver.c
 * @brief   Mock implementations of deca_driver API functions called by
 *          dw1000_ranging.c (dw1000_rx() + dw1000_tx_at(), driven here by
 *          uwb_join_track.c's composed join (UWB-261) -> tracking (UWB-252)
 *          steps -- UWB-263 unit tests). Copied verbatim from
 *          tests/tracking/ (UWB-252) / tests/join/ (UWB-261).
 *
 * These stubs have no hardware or SPI dependencies. Register reads
 * (dwt_read32bitoffsetreg, via the dwt_read32bitreg() macro) return the
 * test-configured mock_reg_state.sys_status / mock_reg_state.rx_finfo values
 * depending on the requested register file ID (SYS_STATUS_ID / RX_FINFO_ID).
 * Register writes are captured, and additionally applied as a bit-clear
 * against mock_reg_state.sys_status when regFileID == SYS_STATUS_ID, mirroring
 * the DW1000's write-1-to-clear semantics for that register — this keeps a
 * test's pre-configured status word self-consistent if a test inspects it
 * again after the call under test returns.
 *
 * @attention
 * SPDX-License-Identifier: MIT
 * Copyright (c) 2024 Fundamentals UWB project contributors.
 */

#include <string.h>

#include "deca_device_api.h"
#include "deca_regs.h"
#include "mock_deca_driver.h"

/* ---------------------------------------------------------------------------
 * Captured / configurable state (inspected and pre-configured by tests)
 * --------------------------------------------------------------------------- */
struct mock_rxtimeout_state       mock_rxtimeout_state;
struct mock_rxenable_state        mock_rxenable_state;
struct mock_forcetrxoff_state     mock_forcetrxoff_state;
struct mock_reg_state             mock_reg_state;
struct mock_readrxdata_state      mock_readrxdata_state;
struct mock_timestamp_state       mock_timestamp_state;
struct mock_delayedtrxtime_state  mock_delayedtrxtime_state;
struct mock_tx_state              mock_tx_state;
struct mock_starttx_state         mock_starttx_state;

void mock_deca_reset(void)
{
    memset(&mock_rxtimeout_state,      0, sizeof(mock_rxtimeout_state));
    memset(&mock_rxenable_state,       0, sizeof(mock_rxenable_state));
    memset(&mock_forcetrxoff_state,    0, sizeof(mock_forcetrxoff_state));
    memset(&mock_reg_state,            0, sizeof(mock_reg_state));
    memset(&mock_readrxdata_state,     0, sizeof(mock_readrxdata_state));
    memset(&mock_timestamp_state,      0, sizeof(mock_timestamp_state));
    memset(&mock_delayedtrxtime_state, 0, sizeof(mock_delayedtrxtime_state));
    memset(&mock_tx_state,             0, sizeof(mock_tx_state));
    memset(&mock_starttx_state,        0, sizeof(mock_starttx_state));

    /* Defaults: every deca_driver call that can fail reports success. */
    mock_rxenable_state.return_value      = DWT_SUCCESS;
    mock_tx_state.writetxdata_return_value = DWT_SUCCESS;
    mock_starttx_state.return_value        = DWT_SUCCESS;
}

/* ---------------------------------------------------------------------------
 * Mock dwt_setrxtimeout
 * --------------------------------------------------------------------------- */
void dwt_setrxtimeout(uint16 time)
{
    mock_rxtimeout_state.called = 1;
    mock_rxtimeout_state.time   = time;
}

/* ---------------------------------------------------------------------------
 * Mock dwt_rxenable
 * --------------------------------------------------------------------------- */
int dwt_rxenable(int mode)
{
    mock_rxenable_state.called = 1;
    mock_rxenable_state.mode   = mode;
    return mock_rxenable_state.return_value;
}

/* ---------------------------------------------------------------------------
 * Mock dwt_forcetrxoff
 * --------------------------------------------------------------------------- */
void dwt_forcetrxoff(void)
{
    mock_forcetrxoff_state.called++;
}

/* ---------------------------------------------------------------------------
 * Mock dwt_read32bitoffsetreg (backs the dwt_read32bitreg() macro)
 *
 * Returns mock_reg_state.sys_status for SYS_STATUS_ID, mock_reg_state.rx_finfo
 * for RX_FINFO_ID, and 0 for anything else.
 * --------------------------------------------------------------------------- */
uint32 dwt_read32bitoffsetreg(int regFileID, int regOffset)
{
    (void)regOffset;

    if (regFileID == SYS_STATUS_ID) {
        return mock_reg_state.sys_status;
    }
    if (regFileID == RX_FINFO_ID) {
        return mock_reg_state.rx_finfo;
    }
    return 0u;
}

/* ---------------------------------------------------------------------------
 * Mock dwt_write32bitoffsetreg (backs the dwt_write32bitreg() macro)
 *
 * Captures the last register/value written. When writing SYS_STATUS_ID,
 * clears the written bits from mock_reg_state.sys_status (write-1-to-clear,
 * matching real DW1000 SYS_STATUS semantics).
 * --------------------------------------------------------------------------- */
void dwt_write32bitoffsetreg(int regFileID, int regOffset, uint32 regval)
{
    (void)regOffset;

    mock_reg_state.last_write_reg = (uint32)regFileID;
    mock_reg_state.last_write_val = regval;
    mock_reg_state.write_count++;

    if (regFileID == SYS_STATUS_ID) {
        mock_reg_state.sys_status &= ~regval;
    }
}

/* ---------------------------------------------------------------------------
 * Mock dwt_readrxdata
 *
 * Captures length/offset and copies the test-injected payload bytes into the
 * caller's buffer.
 * --------------------------------------------------------------------------- */
void dwt_readrxdata(uint8 *buffer, uint16 length, uint16 rxBufferOffset)
{
    uint16 copy_len = length;

    mock_readrxdata_state.called = 1;
    mock_readrxdata_state.length = length;
    mock_readrxdata_state.offset = rxBufferOffset;

    if (copy_len > MOCK_MAX_FRAME_LEN) {
        copy_len = MOCK_MAX_FRAME_LEN;
    }
    if (buffer != NULL) {
        memcpy(buffer, mock_readrxdata_state.injected_payload, copy_len);
    }
}

/* ---------------------------------------------------------------------------
 * Mock dwt_readrxtimestamp / dwt_readtxtimestamp
 * --------------------------------------------------------------------------- */
void dwt_readrxtimestamp(uint8 *timestamp)
{
    mock_timestamp_state.rx_called++;
    if (timestamp != NULL) {
        memcpy(timestamp, mock_timestamp_state.rx_ts_bytes, 5);
    }
}

void dwt_readtxtimestamp(uint8 *timestamp)
{
    mock_timestamp_state.tx_called++;
    if (timestamp != NULL) {
        memcpy(timestamp, mock_timestamp_state.tx_ts_bytes, 5);
    }
}

/* ---------------------------------------------------------------------------
 * Mock dwt_setdelayedtrxtime
 * --------------------------------------------------------------------------- */
void dwt_setdelayedtrxtime(uint32 starttime)
{
    mock_delayedtrxtime_state.called    = 1;
    mock_delayedtrxtime_state.starttime = starttime;
}

/* ---------------------------------------------------------------------------
 * Mock dwt_writetxdata
 * --------------------------------------------------------------------------- */
int dwt_writetxdata(uint16 txFrameLength, uint8 *txFrameBytes, uint16 txBufferOffset)
{
    uint16 copy_len = txFrameLength;

    mock_tx_state.writetxdata_called = 1;
    mock_tx_state.writetxdata_len    = txFrameLength;
    mock_tx_state.writetxdata_offset = txBufferOffset;

    if (copy_len > MOCK_MAX_FRAME_LEN) {
        copy_len = MOCK_MAX_FRAME_LEN;
    }
    if (txFrameBytes != NULL) {
        memcpy(mock_tx_state.writetxdata_buf, txFrameBytes, copy_len);
    }

    return mock_tx_state.writetxdata_return_value;
}

/* ---------------------------------------------------------------------------
 * Mock dwt_writetxfctrl
 * --------------------------------------------------------------------------- */
void dwt_writetxfctrl(uint16 txFrameLength, uint16 txBufferOffset, int ranging)
{
    mock_tx_state.writetxfctrl_called  = 1;
    mock_tx_state.writetxfctrl_len     = txFrameLength;
    mock_tx_state.writetxfctrl_offset  = txBufferOffset;
    mock_tx_state.writetxfctrl_ranging = ranging;
}

/* ---------------------------------------------------------------------------
 * Mock dwt_starttx
 * --------------------------------------------------------------------------- */
int dwt_starttx(uint8 mode)
{
    mock_starttx_state.called = 1;
    mock_starttx_state.mode   = mode;
    return mock_starttx_state.return_value;
}
```

## src/mock_deca_driver.h
```c
/*! ----------------------------------------------------------------------------
 * @file    mock_deca_driver.h
 * @brief   Mock state for the deca_driver API functions called by
 *          dw1000_ranging.c (dw1000_rx() + dw1000_tx_at(), driven here by
 *          uwb_join_track.c's composed join (UWB-261) -> tracking (UWB-252)
 *          steps -- UWB-263 unit tests). Copied verbatim from
 *          tests/tracking/ (UWB-252) / tests/join/ (UWB-261), which
 *          themselves copied it from tests/dw1000_sync/ (UWB-242) /
 *          tests/dw1000_ranging/ (UWB-231) -- a single uwb_join_track_step()
 *          call drives AT MOST one RX-family call OR one TX call (it forwards
 *          to exactly one of uwb_join_step() or uwb_tracking_run_cycle(),
 *          each of which upholds that same "at most one of each" invariant
 *          per call -- see uwb_join.h / uwb_tracking.h), so the simple
 *          single-shot mock state from those suites suffices -- no RX
 *          queueing is needed.
 *
 * Captured/configurable state is reset by mock_deca_reset() before each test.
 * Tests pre-configure the register-read state (mock_reg_state, injected
 * timestamp/payload bytes) before calling the function under test, then
 * assert on the captured call arguments.
 *
 * @attention
 * SPDX-License-Identifier: MIT
 * Copyright (c) 2024 Fundamentals UWB project contributors.
 */

#ifndef MOCK_DECA_DRIVER_H_
#define MOCK_DECA_DRIVER_H_

#include "deca_device_api.h"

/** Size of the scratch buffers used to capture RX/TX payload bytes. */
#define MOCK_MAX_FRAME_LEN  128

/**
 * State captured from mock dwt_setrxtimeout() call.
 */
struct mock_rxtimeout_state {
    int    called;   /**< Non-zero if dwt_setrxtimeout() was called. */
    uint16 time;     /**< The 'time' argument passed (DW1000 RX_FWTO units). */
};

/**
 * State captured from mock dwt_rxenable() call, and its configurable
 * return value.
 */
struct mock_rxenable_state {
    int called;         /**< Non-zero if dwt_rxenable() was called. */
    int mode;            /**< The 'mode' argument passed. */
    int return_value;   /**< Value dwt_rxenable() should return (default DWT_SUCCESS). */
};

/**
 * Call counter for mock dwt_forcetrxoff().
 */
struct mock_forcetrxoff_state {
    int called;
};

/**
 * Configurable register-read values and captured register writes, used for
 * both dw1000_rx()'s and dw1000_tx_at()'s SYS_STATUS/RX_FINFO polling.
 *
 * Set sys_status / rx_finfo BEFORE calling the function under test to drive
 * a specific scenario (good frame / RX error / RX timeout / TXFRS / HPDWARN).
 */
struct mock_reg_state {
    uint32 sys_status;       /**< Value returned for dwt_read32bitreg(SYS_STATUS_ID). */
    uint32 rx_finfo;          /**< Value returned for dwt_read32bitreg(RX_FINFO_ID). */
    uint32 last_write_reg;    /**< Last regFileID written via dwt_write32bit{,offset}reg. */
    uint32 last_write_val;    /**< Last value written. */
    int    write_count;       /**< Number of register writes captured. */
};

/**
 * Captured dwt_readrxdata() call arguments, plus the payload bytes the mock
 * copies into the caller's buffer (set injected_payload before the call).
 */
struct mock_readrxdata_state {
    int    called;
    uint16 length;
    uint16 offset;
    uint8  injected_payload[MOCK_MAX_FRAME_LEN];
};

/**
 * Injected 5-byte RX/TX timestamp buffers returned by
 * dwt_readrxtimestamp() / dwt_readtxtimestamp(), plus call counters.
 */
struct mock_timestamp_state {
    uint8 rx_ts_bytes[5];
    uint8 tx_ts_bytes[5];
    int   rx_called;
    int   tx_called;
};

/**
 * State captured from mock dwt_setdelayedtrxtime() call.
 */
struct mock_delayedtrxtime_state {
    int    called;
    uint32 starttime;
};

/**
 * State captured from mock dwt_writetxdata() and dwt_writetxfctrl() calls,
 * and dwt_writetxdata()'s configurable return value.
 */
struct mock_tx_state {
    int    writetxdata_called;
    uint16 writetxdata_len;
    uint8  writetxdata_buf[MOCK_MAX_FRAME_LEN];
    uint16 writetxdata_offset;
    int    writetxdata_return_value;

    int    writetxfctrl_called;
    uint16 writetxfctrl_len;
    uint16 writetxfctrl_offset;
    int    writetxfctrl_ranging;
};

/**
 * State captured from mock dwt_starttx() call, and its configurable return
 * value (set to DWT_ERROR to simulate a missed/HPDWARN slot).
 */
struct mock_starttx_state {
    int    called;
    uint8  mode;
    int    return_value;
};

extern struct mock_rxtimeout_state       mock_rxtimeout_state;
extern struct mock_rxenable_state        mock_rxenable_state;
extern struct mock_forcetrxoff_state     mock_forcetrxoff_state;
extern struct mock_reg_state             mock_reg_state;
extern struct mock_readrxdata_state      mock_readrxdata_state;
extern struct mock_timestamp_state       mock_timestamp_state;
extern struct mock_delayedtrxtime_state  mock_delayedtrxtime_state;
extern struct mock_tx_state              mock_tx_state;
extern struct mock_starttx_state         mock_starttx_state;

/** Reset all captured/configurable state to defaults (all-success, all-zero). */
void mock_deca_reset(void);

#endif /* MOCK_DECA_DRIVER_H_ */
```

## src/mock_log.c
```c
/*! ----------------------------------------------------------------------------
 * @file    mock_log.c
 * @brief   Zephyr minimal-log stub for the uwb_join_track unit test (UWB-263).
 *
 * Copied from tests/tracking/src/mock_log.c (UWB-252) / tests/join/src/mock_log.c
 * (UWB-261), originally tests/dw1000_sync/src/mock_log.c (UWB-242) /
 * tests/dw1000_ranging/src/mock_log.c (UWB-231): the join_track test build
 * compiles dw1000_ranging.c, dw1000_sync.c, uwb_cycle_ref.c, uwb_slot_timing.c,
 * uwb_join_codec.c, uwb_join.c, and uwb_tracking.c alongside uwb_join_track.c
 * itself, and the unit_testing defconfig enables CONFIG_LOG=y, which causes
 * every LOG_ERR()/LOG_DBG()/LOG_WRN()/LOG_INF() macro in those modules to call
 * z_log_minimal_printk() at link time. That function lives in Zephyr's
 * log_minimal.c, which is not compiled in the minimal unit_testing link set.
 * Stub it out here — unit tests do not need real log output, only assertion
 * correctness.
 *
 * @attention
 * SPDX-License-Identifier: MIT
 * Copyright (c) 2024 Fundamentals UWB project contributors.
 */

#include <stdarg.h>

void z_log_minimal_printk(const char *fmt, ...)
{
    (void)fmt;
    /* No-op: discard log messages in unit tests. */
}
```

## src/test_join_track.c
```c
/*! ----------------------------------------------------------------------------
 * @file    test_join_track.c
 * @brief   ztest suite: join -> tracking orchestration seam (UWB-263)
 *
 * Platform: unit_testing (native-hosted, no Zephyr kernel, no real SPI).
 * Compiles the real uwb_join_track.c against uwb_join.c (UWB-261),
 * uwb_join_codec.c (UWB-259), uwb_tracking.c (UWB-252), dw1000_sync.c
 * (UWB-242), dw1000_ranging.c (UWB-231), uwb_cycle_ref.c (UWB-243),
 * uwb_slot_timing.c (UWB-251), and uwb_blink_codec.c (UWB-250) -- see
 * tests/join_track/CMakeLists.txt.
 *
 * Covers, per the UWB-263 acceptance criteria:
 *   - After a matching SLOT_ASSIGNMENT is adopted, the tag transitions from
 *     the join phase to the track phase, and the FIRST blink built by
 *     uwb_tracking.c carries the ADOPTED short_addr at UWB_OFF_SRC_ADDR (not
 *     any hard-coded/injected value) and is scheduled at the ADOPTED
 *     slot_idx's timing (captured dw1000_tx_at() tx_time_dtu, cross-checked
 *     against dw1000_delayed_tx_time() computed the same way uwb_tracking.c
 *     itself does) -- test_join_then_track_adopts_config_for_blink.
 *   - A tag that never receives a matching SLOT_ASSIGNMENT never leaves the
 *     join phase and never calls the blink dw1000_tx_at() (every captured TX
 *     is JOIN_REQUEST-shaped, never TAG_BLINK-shaped) --
 *     test_never_assigned_never_enters_track_phase.
 *   - A SLOT_ASSIGNMENT for a different EUI-64 does not cause a false adopt
 *     (the seam stays in the join phase) -- covered indirectly via
 *     uwb_join.c's own suite (tests/join/); re-exercised at the seam level
 *     for the join->track transition it gates --
 *     test_foreign_assignment_does_not_transition.
 *   - Once tracking, the seam keeps its assignment across transient SYNC
 *     loss (ADR-0039) -- repeated dw1000_sync_rx() misses report
 *     UWB_JOIN_TRACK_NO_VALID_REF, NOT a return to the join phase --
 *     test_sync_loss_after_track_does_not_rejoin.
 *   - NULL cfg/state are rejected without touching the radio --
 *     test_null_args_rejected_without_touching_radio.
 *   - uwb_join_track_state_init() starts in the join phase and
 *     uwb_join_track_is_tracking() reports false --
 *     test_state_init_starts_in_join_phase.
 *
 * @attention
 * SPDX-License-Identifier: MIT
 * Copyright (c) 2024 Fundamentals UWB project contributors.
 */

#include <string.h>

#include <zephyr/ztest.h>

#include "deca_device_api.h"
#include "deca_regs.h"
#include "dw1000_ranging.h"
#include "mock_deca_driver.h"
#include "uwb_blink_codec.h"
#include "uwb_frames.h"
#include "uwb_join.h"
#include "uwb_join_codec.h"
#include "uwb_join_track.h"

/* ---------------------------------------------------------------------------
 * Suite setup / teardown
 * --------------------------------------------------------------------------- */
static void before_each(void *fixture)
{
    (void)fixture;
    mock_deca_reset();
}

ZTEST_SUITE(uwb_join_track, NULL, NULL, before_each, NULL, NULL);

/* ---------------------------------------------------------------------------
 * Injected seam stubs (join-phase callbacks)
 * --------------------------------------------------------------------------- */
static const uint8_t g_self_eui64[UWB_EUI64_LEN] = {
    0x01, 0x02, 0x03, 0x04, 0x05, 0x06, 0x07, 0x08
};
static const uint8_t g_other_eui64[UWB_EUI64_LEN] = {
    0xAA, 0xBB, 0xCC, 0xDD, 0xEE, 0xFF, 0x11, 0x22
};

static void stub_eui64_get_self(uint8_t eui64_out[UWB_EUI64_LEN])
{
    memcpy(eui64_out, g_self_eui64, UWB_EUI64_LEN);
}

static uint32_t stub_rng(uint32_t min, uint32_t max)
{
    /* Deterministic: always the minimum -- backoff delay/window growth
     * itself is exhaustively covered by tests/join/; this suite only needs
     * SOME deterministic value so retries progress quickly. */
    (void)max;
    return min;
}

static uint64_t stub_now_get(void)
{
    return 0x0000010000000000ULL >> 8; /* arbitrary 40-bit-range value */
}

/* ---------------------------------------------------------------------------
 * Default config fixture
 * --------------------------------------------------------------------------- */
static uwb_join_track_config_t make_default_cfg(void)
{
    uwb_join_track_config_t cfg = {0};

    cfg.join.eui64_get = stub_eui64_get_self;
    cfg.join.rng = stub_rng;
    cfg.join.now_get = stub_now_get;
    cfg.join.capabilities = 0;
    cfg.join.gate_cycles = 0; /* skip the gate -- not this seam's concern */
    cfg.join.await_cycles = 2;
    cfg.join.backoff_base_cycles = 1;
    cfg.join.backoff_max_cycles = 4;
    cfg.join.max_attempts = 0; /* unlimited unless a test overrides it */
    cfg.join.sync_timeout_us = 1000;
    cfg.join.assignment_timeout_us = 1000;
    cfg.join.tx_margin_dtu = 1000;

    cfg.tracking_sync_timeout_us = 1000;

    return cfg;
}

/* ---------------------------------------------------------------------------
 * Test frame builders -- hand-pack raw frame buffers byte-by-byte from the
 * UWB_OFF_* offsets in uwb_frames.h, deliberately independent of the
 * codecs'/dw1000_sync.c's own encode/decode logic (same rationale as
 * tests/join/ and tests/tracking/'s identical builders).
 * --------------------------------------------------------------------------- */
static void build_sync_frame(uint8_t *buf, uint16_t cycle_seq, uint64_t master_tx_ts)
{
    int i;

    memset(buf, 0, UWB_SYNC_FRAME_SIZE);

    buf[UWB_OFF_FRAME_CTRL]     = UWB_FRAME_CTRL_LOW;
    buf[UWB_OFF_FRAME_CTRL + 1] = UWB_FRAME_CTRL_HIGH;
    buf[UWB_OFF_SEQ_NUM]        = 0x01u;

    buf[UWB_OFF_PAN_ID]     = (uint8_t)(UWB_PAN_ID & 0xFFu);
    buf[UWB_OFF_PAN_ID + 1] = (uint8_t)((UWB_PAN_ID >> 8) & 0xFFu);

    buf[UWB_OFF_DEST_ADDR]     = (uint8_t)(UWB_ADDR_BROADCAST & 0xFFu);
    buf[UWB_OFF_DEST_ADDR + 1] = (uint8_t)((UWB_ADDR_BROADCAST >> 8) & 0xFFu);

    buf[UWB_OFF_SRC_ADDR]     = 0x01u; /* Master's short addr -- unvalidated here. */
    buf[UWB_OFF_SRC_ADDR + 1] = 0x00u;

    buf[UWB_OFF_FRAME_TYPE] = (uint8_t)UWB_FRAME_TYPE_SYNC;

    buf[UWB_OFF_SYNC_CYCLE_SEQ]     = (uint8_t)(cycle_seq & 0xFFu);
    buf[UWB_OFF_SYNC_CYCLE_SEQ + 1] = (uint8_t)((cycle_seq >> 8) & 0xFFu);

    for (i = 0; i < 5; i++) {
        buf[UWB_OFF_SYNC_MASTER_TX_TS + i] = (uint8_t)((master_tx_ts >> (8 * i)) & 0xFFu);
    }
}

static void build_slot_assignment_frame(uint8_t *buf,
                                         const uint8_t target_eui64[UWB_EUI64_LEN],
                                         uint16_t short_addr, uint8_t slot_idx,
                                         uint8_t slot_count, uint16_t slot_duration_us)
{
    memset(buf, 0, UWB_SLOT_ASSIGNMENT_FRAME_SIZE);

    buf[UWB_OFF_FRAME_CTRL]     = UWB_FRAME_CTRL_LOW;
    buf[UWB_OFF_FRAME_CTRL + 1] = UWB_FRAME_CTRL_HIGH;
    buf[UWB_OFF_SEQ_NUM]        = 0x01u;

    buf[UWB_OFF_PAN_ID]     = (uint8_t)(UWB_PAN_ID & 0xFFu);
    buf[UWB_OFF_PAN_ID + 1] = (uint8_t)((UWB_PAN_ID >> 8) & 0xFFu);

    buf[UWB_OFF_DEST_ADDR]     = (uint8_t)(UWB_ADDR_BROADCAST & 0xFFu);
    buf[UWB_OFF_DEST_ADDR + 1] = (uint8_t)((UWB_ADDR_BROADCAST >> 8) & 0xFFu);

    buf[UWB_OFF_SRC_ADDR]     = 0x01u; /* Master's short addr -- unvalidated here. */
    buf[UWB_OFF_SRC_ADDR + 1] = 0x00u;

    buf[UWB_OFF_FRAME_TYPE] = (uint8_t)UWB_FRAME_TYPE_SLOT_ASSIGNMENT;

    memcpy(&buf[UWB_OFF_SLOT_TARGET_EUI64], target_eui64, UWB_EUI64_LEN);

    buf[UWB_OFF_SLOT_SHORT_ADDR]     = (uint8_t)(short_addr & 0xFFu);
    buf[UWB_OFF_SLOT_SHORT_ADDR + 1] = (uint8_t)((short_addr >> 8) & 0xFFu);

    buf[UWB_OFF_SLOT_IDX]   = slot_idx;
    buf[UWB_OFF_SLOT_COUNT] = slot_count;

    buf[UWB_OFF_SLOT_DURATION_US]     = (uint8_t)(slot_duration_us & 0xFFu);
    buf[UWB_OFF_SLOT_DURATION_US + 1] = (uint8_t)((slot_duration_us >> 8) & 0xFFu);
}

/* ---------------------------------------------------------------------------
 * Mock configuration helpers
 * --------------------------------------------------------------------------- */
static void arm_rx_timeout(void)
{
    mock_reg_state.sys_status = SYS_STATUS_RXRFTO;
}

static void arm_slot_assignment_heard(const uint8_t target_eui64[UWB_EUI64_LEN],
                                       uint16_t short_addr, uint8_t slot_idx,
                                       uint8_t slot_count, uint16_t slot_duration_us)
{
    uint8_t frame[UWB_SLOT_ASSIGNMENT_FRAME_SIZE];

    build_slot_assignment_frame(frame, target_eui64, short_addr, slot_idx, slot_count,
                                 slot_duration_us);

    mock_reg_state.sys_status = SYS_STATUS_RXFCG;
    mock_reg_state.rx_finfo = (uint32)UWB_SLOT_ASSIGNMENT_FRAME_SIZE;
    memcpy(mock_readrxdata_state.injected_payload, frame, sizeof(frame));
}

/* Arms the mock for a successful dw1000_sync_rx() (used once in the track
 * phase) -- also pre-arms SYS_STATUS_TXFRS so a subsequent dw1000_tx_at()
 * (the blink) succeeds by default, exactly as tests/tracking's
 * configure_good_sync_rx() does. */
static void arm_sync_heard(uint16_t cycle_seq, uint64_t master_tx_ts, uint64_t rx_ts)
{
    uint8_t frame[UWB_SYNC_FRAME_SIZE];
    int i;

    build_sync_frame(frame, cycle_seq, master_tx_ts);

    mock_reg_state.sys_status = SYS_STATUS_RXFCG | SYS_STATUS_TXFRS;
    mock_reg_state.rx_finfo = (uint32)UWB_SYNC_FRAME_SIZE;
    memcpy(mock_readrxdata_state.injected_payload, frame, sizeof(frame));

    for (i = 0; i < 5; i++) {
        mock_timestamp_state.rx_ts_bytes[i] = (uint8_t)((rx_ts >> (8 * i)) & 0xFFu);
    }
}

/* Arms the mock so a JOIN_REQUEST TX (join phase) succeeds. */
static void arm_tx_ok(void)
{
    mock_reg_state.sys_status = SYS_STATUS_TXFRS;
}

static uint16_t decode_le16(const uint8_t *p)
{
    return (uint16_t)((uint16_t)p[0] | ((uint16_t)p[1] << 8));
}

/* =============================================================================
 * Join -> track: the FIRST blink after adoption carries the ADOPTED
 * short_addr as MAC src and TXes at the ADOPTED slot's computed timing.
 * ========================================================================= */
ZTEST(uwb_join_track, test_join_then_track_adopts_config_for_blink)
{
    uwb_join_track_config_t cfg = make_default_cfg();
    uwb_join_track_state_t state;
    const uint16_t adopted_short_addr = 0x00AAu;
    const uint8_t  adopted_slot_idx = 5u;
    const uint8_t  adopted_slot_count = 24u;
    const uint16_t adopted_slot_duration_us = 500u;
    const uint64_t rx_ts = 0x0100000000ULL;

    uwb_join_track_state_init(&state, &cfg);
    zassert_false(uwb_join_track_is_tracking(&state),
        "must start in the join phase, not tracking");

    /* Step 1: JOIN_REQUEST transmitted. */
    arm_tx_ok();
    uwb_join_track_outcome_t o1 = uwb_join_track_step(&cfg, &state);

    zassert_equal(o1, UWB_JOIN_TRACK_JOIN_REQUEST_SENT,
        "expected JOIN_REQUEST_SENT; got %d", (int)o1);
    zassert_equal(mock_tx_state.writetxdata_called, 1,
        "JOIN_REQUEST must have been transmitted");
    zassert_equal(mock_tx_state.writetxdata_len,
        (uint16)(UWB_JOIN_REQUEST_FRAME_SIZE + 2u),
        "the only TX so far must be JOIN_REQUEST-shaped");

    /* Step 2: a matching SLOT_ASSIGNMENT arrives -- adopt + transition. */
    arm_slot_assignment_heard(g_self_eui64, adopted_short_addr, adopted_slot_idx,
                               adopted_slot_count, adopted_slot_duration_us);
    uwb_join_track_outcome_t o2 = uwb_join_track_step(&cfg, &state);

    zassert_equal(o2, UWB_JOIN_TRACK_JOINED,
        "expected JOINED on a matching assignment; got %d", (int)o2);
    zassert_true(uwb_join_track_is_tracking(&state),
        "must be in the track phase immediately after adopting");
    zassert_equal(mock_tx_state.writetxdata_called, 1,
        "adopting the assignment must NOT itself transmit anything -- still "
        "only the earlier JOIN_REQUEST");

    /* The adopted config must be exactly what the SLOT_ASSIGNMENT carried --
     * NOT any hard-coded/injected placeholder value. */
    zassert_equal(state.tracking_cfg.self_addr, adopted_short_addr,
        "tracking_cfg.self_addr must be the ADOPTED short_addr");
    zassert_equal(state.tracking_cfg.slot_idx, (uint32_t)adopted_slot_idx,
        "tracking_cfg.slot_idx must be the ADOPTED slot_idx");
    zassert_equal(state.tracking_cfg.slot_count, (uint32_t)adopted_slot_count,
        "tracking_cfg.slot_count must be the ADOPTED slot_count");
    zassert_true(state.tracking_cfg.slot_duration_dtu > 0,
        "tracking_cfg.slot_duration_dtu must be derived (non-zero) from the "
        "adopted slot_duration_us");

    /* Step 3: first tracking cycle -- a SYNC is heard, the blink must be
     * built + scheduled using the ADOPTED config. */
    arm_sync_heard(0x0001u, 0x0ABCDEULL, rx_ts);
    uwb_join_track_outcome_t o3 = uwb_join_track_step(&cfg, &state);

    zassert_equal(o3, UWB_JOIN_TRACK_BLINKED,
        "expected BLINKED on the first tracking cycle; got %d", (int)o3);
    zassert_equal(mock_tx_state.writetxdata_called, 1,
        "dwt_writetxdata() call counter is a latch (set to 1, not "
        "incremented) -- still non-zero after the blink TX");
    zassert_equal(mock_tx_state.writetxdata_len,
        (uint16)(UWB_TAG_BLINK_FRAME_SIZE + 2u),
        "the blink TX must be TAG_BLINK-shaped (%u bytes incl. CRC); got %u",
        (unsigned)(UWB_TAG_BLINK_FRAME_SIZE + 2u),
        (unsigned)mock_tx_state.writetxdata_len);

    /* MAC src_addr (UWB_OFF_SRC_ADDR) in the raw transmitted buffer must be
     * the ADOPTED short_addr. */
    zassert_equal(decode_le16(&mock_tx_state.writetxdata_buf[UWB_OFF_SRC_ADDR]),
        adopted_short_addr,
        "blink MAC src_addr (UWB_OFF_SRC_ADDR) must be the ADOPTED short_addr");

    /* Cross-check via the blink codec's own parser too. */
    uint16_t decoded_src_addr = 0xFFFFu;
    int ret = uwb_parse_tag_blink(mock_tx_state.writetxdata_buf,
                                   UWB_TAG_BLINK_FRAME_SIZE, &decoded_src_addr,
                                   NULL, NULL);

    zassert_equal(ret, 0, "built blink frame failed to parse back (%d)", ret);
    zassert_equal(decoded_src_addr, adopted_short_addr,
        "uwb_parse_tag_blink()-decoded src_addr must be the ADOPTED short_addr");

    /* The scheduled TX time must be computed from THIS cycle's sync_rx_ts and
     * the ADOPTED slot_idx / (converted) slot_duration_dtu -- exactly the
     * same formula uwb_slot_tx_time()/uwb_tracking.c itself uses. Comparing
     * against the adopted slot_idx (5), NOT slot 0 or any other value,
     * confirms this is not scheduled off a hard-coded/injected slot. */
    uint64_t expected_tx_time = dw1000_delayed_tx_time(
        rx_ts, (uint64_t)state.tracking_cfg.slot_idx * state.tracking_cfg.slot_duration_dtu);

    zassert_equal(mock_delayedtrxtime_state.called, 1,
        "dwt_setdelayedtrxtime() must have been called for the blink");
    zassert_equal(mock_delayedtrxtime_state.starttime,
        (uint32)(expected_tx_time >> 8),
        "scheduled TX time must match the ADOPTED slot's computed timing: "
        "expected 0x%08X; got 0x%08X",
        (unsigned)(expected_tx_time >> 8),
        (unsigned)mock_delayedtrxtime_state.starttime);
}

/* =============================================================================
 * A tag that never receives a matching SLOT_ASSIGNMENT never leaves the join
 * phase and never calls the blink dw1000_tx_at() -- every captured TX stays
 * JOIN_REQUEST-shaped.
 * ========================================================================= */
ZTEST(uwb_join_track, test_never_assigned_never_enters_track_phase)
{
    uwb_join_track_config_t cfg = make_default_cfg();
    uwb_join_track_state_t state;
    int i;

    cfg.join.await_cycles = 1;
    cfg.join.backoff_base_cycles = 1;
    cfg.join.backoff_max_cycles = 2;
    cfg.join.max_attempts = 0; /* never gives up -- stays retrying forever,
                                   same as a real tag that just never hears a
                                   matching assignment */

    uwb_join_track_state_init(&state, &cfg);

    /* Drive ~20 cycles: every REQUEST TXes ok, every AWAIT times out (no
     * SLOT_ASSIGNMENT ever heard), backoff counts down. Nothing should ever
     * transition phase or attempt a blink.
     *
     * Arm the mock according to which join sub-phase THIS call will drive
     * (read from the exposed join_state.phase before stepping) -- a REQUEST
     * call only calls dw1000_tx_at() (needs SYS_STATUS_TXFRS armed so its
     * post-starttx completion poll does not spin forever), an AWAIT call
     * only calls dw1000_rx() (needs an RX-timeout status), and a BACKOFF
     * call touches the radio at all. Arming the wrong one for whichever call
     * is about to happen would hang the test (dw1000_tx_at()'s completion
     * poll never seeing TXFRS). */
    for (i = 0; i < 20; i++) {
        if (state.join_state.phase == UWB_JOIN_PHASE_REQUEST) {
            arm_tx_ok();
        } else if (state.join_state.phase == UWB_JOIN_PHASE_AWAIT) {
            arm_rx_timeout();
        }
        /* UWB_JOIN_PHASE_BACKOFF: no radio call this step -- nothing to arm. */

        uwb_join_track_outcome_t outcome = uwb_join_track_step(&cfg, &state);

        zassert_true(outcome != UWB_JOIN_TRACK_JOINED &&
                         outcome != UWB_JOIN_TRACK_BLINKED &&
                         outcome != UWB_JOIN_TRACK_NO_VALID_REF &&
                         outcome != UWB_JOIN_TRACK_MISSED_WINDOW &&
                         outcome != UWB_JOIN_TRACK_BUILD_ERROR,
            "cycle %d: must stay a join-phase outcome (never enter track "
            "phase); got %d",
            i, (int)outcome);

        zassert_false(uwb_join_track_is_tracking(&state),
            "cycle %d: must never report tracking", i);

        if (mock_tx_state.writetxdata_called) {
            zassert_equal(mock_tx_state.writetxdata_len,
                (uint16)(UWB_JOIN_REQUEST_FRAME_SIZE + 2u),
                "cycle %d: any TX so far must be JOIN_REQUEST-shaped, never "
                "TAG_BLINK-shaped (the blink dw1000_tx_at() must never be "
                "reached)",
                i);
        }
    }

    zassert_equal(state.phase, UWB_JOIN_TRACK_PHASE_JOIN,
        "must still be in the join phase after 20 cycles with no assignment");
}

/* =============================================================================
 * A SLOT_ASSIGNMENT addressed to a DIFFERENT tag must not cause a false
 * adopt / transition at the seam level.
 * ========================================================================= */
ZTEST(uwb_join_track, test_foreign_assignment_does_not_transition)
{
    uwb_join_track_config_t cfg = make_default_cfg();
    uwb_join_track_state_t state;

    cfg.join.await_cycles = 2;

    uwb_join_track_state_init(&state, &cfg);

    arm_tx_ok();
    zassert_equal(uwb_join_track_step(&cfg, &state), UWB_JOIN_TRACK_JOIN_REQUEST_SENT,
        "expected JOIN_REQUEST_SENT");

    arm_slot_assignment_heard(g_other_eui64, 0x0099u, 1u, 24u, 500u);
    uwb_join_track_outcome_t outcome = uwb_join_track_step(&cfg, &state);

    zassert_equal(outcome, UWB_JOIN_TRACK_JOIN_AWAIT_FOREIGN,
        "expected JOIN_AWAIT_FOREIGN for a non-matching target_eui64; got %d",
        (int)outcome);
    zassert_false(uwb_join_track_is_tracking(&state),
        "must NOT have transitioned on a foreign assignment");
    zassert_equal(state.phase, UWB_JOIN_TRACK_PHASE_JOIN, "must remain in the join phase");
}

/* =============================================================================
 * Once tracking, transient SYNC loss must NOT return the seam to the join
 * phase (ADR-0039: assignment kept across transient SYNC loss).
 * ========================================================================= */
ZTEST(uwb_join_track, test_sync_loss_after_track_does_not_rejoin)
{
    uwb_join_track_config_t cfg = make_default_cfg();
    uwb_join_track_state_t state;
    int i;

    uwb_join_track_state_init(&state, &cfg);

    arm_tx_ok();
    zassert_equal(uwb_join_track_step(&cfg, &state), UWB_JOIN_TRACK_JOIN_REQUEST_SENT,
        "expected JOIN_REQUEST_SENT");

    arm_slot_assignment_heard(g_self_eui64, 0x0055u, 2u, 24u, 500u);
    zassert_equal(uwb_join_track_step(&cfg, &state), UWB_JOIN_TRACK_JOINED,
        "expected JOINED");
    zassert_true(uwb_join_track_is_tracking(&state), "must be tracking now");

    /* Many consecutive SYNC misses -- CONFIG_UWB_SYNC_MAX_MISSED (3, injected
     * by this suite's CMakeLists) plus margin. */
    for (i = 0; i < 10; i++) {
        arm_rx_timeout();
        uwb_join_track_outcome_t outcome = uwb_join_track_step(&cfg, &state);

        zassert_true(outcome == UWB_JOIN_TRACK_NO_VALID_REF ||
                         outcome == UWB_JOIN_TRACK_MISSED_WINDOW,
            "cycle %d: sync loss while tracking must stay a track-phase "
            "outcome (never a join-phase outcome / re-JOINED); got %d",
            i, (int)outcome);
        zassert_true(uwb_join_track_is_tracking(&state),
            "cycle %d: must remain in the track phase across transient "
            "SYNC loss (ADR-0039) -- no automatic re-join",
            i);
    }

    zassert_equal(state.phase, UWB_JOIN_TRACK_PHASE_TRACK,
        "must still be in the track phase after sustained sync loss");
}

/* =============================================================================
 * NULL args are rejected without touching the radio
 * ========================================================================= */
ZTEST(uwb_join_track, test_null_args_rejected_without_touching_radio)
{
    uwb_join_track_config_t cfg = make_default_cfg();
    uwb_join_track_state_t state;

    uwb_join_track_state_init(&state, &cfg);

    zassert_equal(uwb_join_track_step(NULL, &state), UWB_JOIN_TRACK_INVALID_ARGS,
        "NULL cfg must be rejected");
    zassert_equal(uwb_join_track_step(&cfg, NULL), UWB_JOIN_TRACK_INVALID_ARGS,
        "NULL state must be rejected");

    zassert_equal(mock_rxenable_state.called, 0,
        "NULL cfg/state must not touch the radio at all");
    zassert_equal(mock_tx_state.writetxdata_called, 0,
        "NULL cfg/state must not touch the radio at all");
}

/* =============================================================================
 * uwb_join_track_state_init(): starts in the join phase, not tracking
 * ========================================================================= */
ZTEST(uwb_join_track, test_state_init_starts_in_join_phase)
{
    uwb_join_track_config_t cfg = make_default_cfg();
    uwb_join_track_state_t state;

    /* Poison the memory first so the assertions below actually exercise
     * uwb_join_track_state_init(), rather than happening to pass on
     * zero-initialised stack memory. */
    memset(&state, 0xAA, sizeof(state));

    uwb_join_track_state_init(&state, &cfg);

    zassert_equal(state.phase, UWB_JOIN_TRACK_PHASE_JOIN,
        "must start in the join phase");
    zassert_false(uwb_join_track_is_tracking(&state), "must not report tracking yet");
    zassert_mem_equal(state.join_state.eui64, g_self_eui64, UWB_EUI64_LEN,
        "join_state.eui64 must be cached from cfg.join.eui64_get() at init");
}

ZTEST(uwb_join_track, test_state_init_null_is_noop)
{
    /* Must not crash. */
    uwb_join_track_state_init(NULL, NULL);

    uwb_join_track_config_t cfg = make_default_cfg();

    uwb_join_track_state_init(NULL, &cfg);
    zassert_false(uwb_join_track_is_tracking(NULL),
        "uwb_join_track_is_tracking(NULL) must report false, not crash");
}
```
