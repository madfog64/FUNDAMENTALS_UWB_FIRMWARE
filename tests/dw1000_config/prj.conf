## CMakeLists.txt
```
cmake_minimum_required(VERSION 3.20.0)

# Zephyr unit test build for the dw1000_config PHY configuration module.
#
# Key differences from regular Zephyr app builds:
#   - 'project()' comes BEFORE 'find_package()'
#   - 'COMPONENTS unittest' selects the minimal, kernel-free build
#   - The build target is 'testbinary' (not 'app')
#   - No device tree, no real SPI/GPIO
#
# What is compiled:
#   dw1000_config.c      — the module under test (UWB-155, UWB-156)
#   mock_deca_driver.c   — mocks dwt_initialise(), dwt_configure(),
#                          dwt_configuretxrf(), dwt_settxantennadelay(),
#                          dwt_setrxantennadelay(), dwt_otpread()
#   mock_port.c          — mocks reset_DW1000(), port_set_dw1000_slowrate(),
#                          port_set_dw1000_fastrate() with call counters
#   test_dw1000_config.c — ztest assertions
#
# Note: deca_device.c and deca_params_init.c are intentionally NOT compiled
# here. The test replaces all deca_driver API functions with mocks in
# mock_deca_driver.c so assertions can verify the argument values directly
# without SPI decoding.
#
# CONFIG_DW1000_PHY_* values are injected as target_compile_definitions below
# rather than via Kconfig, because the unit_testing platform's Kconfig root
# does not include the drivers/dw1000/Kconfig hierarchy.  The values here are
# pinned to phy_config.h v0.6 (same as the Kconfig defaults).
#
# Platform: unit_testing  (native host executable, no emulation)
# Run:  west twister -p unit_testing -T tests/dw1000_config -v

project(test_dw1000_config)
find_package(Zephyr COMPONENTS unittest REQUIRED HINTS $ENV{ZEPHYR_BASE})

set(DW1000_DIR ${CMAKE_CURRENT_SOURCE_DIR}/../../drivers/dw1000)

target_sources(testbinary PRIVATE
    src/test_dw1000_config.c
    src/mock_deca_driver.c
    src/mock_port.c
    ${DW1000_DIR}/dw1000_config.c
)

target_include_directories(testbinary PRIVATE
    ${DW1000_DIR}/deca_driver     # deca_device_api.h, deca_regs.h
    ${DW1000_DIR}                 # dw1000_config.h, phy_config.h
    ${CMAKE_CURRENT_SOURCE_DIR}/src  # mock_deca_driver.h, mock_port.h
)

# Inject the CONFIG_DW1000_PHY_* compile-time constants that dw1000_config.c
# reads (via Kconfig in a normal Zephyr build; directly here in unit tests).
# Values match contracts/uwb/phy_config.h v0.6 / Kconfig defaults in
# drivers/dw1000/Kconfig.
#
# UWB-156: also inject CONFIG_DW1000_ANTENNA_DELAY_TX/RX with the Kconfig
# defaults (16436 ticks — Decawave example value for DWM1001 at PRF 64 MHz).
target_compile_definitions(testbinary PRIVATE
    CONFIG_DW1000=1
    CONFIG_DW1000_PHY_CHANNEL=5
    CONFIG_DW1000_PHY_PRF=2
    CONFIG_DW1000_PHY_TX_PLEN=0x04
    CONFIG_DW1000_PHY_PAC=0
    CONFIG_DW1000_PHY_TX_CODE=9
    CONFIG_DW1000_PHY_RX_CODE=9
    CONFIG_DW1000_PHY_NS_SFD=0
    CONFIG_DW1000_PHY_DATA_RATE=2
    CONFIG_DW1000_PHY_PHR_MODE=0
    CONFIG_DW1000_PHY_SFD_TIMEOUT=65
    CONFIG_DW1000_PHY_TX_PGDELAY=0xC0
    CONFIG_DW1000_PHY_TX_POWER=0x0E082848
    CONFIG_DW1000_ANTENNA_DELAY_TX=16436
    CONFIG_DW1000_ANTENNA_DELAY_RX=16436
)
```

## prj.conf
```kconfig
# tests/dw1000_config/prj.conf
# Minimal config for the unit_testing platform — only ztest is needed.
# CONFIG_DW1000_PHY_* values are injected as compile definitions in
# CMakeLists.txt so they do not require Kconfig symbol registration.
CONFIG_ZTEST=y
```

## src/mock_deca_driver.c
```c
/*! ----------------------------------------------------------------------------
 * @file    mock_deca_driver.c
 * @brief   Mock implementations of deca_driver API functions called by
 *          dw1000_configure() (UWB-155, UWB-156 unit tests).
 *
 * These stubs replace deca_device.c and deca_params_init.c in the
 * unit_testing build.  They have no hardware or SPI dependencies — they
 * capture arguments so the test assertions can verify dw1000_configure()
 * drove the driver with the correct parameters.
 *
 * UWB-156 additions:
 *   dwt_settxantennadelay()  — captures last TX delay value and call count
 *   dwt_setrxantennadelay()  — captures last RX delay value and call count
 *   dwt_otpread()            — returns mock_otp_state.antdly_word for address
 *                              DW1000_OTP_ANTDLY_ADDRESS (0x1C); zero otherwise
 *
 * @attention
 * SPDX-License-Identifier: MIT
 * Copyright (c) 2024 Fundamentals UWB project contributors.
 */

#include <string.h>
#include "deca_device_api.h"
#include "dw1000_config.h"
#include "mock_deca_driver.h"

/* ---------------------------------------------------------------------------
 * Captured call state (inspected by test assertions)
 * --------------------------------------------------------------------------- */
struct mock_dwt_init_state    mock_init_state;
struct mock_dwt_cfg_state     mock_cfg_state;
struct mock_dwt_txrf_state    mock_txrf_state;
struct mock_dwt_antenna_state mock_antenna_state;
struct mock_dwt_otp_state     mock_otp_state;

void mock_deca_reset(void)
{
    memset(&mock_init_state,    0, sizeof(mock_init_state));
    memset(&mock_cfg_state,     0, sizeof(mock_cfg_state));
    memset(&mock_txrf_state,    0, sizeof(mock_txrf_state));
    memset(&mock_antenna_state, 0, sizeof(mock_antenna_state));
    memset(&mock_otp_state,     0, sizeof(mock_otp_state));
    /* Default: dwt_initialise() returns success; OTP is unprogrammed (0). */
    mock_init_state.return_value = DWT_SUCCESS;
}

/* ---------------------------------------------------------------------------
 * Mock dwt_initialise
 *
 * Captures the 'config' argument (DWT_LOADUCODE vs DWT_LOADNONE) and returns
 * the pre-set return_value (default: DWT_SUCCESS).
 * --------------------------------------------------------------------------- */
int dwt_initialise(uint16 config)
{
    mock_init_state.called     = 1;
    mock_init_state.config_arg = config;
    return mock_init_state.return_value;
}

/* ---------------------------------------------------------------------------
 * Mock dwt_configure
 *
 * Captures a copy of the dwt_config_t struct so the test can assert each
 * field value independently.
 * --------------------------------------------------------------------------- */
void dwt_configure(dwt_config_t *config)
{
    mock_cfg_state.called = 1;
    if (config != NULL) {
        memcpy(&mock_cfg_state.config, config, sizeof(dwt_config_t));
    }
}

/* ---------------------------------------------------------------------------
 * Mock dwt_configuretxrf
 *
 * Captures a copy of the dwt_txconfig_t struct.
 * --------------------------------------------------------------------------- */
void dwt_configuretxrf(dwt_txconfig_t *config)
{
    mock_txrf_state.called = 1;
    if (config != NULL) {
        memcpy(&mock_txrf_state.config, config, sizeof(dwt_txconfig_t));
    }
}

/* ---------------------------------------------------------------------------
 * Mock dwt_settxantennadelay (UWB-156)
 *
 * Captures the TX delay value and increments the call counter.
 * --------------------------------------------------------------------------- */
void dwt_settxantennadelay(uint16 txDelay)
{
    mock_antenna_state.tx_called++;
    mock_antenna_state.tx_delay = txDelay;
}

/* ---------------------------------------------------------------------------
 * Mock dwt_setrxantennadelay (UWB-156)
 *
 * Captures the RX delay value and increments the call counter.
 * --------------------------------------------------------------------------- */
void dwt_setrxantennadelay(uint16 rxDelay)
{
    mock_antenna_state.rx_called++;
    mock_antenna_state.rx_delay = rxDelay;
}

/* ---------------------------------------------------------------------------
 * Mock dwt_otpread (UWB-156)
 *
 * Returns mock_otp_state.antdly_word when the requested address matches
 * DW1000_OTP_ANTDLY_ADDRESS (0x1C).  All other addresses return 0.
 *
 * Set mock_otp_state.antdly_word before calling dw1000_configure() to
 * simulate a factory-calibrated (non-zero) or unprogrammed (zero) OTP:
 *   - Unprogrammed: antdly_word = 0           (default after mock_deca_reset)
 *   - PRF-64 cal'd: antdly_word = (val << 16) (val in bits[31:16])
 * --------------------------------------------------------------------------- */
void dwt_otpread(uint32 address, uint32 *array, uint8 length)
{
    uint8 i;

    if (array == NULL || length == 0u) {
        return;
    }
    for (i = 0u; i < length; i++) {
        if (address + i == (uint32)DW1000_OTP_ANTDLY_ADDRESS) {
            array[i] = mock_otp_state.antdly_word;
        } else {
            array[i] = 0u;
        }
    }
}

/* ---------------------------------------------------------------------------
 * Additional deca_driver stubs required at link time.
 * These functions are not called by dw1000_configure() but may be pulled in
 * by deca_device_api.h declarations or the linker.
 * --------------------------------------------------------------------------- */

uint32 dwt_readdevid(void)         { return DWT_DEVICE_ID; }
uint32 dwt_getpartid(void)         { return 0; }
uint32 dwt_getlotid(void)          { return 0; }
uint8  dwt_otprevision(void)       { return 0; }
int    dwt_setlocaldataptr(unsigned int index) { (void)index; return DWT_SUCCESS; }
uint32 dwt_read32bitoffsetreg(int regFileID, int regOffset) {
    (void)regFileID; (void)regOffset; return 0;
}
void   dwt_write32bitoffsetreg(int regFileID, int regOffset, uint32 regval) {
    (void)regFileID; (void)regOffset; (void)regval;
}
uint16 dwt_read16bitoffsetreg(int regFileID, int regOffset) {
    (void)regFileID; (void)regOffset; return 0;
}
void   dwt_write16bitoffsetreg(int regFileID, int regOffset, uint16 regval) {
    (void)regFileID; (void)regOffset; (void)regval;
}
uint8  dwt_read8bitoffsetreg(int regFileID, int regOffset) {
    (void)regFileID; (void)regOffset; return 0;
}
void   dwt_write8bitoffsetreg(int regFileID, int regOffset, uint8 regval) {
    (void)regFileID; (void)regOffset; (void)regval;
}
void   dwt_readfromdevice(uint16 r, uint16 i, uint32 l, uint8 *b) {
    (void)r; (void)i; (void)l; (void)b;
}
void   dwt_writetodevice(uint16 r, uint16 i, uint32 l, const uint8 *b) {
    (void)r; (void)i; (void)l; (void)b;
}
```

## src/mock_deca_driver.h
```c
/*! ----------------------------------------------------------------------------
 * @file    mock_deca_driver.h
 * @brief   Mock state for the deca_driver API functions called by
 *          dw1000_configure() (UWB-155, UWB-156 unit tests).
 *
 * Captured state is reset by mock_deca_reset() before each test.
 *
 * @attention
 * SPDX-License-Identifier: MIT
 * Copyright (c) 2024 Fundamentals UWB project contributors.
 */

#ifndef MOCK_DECA_DRIVER_H_
#define MOCK_DECA_DRIVER_H_

#include "deca_device_api.h"

/**
 * State captured from mock dwt_initialise() call.
 */
struct mock_dwt_init_state {
    int    called;          /**< Non-zero if dwt_initialise() was called. */
    uint16 config_arg;      /**< The 'config' argument (e.g. DWT_LOADUCODE). */
    int    return_value;    /**< Value that dwt_initialise() should return. */
};

/**
 * State captured from mock dwt_configure() call.
 */
struct mock_dwt_cfg_state {
    int         called;     /**< Non-zero if dwt_configure() was called. */
    dwt_config_t config;    /**< Copy of the dwt_config_t passed to dwt_configure(). */
};

/**
 * State captured from mock dwt_configuretxrf() call.
 */
struct mock_dwt_txrf_state {
    int            called;  /**< Non-zero if dwt_configuretxrf() was called. */
    dwt_txconfig_t config;  /**< Copy of the dwt_txconfig_t passed to dwt_configuretxrf(). */
};

/**
 * State captured from mock dwt_settxantennadelay() and
 * dwt_setrxantennadelay() calls (UWB-156).
 */
struct mock_dwt_antenna_state {
    int    tx_called;       /**< Number of dwt_settxantennadelay() calls. */
    uint16 tx_delay;        /**< Last value passed to dwt_settxantennadelay(). */
    int    rx_called;       /**< Number of dwt_setrxantennadelay() calls. */
    uint16 rx_delay;        /**< Last value passed to dwt_setrxantennadelay(). */
};

/**
 * Configurable OTP state for mock dwt_otpread() (UWB-156).
 *
 * antdly_word is the 32-bit value returned when dwt_otpread() is called with
 * address DW1000_OTP_ANTDLY_ADDRESS (0x1C).  Set to 0 (default) to simulate
 * an unprogrammed OTP; set bits[31:16] to a non-zero PRF-64 delay to simulate
 * a factory-calibrated device.
 */
struct mock_dwt_otp_state {
    uint32 antdly_word;     /**< OTP word returned for address 0x1C. */
};

extern struct mock_dwt_init_state    mock_init_state;
extern struct mock_dwt_cfg_state     mock_cfg_state;
extern struct mock_dwt_txrf_state    mock_txrf_state;
extern struct mock_dwt_antenna_state mock_antenna_state;
extern struct mock_dwt_otp_state     mock_otp_state;

/** Reset all captured state and set dwt_initialise return value to DWT_SUCCESS. */
void mock_deca_reset(void);

#endif /* MOCK_DECA_DRIVER_H_ */
```

## src/mock_port.c
```c
/*! ----------------------------------------------------------------------------
 * @file    mock_port.c
 * @brief   Mock implementations of port functions called by dw1000_configure()
 *          (UWB-155 unit test).
 *
 * These stubs replace deca_port.c in the unit_testing build.  They are
 * no-ops with call counters so the test can verify the expected call sequence.
 *
 * @attention
 * SPDX-License-Identifier: MIT
 * Copyright (c) 2024 Fundamentals UWB project contributors.
 */

#include <string.h>
#include "mock_port.h"

/* ---------------------------------------------------------------------------
 * Captured call state
 * --------------------------------------------------------------------------- */
struct mock_port_state mock_port_state;

void mock_port_reset(void)
{
    memset(&mock_port_state, 0, sizeof(mock_port_state));
}

/* ---------------------------------------------------------------------------
 * Port function stubs
 * --------------------------------------------------------------------------- */

void reset_DW1000(void)
{
    mock_port_state.reset_called++;
}

void port_set_dw1000_slowrate(void)
{
    mock_port_state.slowrate_called++;
}

void port_set_dw1000_fastrate(void)
{
    mock_port_state.fastrate_called++;
}

/* ---------------------------------------------------------------------------
 * deca_driver SPI/mutex stubs — required at link time by the mock driver.
 * --------------------------------------------------------------------------- */

int writetospi(uint16 headerLength, const uint8 *headerBuffer,
               uint32 bodylength, const uint8 *bodyBuffer)
{
    (void)headerLength; (void)headerBuffer;
    (void)bodylength;   (void)bodyBuffer;
    return DWT_SUCCESS;
}

int readfromspi(uint16 headerLength, const uint8 *headerBuffer,
                uint32 readlength, uint8 *readBuffer)
{
    (void)headerLength; (void)headerBuffer;
    (void)readlength;   (void)readBuffer;
    return DWT_SUCCESS;
}

decaIrqStatus_t decamutexon(void)  { return 0; }
void decamutexoff(decaIrqStatus_t s) { (void)s; }
void deca_sleep(unsigned int time_ms) { (void)time_ms; }

/* ---------------------------------------------------------------------------
 * Zephyr logging stubs.
 *
 * The unit_testing defconfig enables CONFIG_LOG=y which causes LOG_ERR() /
 * LOG_DBG() macros in dw1000_config.c to call z_log_minimal_printk() at
 * link time.  That function lives in Zephyr's log_minimal.c which is not
 * compiled in the minimal unit_testing link set.  Stub it out here — unit
 * tests do not need real log output, only assertion correctness.
 * --------------------------------------------------------------------------- */
#include <stdarg.h>

void z_log_minimal_printk(const char *fmt, ...)
{
    (void)fmt;
    /* No-op: discard log messages in unit tests. */
}
```

## src/mock_port.h
```c
/*! ----------------------------------------------------------------------------
 * @file    mock_port.h
 * @brief   Shared state for the port function mocks (UWB-155 unit test).
 *
 * @attention
 * SPDX-License-Identifier: MIT
 * Copyright (c) 2024 Fundamentals UWB project contributors.
 */

#ifndef MOCK_PORT_H_
#define MOCK_PORT_H_

#include "deca_device_api.h"

/** Call counters for port functions. */
struct mock_port_state {
    int reset_called;      /**< Number of times reset_DW1000() was called.             */
    int slowrate_called;   /**< Number of times port_set_dw1000_slowrate() was called.  */
    int fastrate_called;   /**< Number of times port_set_dw1000_fastrate() was called.  */
};

extern struct mock_port_state mock_port_state;

/** Reset call counters before each test. */
void mock_port_reset(void);

#endif /* MOCK_PORT_H_ */
```

## src/test_dw1000_config.c
```c
/*! ----------------------------------------------------------------------------
 * @file    test_dw1000_config.c
 * @brief   ztest suite: DW1000 PHY configuration (UWB-155, UWB-156)
 *
 * Platform: unit_testing (native-hosted, no Zephyr kernel, no real SPI).
 *
 * Tests in this suite verify that dw1000_configure() drives the deca_driver
 * API with the exact PHY parameter values mandated by contracts/uwb/phy_config.h
 * version 0.6 (pinned at drivers/dw1000/phy_config.h).
 *
 * UWB-156 tests (9, 10, 11) verify antenna delay hook behaviour:
 *   9. Kconfig defaults used when OTP word at 0x1C is zero (unprogrammed).
 *  10. OTP PRF-64 half (bits[31:16]) overrides Kconfig defaults when non-zero.
 *  11. dw1000_set_antenna_delay() overrides TX/RX independently at runtime.
 *
 * Mocked functions (in mock_deca_driver.c and mock_port.c):
 *   dwt_initialise()           — captures config arg (DWT_LOADUCODE vs DWT_LOADNONE)
 *   dwt_configure()            — captures full dwt_config_t struct
 *   dwt_configuretxrf()        — captures dwt_txconfig_t struct
 *   dwt_settxantennadelay()    — captures TX delay + call count (UWB-156)
 *   dwt_setrxantennadelay()    — captures RX delay + call count (UWB-156)
 *   dwt_otpread()              — returns configurable mock_otp_state (UWB-156)
 *   reset_DW1000()             — call counter
 *   port_set_dw1000_slowrate() — call counter
 *   port_set_dw1000_fastrate() — call counter
 *
 * @attention
 * SPDX-License-Identifier: MIT
 * Copyright (c) 2024 Fundamentals UWB project contributors.
 */

#include <zephyr/ztest.h>

#include "deca_device_api.h"
#include "dw1000_config.h"
#include "phy_config.h"
#include "mock_deca_driver.h"
#include "mock_port.h"

/* ---------------------------------------------------------------------------
 * Suite setup / teardown
 * --------------------------------------------------------------------------- */
static void *suite_setup(void)
{
    return NULL;
}

static void before_each(void *fixture)
{
    (void)fixture;
    mock_deca_reset();
    mock_port_reset();
}

ZTEST_SUITE(dw1000_config, NULL, suite_setup, before_each, NULL, NULL);

/* ---------------------------------------------------------------------------
 * Test 1 — dwt_initialise is called with DWT_LOADUCODE
 *
 * dw1000_configure() must load the LDE microcode (DWT_LOADUCODE = 0x1), not
 * DWT_LOADNONE (0x0).  LDE loading is required for accurate hardware RX
 * timestamps in TDoA and DS-TWR operation.
 * --------------------------------------------------------------------------- */
ZTEST(dw1000_config, test_initialise_called_with_loaducode)
{
    int ret = dw1000_configure();

    zassert_equal(ret, 0,
        "dw1000_configure() returned %d (expected 0 = success)", ret);

    zassert_equal(mock_init_state.called, 1,
        "Expected dwt_initialise() to be called exactly once; got %d",
        mock_init_state.called);

    zassert_equal(mock_init_state.config_arg, (uint16)DWT_LOADUCODE,
        "Expected dwt_initialise(DWT_LOADUCODE=0x%04X); "
        "got dwt_initialise(0x%04X)",
        (unsigned)DWT_LOADUCODE, (unsigned)mock_init_state.config_arg);
}

/* ---------------------------------------------------------------------------
 * Test 2 — dwt_configure is called with the pinned channel and PRF
 *
 * Channel 5 (UWB_PHY_CHANNEL) and PRF 64 MHz (UWB_PHY_PRF = DWT_PRF_64M).
 * --------------------------------------------------------------------------- */
ZTEST(dw1000_config, test_configure_channel_and_prf)
{
    (void)dw1000_configure();

    zassert_equal(mock_cfg_state.called, 1,
        "Expected dwt_configure() to be called exactly once; got %d",
        mock_cfg_state.called);

    zassert_equal(mock_cfg_state.config.chan, (uint8)UWB_PHY_CHANNEL,
        "chan: expected %u (UWB_PHY_CHANNEL); got %u",
        (unsigned)UWB_PHY_CHANNEL, (unsigned)mock_cfg_state.config.chan);

    zassert_equal(mock_cfg_state.config.prf, (uint8)UWB_PHY_PRF,
        "prf: expected %u (UWB_PHY_PRF = DWT_PRF_64M); got %u",
        (unsigned)UWB_PHY_PRF, (unsigned)mock_cfg_state.config.prf);
}

/* ---------------------------------------------------------------------------
 * Test 3 — dwt_configure is called with the pinned preamble length and PAC
 *
 * PLEN 64 (UWB_PHY_TX_PLEN = DWT_PLEN_64 = 0x04) and PAC 8 (UWB_PHY_PAC = 0).
 * --------------------------------------------------------------------------- */
ZTEST(dw1000_config, test_configure_plen_and_pac)
{
    (void)dw1000_configure();

    zassert_equal(mock_cfg_state.config.txPreambLength, (uint8)UWB_PHY_TX_PLEN,
        "txPreambLength: expected 0x%02X (UWB_PHY_TX_PLEN = DWT_PLEN_64); "
        "got 0x%02X",
        (unsigned)UWB_PHY_TX_PLEN, (unsigned)mock_cfg_state.config.txPreambLength);

    zassert_equal(mock_cfg_state.config.rxPAC, (uint8)UWB_PHY_PAC,
        "rxPAC: expected %u (UWB_PHY_PAC = DWT_PAC8); got %u",
        (unsigned)UWB_PHY_PAC, (unsigned)mock_cfg_state.config.rxPAC);
}

/* ---------------------------------------------------------------------------
 * Test 4 — dwt_configure is called with the pinned preamble codes and SFD
 *
 * TX code 9, RX code 9 (both UWB_PHY_TX/RX_CODE); standard SFD (nsSFD = 0).
 * --------------------------------------------------------------------------- */
ZTEST(dw1000_config, test_configure_codes_and_sfd)
{
    (void)dw1000_configure();

    zassert_equal(mock_cfg_state.config.txCode, (uint8)UWB_PHY_TX_CODE,
        "txCode: expected %u (UWB_PHY_TX_CODE); got %u",
        (unsigned)UWB_PHY_TX_CODE, (unsigned)mock_cfg_state.config.txCode);

    zassert_equal(mock_cfg_state.config.rxCode, (uint8)UWB_PHY_RX_CODE,
        "rxCode: expected %u (UWB_PHY_RX_CODE); got %u",
        (unsigned)UWB_PHY_RX_CODE, (unsigned)mock_cfg_state.config.rxCode);

    zassert_equal(mock_cfg_state.config.nsSFD, (uint8)UWB_PHY_NS_SFD,
        "nsSFD: expected %u (UWB_PHY_NS_SFD = standard); got %u",
        (unsigned)UWB_PHY_NS_SFD, (unsigned)mock_cfg_state.config.nsSFD);
}

/* ---------------------------------------------------------------------------
 * Test 5 — dwt_configure is called with the pinned data rate, PHR mode, sfdTO
 *
 * Data rate: 6.8 Mbps (UWB_PHY_DATA_RATE = DWT_BR_6M8 = 2).
 * PHR mode:  standard (UWB_PHY_PHR_MODE = DWT_PHRMODE_STD = 0).
 * sfdTO:     65 symbols (UWB_PHY_SFD_TIMEOUT = 64+1+8-8 = 65).
 * --------------------------------------------------------------------------- */
ZTEST(dw1000_config, test_configure_datarate_phrmode_sfdto)
{
    (void)dw1000_configure();

    zassert_equal(mock_cfg_state.config.dataRate, (uint8)UWB_PHY_DATA_RATE,
        "dataRate: expected %u (UWB_PHY_DATA_RATE = DWT_BR_6M8); got %u",
        (unsigned)UWB_PHY_DATA_RATE, (unsigned)mock_cfg_state.config.dataRate);

    zassert_equal(mock_cfg_state.config.phrMode, (uint8)UWB_PHY_PHR_MODE,
        "phrMode: expected %u (UWB_PHY_PHR_MODE = DWT_PHRMODE_STD); got %u",
        (unsigned)UWB_PHY_PHR_MODE, (unsigned)mock_cfg_state.config.phrMode);

    zassert_equal(mock_cfg_state.config.sfdTO, (uint16)UWB_PHY_SFD_TIMEOUT,
        "sfdTO: expected %u (UWB_PHY_SFD_TIMEOUT = 65); got %u",
        (unsigned)UWB_PHY_SFD_TIMEOUT, (unsigned)mock_cfg_state.config.sfdTO);
}

/* ---------------------------------------------------------------------------
 * Test 6 — dwt_configuretxrf is called with the pinned PG delay
 *
 * PGdly: 0xC0 (UWB_PHY_TX_PGDELAY = TC_PGDELAY_CH5).
 * --------------------------------------------------------------------------- */
ZTEST(dw1000_config, test_configuretxrf_pgdelay)
{
    (void)dw1000_configure();

    zassert_equal(mock_txrf_state.called, 1,
        "Expected dwt_configuretxrf() to be called exactly once; got %d",
        mock_txrf_state.called);

    zassert_equal(mock_txrf_state.config.PGdly, (uint8)UWB_PHY_TX_PGDELAY,
        "PGdly: expected 0x%02X (UWB_PHY_TX_PGDELAY = TC_PGDELAY_CH5); "
        "got 0x%02X",
        (unsigned)UWB_PHY_TX_PGDELAY, (unsigned)mock_txrf_state.config.PGdly);
}

/* ---------------------------------------------------------------------------
 * Test 7 — port call sequence: reset, slowrate, fastrate all called once
 *
 * dw1000_configure() must call reset_DW1000() before dwt_initialise(),
 * port_set_dw1000_slowrate() before dwt_initialise(), and
 * port_set_dw1000_fastrate() after dwt_initialise() succeeds.
 * --------------------------------------------------------------------------- */
ZTEST(dw1000_config, test_port_call_sequence)
{
    (void)dw1000_configure();

    zassert_equal(mock_port_state.reset_called, 1,
        "Expected reset_DW1000() to be called once; got %d",
        mock_port_state.reset_called);

    zassert_equal(mock_port_state.slowrate_called, 1,
        "Expected port_set_dw1000_slowrate() to be called once; got %d",
        mock_port_state.slowrate_called);

    zassert_equal(mock_port_state.fastrate_called, 1,
        "Expected port_set_dw1000_fastrate() to be called once; got %d",
        mock_port_state.fastrate_called);
}

/* ---------------------------------------------------------------------------
 * Test 8 — dw1000_configure() returns -EIO when dwt_initialise fails
 *
 * When dwt_initialise returns DWT_ERROR (SPI fault, wrong device), the
 * function must return -EIO and must NOT proceed to dwt_configure().
 * --------------------------------------------------------------------------- */
ZTEST(dw1000_config, test_init_failure_returns_eio)
{
    /* Pre-configure the mock to simulate a device-not-found error. */
    mock_init_state.return_value = DWT_ERROR;

    int ret = dw1000_configure();

    zassert_equal(ret, -EIO,
        "Expected dw1000_configure() to return -EIO on dwt_initialise failure; "
        "got %d", ret);

    /* dwt_configure must NOT be called when initialisation fails. */
    zassert_equal(mock_cfg_state.called, 0,
        "dwt_configure() must not be called when dwt_initialise fails; "
        "was called %d times", mock_cfg_state.called);
}

/* ---------------------------------------------------------------------------
 * Test 9 — Antenna delay: Kconfig defaults used when OTP is unprogrammed
 *
 * When dwt_otpread() returns 0 for the antenna-delay OTP address (0x1C),
 * dw1000_configure() must call BOTH dwt_settxantennadelay() and
 * dwt_setrxantennadelay() with the Kconfig compile-time defaults
 * (CONFIG_DW1000_ANTENNA_DELAY_TX and CONFIG_DW1000_ANTENNA_DELAY_RX).
 *
 * Acceptance criterion (a) from UWB-156.
 * --------------------------------------------------------------------------- */
ZTEST(dw1000_config, test_antenna_delay_kconfig_default_when_otp_empty)
{
    /* OTP returns 0 — the default state after mock_deca_reset(). */
    /* mock_otp_state.antdly_word is already 0 at this point. */

    int ret = dw1000_configure();

    zassert_equal(ret, 0,
        "dw1000_configure() returned %d (expected 0)", ret);

    /* TX antenna delay must be called exactly once with the Kconfig default. */
    zassert_equal(mock_antenna_state.tx_called, 1,
        "Expected dwt_settxantennadelay() to be called once; got %d",
        mock_antenna_state.tx_called);

    zassert_equal(mock_antenna_state.tx_delay,
        (uint16)CONFIG_DW1000_ANTENNA_DELAY_TX,
        "TX delay: expected Kconfig default %u; got %u",
        (unsigned)CONFIG_DW1000_ANTENNA_DELAY_TX,
        (unsigned)mock_antenna_state.tx_delay);

    /* RX antenna delay must be called exactly once with the Kconfig default. */
    zassert_equal(mock_antenna_state.rx_called, 1,
        "Expected dwt_setrxantennadelay() to be called once; got %d",
        mock_antenna_state.rx_called);

    zassert_equal(mock_antenna_state.rx_delay,
        (uint16)CONFIG_DW1000_ANTENNA_DELAY_RX,
        "RX delay: expected Kconfig default %u; got %u",
        (unsigned)CONFIG_DW1000_ANTENNA_DELAY_RX,
        (unsigned)mock_antenna_state.rx_delay);
}

/* ---------------------------------------------------------------------------
 * Test 10 — Antenna delay: OTP PRF-64 value overrides Kconfig defaults
 *
 * When the OTP word at address 0x1C has a non-zero PRF-64 half (bits[31:16]),
 * dw1000_configure() must use THAT value for both dwt_settxantennadelay() and
 * dwt_setrxantennadelay() instead of the Kconfig defaults.
 *
 * OTP word layout:
 *   bits[15:0]  — PRF 16 MHz delay (irrelevant for this config — PRF 64 in use)
 *   bits[31:16] — PRF 64 MHz delay → extracted and applied to both TX and RX
 *
 * Acceptance criterion (b) from UWB-156.
 * --------------------------------------------------------------------------- */
ZTEST(dw1000_config, test_antenna_delay_otp_overrides_kconfig)
{
    /*
     * Simulate a factory-programmed device:
     *   PRF-64 delay (bits[31:16]) = 0x4040 (16448 ticks — slightly higher
     *   than the Kconfig default 16436, chosen to be unambiguously different)
     *   PRF-16 delay (bits[15:0])  = 0x3E80 (some other value, not used)
     */
    const uint16 otp_prf64_delay = 0x4040u;
    const uint16 otp_prf16_delay = 0x3E80u;

    mock_otp_state.antdly_word = ((uint32)otp_prf64_delay << 16) |
                                 (uint32)otp_prf16_delay;

    (void)dw1000_configure();

    /* Both TX and RX must use the OTP PRF-64 half. */
    zassert_equal(mock_antenna_state.tx_delay, otp_prf64_delay,
        "TX delay: expected OTP PRF-64 value 0x%04X; got 0x%04X",
        (unsigned)otp_prf64_delay, (unsigned)mock_antenna_state.tx_delay);

    zassert_equal(mock_antenna_state.rx_delay, otp_prf64_delay,
        "RX delay: expected OTP PRF-64 value 0x%04X; got 0x%04X",
        (unsigned)otp_prf64_delay, (unsigned)mock_antenna_state.rx_delay);

    /* Confirm the Kconfig default was NOT used (guard against equal values). */
    zassert_not_equal(otp_prf64_delay, (uint16)CONFIG_DW1000_ANTENNA_DELAY_TX,
        "Test misconfigured: OTP value equals Kconfig default — "
        "choose a different OTP test value");
}

/* ---------------------------------------------------------------------------
 * Test 11 — dw1000_set_antenna_delay() overrides at runtime
 *
 * After dw1000_configure() has applied the initial delays, calling
 * dw1000_set_antenna_delay(tx, rx) must:
 *   (a) call dwt_settxantennadelay(tx) and dwt_setrxantennadelay(rx), and
 *   (b) update the cached values returned by dw1000_get_antenna_delay().
 *
 * TX and RX values are overridden independently (different values used here
 * to confirm both registers are written separately).
 *
 * Acceptance criterion (c) from UWB-156.
 * --------------------------------------------------------------------------- */
ZTEST(dw1000_config, test_set_antenna_delay_runtime_override)
{
    /* Start from a known state: configure with OTP empty → Kconfig defaults. */
    (void)dw1000_configure();

    /* Reset call counters so we can isolate the set_antenna_delay() calls. */
    mock_antenna_state.tx_called = 0;
    mock_antenna_state.rx_called = 0;

    /* Override with distinct TX and RX values. */
    const uint16_t new_tx = 0x5000u;
    const uint16_t new_rx = 0x5010u;

    dw1000_set_antenna_delay(new_tx, new_rx);

    /* dwt_settxantennadelay / dwt_setrxantennadelay called once each. */
    zassert_equal(mock_antenna_state.tx_called, 1,
        "Expected dwt_settxantennadelay() called once after set; got %d",
        mock_antenna_state.tx_called);

    zassert_equal(mock_antenna_state.tx_delay, (uint16)new_tx,
        "TX delay after override: expected 0x%04X; got 0x%04X",
        (unsigned)new_tx, (unsigned)mock_antenna_state.tx_delay);

    zassert_equal(mock_antenna_state.rx_called, 1,
        "Expected dwt_setrxantennadelay() called once after set; got %d",
        mock_antenna_state.rx_called);

    zassert_equal(mock_antenna_state.rx_delay, (uint16)new_rx,
        "RX delay after override: expected 0x%04X; got 0x%04X",
        (unsigned)new_rx, (unsigned)mock_antenna_state.rx_delay);

    /* dw1000_get_antenna_delay() must reflect the new values. */
    uint16_t get_tx = 0u;
    uint16_t get_rx = 0u;

    dw1000_get_antenna_delay(&get_tx, &get_rx);

    zassert_equal(get_tx, new_tx,
        "get_antenna_delay TX: expected 0x%04X; got 0x%04X",
        (unsigned)new_tx, (unsigned)get_tx);

    zassert_equal(get_rx, new_rx,
        "get_antenna_delay RX: expected 0x%04X; got 0x%04X",
        (unsigned)new_rx, (unsigned)get_rx);
}
```
