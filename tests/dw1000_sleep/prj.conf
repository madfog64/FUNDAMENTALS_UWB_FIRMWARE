## CMakeLists.txt
```
cmake_minimum_required(VERSION 3.20.0)

# Zephyr unit test build for the dw1000_sleep driver sleep/wake seam (UWB-316).
#
# Key differences from regular Zephyr app builds:
#   - 'project()' comes BEFORE 'find_package()'
#   - 'COMPONENTS unittest' selects the minimal, kernel-free build
#   - The build target is 'testbinary' (not 'app')
#   - No device tree, no real SPI/GPIO
#
# What is compiled:
#   dw1000_sleep.c        — the module under test (UWB-316)
#   dw1000_config.c        — dw1000_wake()'s reconfigure-on-wake dependency
#                            (UWB-155/UWB-156) — exercised here for call
#                            order/pass-through only; its own detailed PHY
#                            parameter assertions live in tests/dw1000_config/.
#   mock_deca_driver.c    — mocks dwt_initialise(), dwt_configure(),
#                           dwt_configuretxrf(), dwt_settxantennadelay(),
#                           dwt_setrxantennadelay(), dwt_otpread(),
#                           dwt_configuresleep(), dwt_entersleep()
#   mock_port.c           — mocks reset_DW1000(), port_set_dw1000_slowrate(),
#                           port_set_dw1000_fastrate(), port_wakeup_dw1000()
#   mock_seq.c            — shared call-order sequence counter
#   test_dw1000_sleep.c   — ztest assertions
#
# Note: deca_device.c and deca_params_init.c are intentionally NOT compiled
# here, same as tests/dw1000_config/ — all deca_driver API functions are
# replaced with mocks so assertions can verify argument values and call
# order directly, without SPI decoding.
#
# CONFIG_DW1000_PHY_* values are injected as target_compile_definitions below
# rather than via Kconfig, because the unit_testing platform's Kconfig root
# does not include the drivers/dw1000/Kconfig hierarchy. The values here are
# pinned to phy_config.h v0.6 (same as tests/dw1000_config/CMakeLists.txt and
# the Kconfig defaults).
#
# Platform: unit_testing  (native host executable, no emulation)
# Run:  west twister -p unit_testing -T tests/dw1000_sleep -v

project(test_dw1000_sleep)
find_package(Zephyr COMPONENTS unittest REQUIRED HINTS $ENV{ZEPHYR_BASE})

set(DW1000_DIR ${CMAKE_CURRENT_SOURCE_DIR}/../../drivers/dw1000)

target_sources(testbinary PRIVATE
    src/test_dw1000_sleep.c
    src/mock_deca_driver.c
    src/mock_port.c
    src/mock_seq.c
    ${DW1000_DIR}/dw1000_sleep.c
    ${DW1000_DIR}/dw1000_config.c
)

target_include_directories(testbinary PRIVATE
    ${DW1000_DIR}/deca_driver     # deca_device_api.h, deca_regs.h
    ${DW1000_DIR}                 # dw1000_sleep.h, dw1000_config.h, phy_config.h
    ${CMAKE_CURRENT_SOURCE_DIR}/src  # mock_deca_driver.h, mock_port.h, mock_seq.h
)

# Inject the CONFIG_DW1000_PHY_* compile-time constants that dw1000_config.c
# (dw1000_wake()'s reconfigure dependency) reads. Values match
# contracts/uwb/phy_config.h v0.6 / Kconfig defaults in drivers/dw1000/Kconfig
# — identical to tests/dw1000_config/CMakeLists.txt.
target_compile_definitions(testbinary PRIVATE
    CONFIG_DW1000=1
    CONFIG_DW1000_PHY_CHANNEL=5
    CONFIG_DW1000_PHY_PRF=2
    CONFIG_DW1000_PHY_TX_PLEN=0x04
    CONFIG_DW1000_PHY_PAC=0
    CONFIG_DW1000_PHY_TX_CODE=9
    CONFIG_DW1000_PHY_RX_CODE=9
    CONFIG_DW1000_PHY_NS_SFD=0
    CONFIG_DW1000_PHY_DATA_RATE=2
    CONFIG_DW1000_PHY_PHR_MODE=0
    CONFIG_DW1000_PHY_SFD_TIMEOUT=65
    CONFIG_DW1000_PHY_TX_PGDELAY=0xC0
    CONFIG_DW1000_PHY_TX_POWER=0x0E082848
    CONFIG_DW1000_ANTENNA_DELAY_TX=16436
    CONFIG_DW1000_ANTENNA_DELAY_RX=16436
)
```

## prj.conf
```kconfig
# tests/dw1000_sleep/prj.conf
# Minimal config for the unit_testing platform — only ztest is needed.
# CONFIG_DW1000_PHY_* values are injected as compile definitions in
# CMakeLists.txt so they do not require Kconfig symbol registration.
CONFIG_ZTEST=y
```

## src/mock_deca_driver.c
```c
/*! ----------------------------------------------------------------------------
 * @file    mock_deca_driver.c
 * @brief   Mock implementations of deca_driver API functions called by
 *          dw1000_sleep()/dw1000_wake() and the dw1000_configure()
 *          reconfigure-on-wake path (UWB-316).
 *
 * These stubs replace deca_device.c and deca_params_init.c in the
 * unit_testing build. They have no hardware or SPI dependencies — they
 * capture arguments (and a call-order sequence number, mock_seq.h) so the
 * test assertions can verify both the sleep/wake call sequence and the
 * dw1000_configure() reconfigure path it drives.
 *
 * @attention
 * SPDX-License-Identifier: MIT
 * Copyright (c) 2024 Fundamentals UWB project contributors.
 */

#include <string.h>
#include "deca_device_api.h"
#include "dw1000_config.h"
#include "mock_deca_driver.h"
#include "mock_seq.h"

/* ---------------------------------------------------------------------------
 * Captured call state (inspected by test assertions)
 * --------------------------------------------------------------------------- */
struct mock_dwt_init_state    mock_init_state;
struct mock_dwt_cfg_state     mock_cfg_state;
struct mock_dwt_txrf_state    mock_txrf_state;
struct mock_dwt_antenna_state mock_antenna_state;
struct mock_dwt_otp_state     mock_otp_state;
struct mock_dwt_sleep_state   mock_sleep_state;

void mock_deca_reset(void)
{
    memset(&mock_init_state,    0, sizeof(mock_init_state));
    memset(&mock_cfg_state,     0, sizeof(mock_cfg_state));
    memset(&mock_txrf_state,    0, sizeof(mock_txrf_state));
    memset(&mock_antenna_state, 0, sizeof(mock_antenna_state));
    memset(&mock_otp_state,     0, sizeof(mock_otp_state));
    memset(&mock_sleep_state,   0, sizeof(mock_sleep_state));
    /* Default: dwt_initialise() returns success; OTP is unprogrammed (0). */
    mock_init_state.return_value = DWT_SUCCESS;
}

/* ---------------------------------------------------------------------------
 * Mock dwt_initialise — the "device-id re-read" step of the reconfigure path.
 * --------------------------------------------------------------------------- */
int dwt_initialise(uint16 config)
{
    mock_init_state.called     = 1;
    mock_init_state.config_arg = config;
    mock_init_state.seq        = mock_seq_next();
    return mock_init_state.return_value;
}

/* ---------------------------------------------------------------------------
 * Mock dwt_configure
 * --------------------------------------------------------------------------- */
void dwt_configure(dwt_config_t *config)
{
    mock_cfg_state.called = 1;
    mock_cfg_state.seq    = mock_seq_next();
    if (config != NULL) {
        memcpy(&mock_cfg_state.config, config, sizeof(dwt_config_t));
    }
}

/* ---------------------------------------------------------------------------
 * Mock dwt_configuretxrf
 * --------------------------------------------------------------------------- */
void dwt_configuretxrf(dwt_txconfig_t *config)
{
    mock_txrf_state.called = 1;
    mock_txrf_state.seq    = mock_seq_next();
    if (config != NULL) {
        memcpy(&mock_txrf_state.config, config, sizeof(dwt_txconfig_t));
    }
}

/* ---------------------------------------------------------------------------
 * Mock dwt_settxantennadelay / dwt_setrxantennadelay
 * --------------------------------------------------------------------------- */
void dwt_settxantennadelay(uint16 txDelay)
{
    mock_antenna_state.tx_called++;
    mock_antenna_state.tx_delay = txDelay;
}

void dwt_setrxantennadelay(uint16 rxDelay)
{
    mock_antenna_state.rx_called++;
    mock_antenna_state.rx_delay = rxDelay;
}

/* ---------------------------------------------------------------------------
 * Mock dwt_otpread
 *
 * Returns mock_otp_state.antdly_word for DW1000_OTP_ANTDLY_ADDRESS; 0
 * otherwise. Default (unprogrammed OTP) keeps dw1000_configure()'s antenna
 * delay path on the Kconfig-default branch, which this suite does not assert
 * on (already covered by tests/dw1000_config/).
 * --------------------------------------------------------------------------- */
void dwt_otpread(uint32 address, uint32 *array, uint8 length)
{
    uint8 i;

    if (array == NULL || length == 0u) {
        return;
    }
    for (i = 0u; i < length; i++) {
        if (address + i == (uint32)DW1000_OTP_ANTDLY_ADDRESS) {
            array[i] = mock_otp_state.antdly_word;
        } else {
            array[i] = 0u;
        }
    }
}

/* ---------------------------------------------------------------------------
 * Mock dwt_configuresleep / dwt_entersleep (UWB-316)
 * --------------------------------------------------------------------------- */
void dwt_configuresleep(uint16 mode, uint8 wake)
{
    mock_sleep_state.configuresleep_called = 1;
    mock_sleep_state.configuresleep_mode   = mode;
    mock_sleep_state.configuresleep_wake   = wake;
    mock_sleep_state.configuresleep_seq    = mock_seq_next();
}

void dwt_entersleep(void)
{
    mock_sleep_state.entersleep_called = 1;
    mock_sleep_state.entersleep_seq    = mock_seq_next();
}

/* ---------------------------------------------------------------------------
 * Additional deca_driver stubs required at link time.
 * These functions are not exercised by this suite's assertions but may be
 * pulled in by deca_device_api.h declarations or the linker.
 * --------------------------------------------------------------------------- */

uint32 dwt_readdevid(void)         { return DWT_DEVICE_ID; }
uint32 dwt_getpartid(void)         { return 0; }
uint32 dwt_getlotid(void)          { return 0; }
uint8  dwt_otprevision(void)       { return 0; }
int    dwt_setlocaldataptr(unsigned int index) { (void)index; return DWT_SUCCESS; }
uint32 dwt_read32bitoffsetreg(int regFileID, int regOffset) {
    (void)regFileID; (void)regOffset; return 0;
}
void   dwt_write32bitoffsetreg(int regFileID, int regOffset, uint32 regval) {
    (void)regFileID; (void)regOffset; (void)regval;
}
uint16 dwt_read16bitoffsetreg(int regFileID, int regOffset) {
    (void)regFileID; (void)regOffset; return 0;
}
void   dwt_write16bitoffsetreg(int regFileID, int regOffset, uint16 regval) {
    (void)regFileID; (void)regOffset; (void)regval;
}
uint8  dwt_read8bitoffsetreg(int regFileID, int regOffset) {
    (void)regFileID; (void)regOffset; return 0;
}
void   dwt_write8bitoffsetreg(int regFileID, int regOffset, uint8 regval) {
    (void)regFileID; (void)regOffset; (void)regval;
}
void   dwt_readfromdevice(uint16 r, uint16 i, uint32 l, uint8 *b) {
    (void)r; (void)i; (void)l; (void)b;
}
void   dwt_writetodevice(uint16 r, uint16 i, uint32 l, const uint8 *b) {
    (void)r; (void)i; (void)l; (void)b;
}
```

## src/mock_deca_driver.h
```c
/*! ----------------------------------------------------------------------------
 * @file    mock_deca_driver.h
 * @brief   Mock state for the deca_driver API functions called by
 *          dw1000_sleep()/dw1000_wake() and the dw1000_configure()
 *          reconfigure-on-wake path they drive (UWB-316).
 *
 * Captured state is reset by mock_deca_reset() before each test. Each struct
 * carries a `seq` field (see mock_seq.h) stamped at call time, so tests can
 * assert call ORDER, not just call presence/count.
 *
 * @attention
 * SPDX-License-Identifier: MIT
 * Copyright (c) 2024 Fundamentals UWB project contributors.
 */

#ifndef MOCK_DECA_DRIVER_H_
#define MOCK_DECA_DRIVER_H_

#include "deca_device_api.h"

/** State captured from mock dwt_initialise() — the "device-id re-read". */
struct mock_dwt_init_state {
    int    called;
    uint16 config_arg;
    int    return_value;
    int    seq;
};

/** State captured from mock dwt_configure(). */
struct mock_dwt_cfg_state {
    int          called;
    dwt_config_t config;
    int          seq;
};

/** State captured from mock dwt_configuretxrf(). */
struct mock_dwt_txrf_state {
    int            called;
    dwt_txconfig_t config;
    int            seq;
};

/** State captured from mock dwt_settxantennadelay() / dwt_setrxantennadelay(). */
struct mock_dwt_antenna_state {
    int    tx_called;
    uint16 tx_delay;
    int    rx_called;
    uint16 rx_delay;
};

/** Configurable OTP state for mock dwt_otpread(). */
struct mock_dwt_otp_state {
    uint32 antdly_word;
};

/** State captured from mock dwt_configuresleep() / dwt_entersleep() (UWB-316). */
struct mock_dwt_sleep_state {
    int    configuresleep_called;
    uint16 configuresleep_mode;
    uint8  configuresleep_wake;
    int    configuresleep_seq;

    int    entersleep_called;
    int    entersleep_seq;
};

extern struct mock_dwt_init_state    mock_init_state;
extern struct mock_dwt_cfg_state     mock_cfg_state;
extern struct mock_dwt_txrf_state    mock_txrf_state;
extern struct mock_dwt_antenna_state mock_antenna_state;
extern struct mock_dwt_otp_state     mock_otp_state;
extern struct mock_dwt_sleep_state   mock_sleep_state;

/** Reset all captured state; dwt_initialise() defaults to returning DWT_SUCCESS. */
void mock_deca_reset(void);

#endif /* MOCK_DECA_DRIVER_H_ */
```

## src/mock_port.c
```c
/*! ----------------------------------------------------------------------------
 * @file    mock_port.c
 * @brief   Mock implementations of port functions called by dw1000_sleep() /
 *          dw1000_wake() and the dw1000_configure() path dw1000_wake()
 *          drives (UWB-316).
 *
 * These stubs replace deca_port.c in the unit_testing build. They are
 * no-ops with call counters + call-order sequence numbers (mock_seq.h) so
 * the test can verify the expected call sequence.
 *
 * @attention
 * SPDX-License-Identifier: MIT
 * Copyright (c) 2024 Fundamentals UWB project contributors.
 */

#include <string.h>
#include "mock_port.h"
#include "mock_seq.h"

/* ---------------------------------------------------------------------------
 * Captured call state
 * --------------------------------------------------------------------------- */
struct mock_port_state mock_port_state;

void mock_port_reset(void)
{
    memset(&mock_port_state, 0, sizeof(mock_port_state));
}

/* ---------------------------------------------------------------------------
 * Port function stubs
 * --------------------------------------------------------------------------- */

void reset_DW1000(void)
{
    mock_port_state.reset_called++;
    mock_port_state.reset_seq = mock_seq_next();
}

void port_set_dw1000_slowrate(void)
{
    mock_port_state.slowrate_called++;
}

void port_set_dw1000_fastrate(void)
{
    mock_port_state.fastrate_called++;
}

/**
 * @brief Mock WAKEUP pin toggle (UWB-316).
 *
 * The real implementation (deca_port.c) drives a GPIO and busy-waits/sleeps;
 * this mock only records that it was called and where in the call sequence,
 * so the test can assert the WAKEUP toggle happens before the
 * reconfigure-on-wake sequence (dwt_initialise/dwt_configure).
 */
void port_wakeup_dw1000(void)
{
    mock_port_state.wakeup_called++;
    mock_port_state.wakeup_seq = mock_seq_next();
}

/* ---------------------------------------------------------------------------
 * deca_driver SPI/mutex stubs — required at link time by the mock driver.
 * --------------------------------------------------------------------------- */

int writetospi(uint16 headerLength, const uint8 *headerBuffer,
               uint32 bodylength, const uint8 *bodyBuffer)
{
    (void)headerLength; (void)headerBuffer;
    (void)bodylength;   (void)bodyBuffer;
    return DWT_SUCCESS;
}

int readfromspi(uint16 headerLength, const uint8 *headerBuffer,
                uint32 readlength, uint8 *readBuffer)
{
    (void)headerLength; (void)headerBuffer;
    (void)readlength;   (void)readBuffer;
    return DWT_SUCCESS;
}

decaIrqStatus_t decamutexon(void)  { return 0; }
void decamutexoff(decaIrqStatus_t s) { (void)s; }
void deca_sleep(unsigned int time_ms) { (void)time_ms; }

/* ---------------------------------------------------------------------------
 * Zephyr logging stubs.
 *
 * The unit_testing defconfig enables CONFIG_LOG=y which causes LOG_ERR() /
 * LOG_DBG() macros in dw1000_config.c / dw1000_sleep.c to call
 * z_log_minimal_printk() at link time. That function lives in Zephyr's
 * log_minimal.c which is not compiled in the minimal unit_testing link set.
 * Stub it out here — unit tests do not need real log output, only assertion
 * correctness.
 * --------------------------------------------------------------------------- */
#include <stdarg.h>

void z_log_minimal_printk(const char *fmt, ...)
{
    (void)fmt;
    /* No-op: discard log messages in unit tests. */
}
```

## src/mock_port.h
```c
/*! ----------------------------------------------------------------------------
 * @file    mock_port.h
 * @brief   Shared state for the port function mocks (UWB-316 ztest suite).
 *
 * @attention
 * SPDX-License-Identifier: MIT
 * Copyright (c) 2024 Fundamentals UWB project contributors.
 */

#ifndef MOCK_PORT_H_
#define MOCK_PORT_H_

#include "deca_device_api.h"

/** Call counters + call-order sequence numbers for port functions. */
struct mock_port_state {
    int reset_called;
    int reset_seq;

    int slowrate_called;
    int fastrate_called;

    /** port_wakeup_dw1000() — the WAKEUP pin toggle (UWB-316). */
    int wakeup_called;
    int wakeup_seq;
};

extern struct mock_port_state mock_port_state;

/** Reset call counters before each test. */
void mock_port_reset(void);

#endif /* MOCK_PORT_H_ */
```

## src/mock_seq.c
```c
/*! ----------------------------------------------------------------------------
 * @file    mock_seq.c
 * @brief   Shared call-order sequence counter (UWB-316 ztest suite).
 *
 * @attention
 * SPDX-License-Identifier: MIT
 * Copyright (c) 2024 Fundamentals UWB project contributors.
 */

#include "mock_seq.h"

int mock_seq_counter;

void mock_seq_reset(void)
{
    mock_seq_counter = 0;
}

int mock_seq_next(void)
{
    return mock_seq_counter++;
}
```

## src/mock_seq.h
```c
/*! ----------------------------------------------------------------------------
 * @file    mock_seq.h
 * @brief   Shared call-order sequence counter for the dw1000_sleep ztest
 *          suite (UWB-316).
 *
 * mock_deca_driver.c and mock_port.c are separate compilation units that
 * both need to stamp captured calls with a monotonically increasing sequence
 * number, so the test assertions can verify call ORDER (e.g. "WAKEUP toggle
 * happens before dwt_initialise()") and not just call presence/count.
 *
 * @attention
 * SPDX-License-Identifier: MIT
 * Copyright (c) 2024 Fundamentals UWB project contributors.
 */

#ifndef MOCK_SEQ_H_
#define MOCK_SEQ_H_

/** Monotonically increasing counter; mock_seq_next() returns then increments. */
extern int mock_seq_counter;

/** Reset the counter to 0. Call before each test (mock_seq_reset()). */
void mock_seq_reset(void);

/** Return the next sequence number (0, 1, 2, ...). */
int mock_seq_next(void);

#endif /* MOCK_SEQ_H_ */
```

## src/test_dw1000_sleep.c
```c
/*! ----------------------------------------------------------------------------
 * @file    test_dw1000_sleep.c
 * @brief   ztest suite: DW1000 driver sleep/wake seam (UWB-316)
 *
 * Platform: unit_testing (native-hosted, no Zephyr kernel, no real SPI/GPIO).
 *
 * Verifies dw1000_sleep()/dw1000_wake() drive the deca_driver + port mocks
 * with the correct arguments and call ORDER — this is the mechanism the
 * STANDBY state machine (UWB-319) will drive, so the call sequence contract
 * is the thing worth locking down here.
 *
 * Mocked functions (mock_deca_driver.c, mock_port.c):
 *   dwt_configuresleep()       — captures mode/wake args + call-order seq
 *   dwt_entersleep()           — captures call-order seq
 *   port_wakeup_dw1000()       — captures call-order seq (WAKEUP pin toggle)
 *   dwt_initialise()           — captures config arg + call-order seq
 *                                 (this is dw1000_configure()'s "device-id
 *                                 re-read" step)
 *   dwt_configure()            — captures call-order seq
 *   reset_DW1000(), port_set_dw1000_slowrate/fastrate(), dwt_configuretxrf(),
 *   dwt_settxantennadelay/dwt_setrxantennadelay(), dwt_otpread() — the rest
 *   of dw1000_configure()'s reconfigure-on-wake path (already covered in
 *   detail by tests/dw1000_config/; only touched here for call-order and
 *   pass/fail propagation).
 *
 * @attention
 * SPDX-License-Identifier: MIT
 * Copyright (c) 2024 Fundamentals UWB project contributors.
 */

#include <zephyr/ztest.h>

#include "deca_device_api.h"
#include "dw1000_config.h"
#include "dw1000_sleep.h"
#include "mock_deca_driver.h"
#include "mock_port.h"
#include "mock_seq.h"

/* ---------------------------------------------------------------------------
 * Suite setup / teardown
 * --------------------------------------------------------------------------- */
static void *suite_setup(void)
{
    return NULL;
}

static void before_each(void *fixture)
{
    (void)fixture;
    mock_deca_reset();
    mock_port_reset();
    mock_seq_reset();
}

ZTEST_SUITE(dw1000_sleep, NULL, suite_setup, before_each, NULL, NULL);

/* ---------------------------------------------------------------------------
 * Test 1 — dw1000_sleep() calls dwt_configuresleep() then dwt_entersleep()
 *
 * Both must be called exactly once, and dwt_configuresleep() must be called
 * BEFORE dwt_entersleep() (deca_device_api.h contract: "dwt_configuresleep()
 * should be called first").
 * --------------------------------------------------------------------------- */
ZTEST(dw1000_sleep, test_sleep_calls_configuresleep_then_entersleep)
{
    dw1000_sleep_result_t ret = dw1000_sleep();

    zassert_equal(ret, DW1000_SLEEP_OK,
        "dw1000_sleep() returned %d (expected DW1000_SLEEP_OK)", ret);

    zassert_equal(mock_sleep_state.configuresleep_called, 1,
        "Expected dwt_configuresleep() to be called exactly once; got %d",
        mock_sleep_state.configuresleep_called);

    zassert_equal(mock_sleep_state.entersleep_called, 1,
        "Expected dwt_entersleep() to be called exactly once; got %d",
        mock_sleep_state.entersleep_called);

    zassert_true(mock_sleep_state.configuresleep_seq < mock_sleep_state.entersleep_seq,
        "Expected dwt_configuresleep() (seq=%d) to be called before "
        "dwt_entersleep() (seq=%d)",
        mock_sleep_state.configuresleep_seq, mock_sleep_state.entersleep_seq);
}

/* ---------------------------------------------------------------------------
 * Test 2 — dw1000_sleep() programs the DEEPSLEEP wake trigger correctly
 *
 * mode must request the AON-preserved config to be reloaded on wake
 * (DWT_PRESRV_SLEEP | DWT_CONFIG); wake must enable sleep and request the
 * WAKEUP-pin trigger (DWT_SLP_EN | DWT_WAKE_WK), the mechanism UWB-316 wires.
 * --------------------------------------------------------------------------- */
ZTEST(dw1000_sleep, test_sleep_configures_wake_on_wakeup_pin)
{
    (void)dw1000_sleep();

    zassert_true((mock_sleep_state.configuresleep_mode & DWT_CONFIG) != 0,
        "Expected dwt_configuresleep() mode to include DWT_CONFIG (reload "
        "AON config on wake); got 0x%04X",
        (unsigned)mock_sleep_state.configuresleep_mode);

    zassert_true((mock_sleep_state.configuresleep_mode & DWT_PRESRV_SLEEP) != 0,
        "Expected dwt_configuresleep() mode to include DWT_PRESRV_SLEEP; "
        "got 0x%04X", (unsigned)mock_sleep_state.configuresleep_mode);

    zassert_true((mock_sleep_state.configuresleep_wake & DWT_WAKE_WK) != 0,
        "Expected dwt_configuresleep() wake to include DWT_WAKE_WK (WAKEUP "
        "pin trigger); got 0x%02X",
        (unsigned)mock_sleep_state.configuresleep_wake);

    zassert_true((mock_sleep_state.configuresleep_wake & DWT_SLP_EN) != 0,
        "Expected dwt_configuresleep() wake to include DWT_SLP_EN (sleep "
        "functionality enabled); got 0x%02X",
        (unsigned)mock_sleep_state.configuresleep_wake);
}

/* ---------------------------------------------------------------------------
 * Test 3 — dw1000_wake() toggles WAKEUP, then reconfigures
 *
 * Full order: port_wakeup_dw1000() < reset_DW1000() < dwt_initialise()
 * < dwt_configure() — the WAKEUP toggle must happen before ANY part of the
 * dw1000_configure() reconfigure-on-wake path, and dwt_initialise() (the
 * device-id re-read) must happen before dwt_configure().
 * --------------------------------------------------------------------------- */
ZTEST(dw1000_sleep, test_wake_toggles_wakeup_before_reconfigure)
{
    dw1000_sleep_result_t ret = dw1000_wake();

    zassert_equal(ret, DW1000_SLEEP_OK,
        "dw1000_wake() returned %d (expected DW1000_SLEEP_OK)", ret);

    zassert_equal(mock_port_state.wakeup_called, 1,
        "Expected port_wakeup_dw1000() to be called exactly once; got %d",
        mock_port_state.wakeup_called);

    zassert_equal(mock_init_state.called, 1,
        "Expected dwt_initialise() (device-id re-read) to be called exactly "
        "once; got %d", mock_init_state.called);

    zassert_equal(mock_cfg_state.called, 1,
        "Expected dwt_configure() to be called exactly once; got %d",
        mock_cfg_state.called);

    zassert_true(mock_port_state.wakeup_seq < mock_port_state.reset_seq,
        "Expected port_wakeup_dw1000() (seq=%d) before reset_DW1000() "
        "(seq=%d)", mock_port_state.wakeup_seq, mock_port_state.reset_seq);

    zassert_true(mock_port_state.reset_seq < mock_init_state.seq,
        "Expected reset_DW1000() (seq=%d) before dwt_initialise() (seq=%d)",
        mock_port_state.reset_seq, mock_init_state.seq);

    zassert_true(mock_init_state.seq < mock_cfg_state.seq,
        "Expected dwt_initialise() (seq=%d) before dwt_configure() (seq=%d)",
        mock_init_state.seq, mock_cfg_state.seq);
}

/* ---------------------------------------------------------------------------
 * Test 4 — dw1000_wake() reconfigures with DWT_LOADUCODE
 *
 * The reconfigure-on-wake path must load the LDE microcode, exactly like a
 * fresh dw1000_configure() bring-up (UWB-155) — deep sleep does not preserve
 * the LDE state.
 * --------------------------------------------------------------------------- */
ZTEST(dw1000_sleep, test_wake_reconfigure_uses_loaducode)
{
    (void)dw1000_wake();

    zassert_equal(mock_init_state.config_arg, (uint16)DWT_LOADUCODE,
        "Expected dwt_initialise(DWT_LOADUCODE=0x%04X) during wake "
        "reconfigure; got dwt_initialise(0x%04X)",
        (unsigned)DWT_LOADUCODE, (unsigned)mock_init_state.config_arg);
}

/* ---------------------------------------------------------------------------
 * Test 5 — dw1000_wake() propagates a reconfigure failure
 *
 * If dwt_initialise() fails after the WAKEUP pulse (device did not actually
 * wake / SPI fault), dw1000_wake() must report
 * DW1000_SLEEP_ERR_WAKE_RECONFIGURE — the caller must not proceed to treat
 * the radio as usable.
 * --------------------------------------------------------------------------- */
ZTEST(dw1000_sleep, test_wake_reports_reconfigure_failure)
{
    mock_init_state.return_value = DWT_ERROR;

    dw1000_sleep_result_t ret = dw1000_wake();

    zassert_equal(ret, DW1000_SLEEP_ERR_WAKE_RECONFIGURE,
        "Expected DW1000_SLEEP_ERR_WAKE_RECONFIGURE when dwt_initialise() "
        "fails during wake reconfigure; got %d", ret);

    /* The WAKEUP pulse must still have happened before the failure. */
    zassert_equal(mock_port_state.wakeup_called, 1,
        "Expected port_wakeup_dw1000() to still be called once even though "
        "the reconfigure ultimately failed; got %d",
        mock_port_state.wakeup_called);

    /* dwt_configure() must NOT be reached — dw1000_configure() bails out on
     * dwt_initialise() failure before that step (same contract as UWB-155). */
    zassert_equal(mock_cfg_state.called, 0,
        "dwt_configure() must not be called when the wake reconfigure's "
        "dwt_initialise() fails; was called %d times",
        mock_cfg_state.called);
}

/* ---------------------------------------------------------------------------
 * Test 6 — full sleep -> wake round trip
 *
 * Exercises the seam end-to-end: sleep, then wake, confirming both halves
 * report success independently and the wake path still runs to completion
 * after a prior sleep call (no leftover mock/module state trips it up).
 * --------------------------------------------------------------------------- */
ZTEST(dw1000_sleep, test_sleep_then_wake_round_trip)
{
    dw1000_sleep_result_t sleep_ret = dw1000_sleep();
    dw1000_sleep_result_t wake_ret  = dw1000_wake();

    zassert_equal(sleep_ret, DW1000_SLEEP_OK,
        "dw1000_sleep() returned %d (expected DW1000_SLEEP_OK)", sleep_ret);
    zassert_equal(wake_ret, DW1000_SLEEP_OK,
        "dw1000_wake() returned %d (expected DW1000_SLEEP_OK)", wake_ret);

    zassert_equal(mock_sleep_state.entersleep_called, 1,
        "Expected dwt_entersleep() called once across the round trip; got %d",
        mock_sleep_state.entersleep_called);
    zassert_equal(mock_port_state.wakeup_called, 1,
        "Expected port_wakeup_dw1000() called once across the round trip; "
        "got %d", mock_port_state.wakeup_called);

    /* The whole sleep call must precede the whole wake call. */
    zassert_true(mock_sleep_state.entersleep_seq < mock_port_state.wakeup_seq,
        "Expected dwt_entersleep() (seq=%d) before port_wakeup_dw1000() "
        "(seq=%d)", mock_sleep_state.entersleep_seq, mock_port_state.wakeup_seq);
}
```
