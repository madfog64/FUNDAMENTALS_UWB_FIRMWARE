## CMakeLists.txt
```
cmake_minimum_required(VERSION 3.20.0)

# Zephyr unit test build for the dw1000_ranging module (UWB-231).
#
# Mirrors tests/dw1000_config's unit_testing pattern: a mocked deca_driver so
# assertions can inspect the exact register/API arguments dw1000_ranging.c
# drives, without any real SPI/hardware.
#
# What is compiled:
#   dw1000_ranging.c        — the module under test (UWB-231)
#   mock_deca_driver.c      — mocks dwt_setrxtimeout(), dwt_rxenable(),
#                             dwt_forcetrxoff(), dwt_read32bitoffsetreg(),
#                             dwt_write32bitoffsetreg(), dwt_readrxdata(),
#                             dwt_readrxtimestamp(), dwt_readtxtimestamp(),
#                             dwt_setdelayedtrxtime(), dwt_writetxdata(),
#                             dwt_writetxfctrl(), dwt_starttx()
#   mock_log.c              — stubs z_log_minimal_printk() (same rationale and
#                             pattern as tests/dw1000_config/src/mock_port.c):
#                             the unit_testing defconfig enables CONFIG_LOG=y,
#                             so dw1000_ranging.c's LOG_ERR()/LOG_DBG() calls
#                             need this symbol at link time.
#   test_dw1000_ranging.c   — ztest assertions
#
# Note: deca_device.c is intentionally NOT compiled here (same rationale as
# tests/dw1000_config): the mock replaces every deca_driver API function
# dw1000_ranging.c calls, so assertions can verify argument values directly
# without SPI decoding.
#
# Platform: unit_testing  (native host executable, no emulation)
# Run:  west twister -p unit_testing -T tests/dw1000_ranging -v

project(test_dw1000_ranging)
find_package(Zephyr COMPONENTS unittest REQUIRED HINTS $ENV{ZEPHYR_BASE})

set(DW1000_DIR ${CMAKE_CURRENT_SOURCE_DIR}/../../drivers/dw1000)

target_sources(testbinary PRIVATE
    src/test_dw1000_ranging.c
    src/mock_deca_driver.c
    src/mock_log.c
    ${DW1000_DIR}/dw1000_ranging.c
)

target_include_directories(testbinary PRIVATE
    ${DW1000_DIR}/deca_driver        # deca_device_api.h, deca_regs.h
    ${DW1000_DIR}                    # dw1000_ranging.h
    ${CMAKE_CURRENT_SOURCE_DIR}/src  # mock_deca_driver.h
)
```

## prj.conf
```kconfig
# tests/dw1000_ranging/prj.conf
# Minimal config for the unit_testing platform — only ztest is needed.
CONFIG_ZTEST=y
```

## src/mock_deca_driver.c
```c
/*! ----------------------------------------------------------------------------
 * @file    mock_deca_driver.c
 * @brief   Mock implementations of deca_driver API functions called by
 *          dw1000_ranging.c (UWB-231 unit tests).
 *
 * These stubs have no hardware or SPI dependencies. Register reads
 * (dwt_read32bitoffsetreg, via the dwt_read32bitreg() macro) return the
 * test-configured mock_reg_state.sys_status / mock_reg_state.rx_finfo values
 * depending on the requested register file ID (SYS_STATUS_ID / RX_FINFO_ID).
 * Register writes are captured, and additionally applied as a bit-clear
 * against mock_reg_state.sys_status when regFileID == SYS_STATUS_ID, mirroring
 * the DW1000's write-1-to-clear semantics for that register — this keeps a
 * test's pre-configured status word self-consistent if a test inspects it
 * again after the call under test returns.
 *
 * @attention
 * SPDX-License-Identifier: MIT
 * Copyright (c) 2024 Fundamentals UWB project contributors.
 */

#include <string.h>

#include "deca_device_api.h"
#include "deca_regs.h"
#include "mock_deca_driver.h"

/* ---------------------------------------------------------------------------
 * Captured / configurable state (inspected and pre-configured by tests)
 * --------------------------------------------------------------------------- */
struct mock_rxtimeout_state       mock_rxtimeout_state;
struct mock_rxenable_state        mock_rxenable_state;
struct mock_forcetrxoff_state     mock_forcetrxoff_state;
struct mock_reg_state             mock_reg_state;
struct mock_readrxdata_state      mock_readrxdata_state;
struct mock_timestamp_state       mock_timestamp_state;
struct mock_delayedtrxtime_state  mock_delayedtrxtime_state;
struct mock_tx_state              mock_tx_state;
struct mock_starttx_state         mock_starttx_state;

void mock_deca_reset(void)
{
    memset(&mock_rxtimeout_state,      0, sizeof(mock_rxtimeout_state));
    memset(&mock_rxenable_state,       0, sizeof(mock_rxenable_state));
    memset(&mock_forcetrxoff_state,    0, sizeof(mock_forcetrxoff_state));
    memset(&mock_reg_state,            0, sizeof(mock_reg_state));
    memset(&mock_readrxdata_state,     0, sizeof(mock_readrxdata_state));
    memset(&mock_timestamp_state,      0, sizeof(mock_timestamp_state));
    memset(&mock_delayedtrxtime_state, 0, sizeof(mock_delayedtrxtime_state));
    memset(&mock_tx_state,             0, sizeof(mock_tx_state));
    memset(&mock_starttx_state,        0, sizeof(mock_starttx_state));

    /* Defaults: every deca_driver call that can fail reports success. */
    mock_rxenable_state.return_value      = DWT_SUCCESS;
    mock_tx_state.writetxdata_return_value = DWT_SUCCESS;
    mock_starttx_state.return_value        = DWT_SUCCESS;
}

/* ---------------------------------------------------------------------------
 * Mock dwt_setrxtimeout
 * --------------------------------------------------------------------------- */
void dwt_setrxtimeout(uint16 time)
{
    mock_rxtimeout_state.called = 1;
    mock_rxtimeout_state.time   = time;
}

/* ---------------------------------------------------------------------------
 * Mock dwt_rxenable
 * --------------------------------------------------------------------------- */
int dwt_rxenable(int mode)
{
    mock_rxenable_state.called = 1;
    mock_rxenable_state.mode   = mode;
    return mock_rxenable_state.return_value;
}

/* ---------------------------------------------------------------------------
 * Mock dwt_forcetrxoff
 * --------------------------------------------------------------------------- */
void dwt_forcetrxoff(void)
{
    mock_forcetrxoff_state.called++;
}

/* ---------------------------------------------------------------------------
 * Mock dwt_read32bitoffsetreg (backs the dwt_read32bitreg() macro)
 *
 * Returns mock_reg_state.sys_status for SYS_STATUS_ID, mock_reg_state.rx_finfo
 * for RX_FINFO_ID, and 0 for anything else.
 * --------------------------------------------------------------------------- */
uint32 dwt_read32bitoffsetreg(int regFileID, int regOffset)
{
    (void)regOffset;

    if (regFileID == SYS_STATUS_ID) {
        return mock_reg_state.sys_status;
    }
    if (regFileID == RX_FINFO_ID) {
        return mock_reg_state.rx_finfo;
    }
    return 0u;
}

/* ---------------------------------------------------------------------------
 * Mock dwt_write32bitoffsetreg (backs the dwt_write32bitreg() macro)
 *
 * Captures the last register/value written. When writing SYS_STATUS_ID,
 * clears the written bits from mock_reg_state.sys_status (write-1-to-clear,
 * matching real DW1000 SYS_STATUS semantics).
 * --------------------------------------------------------------------------- */
void dwt_write32bitoffsetreg(int regFileID, int regOffset, uint32 regval)
{
    (void)regOffset;

    mock_reg_state.last_write_reg = (uint32)regFileID;
    mock_reg_state.last_write_val = regval;
    mock_reg_state.write_count++;

    if (regFileID == SYS_STATUS_ID) {
        mock_reg_state.sys_status &= ~regval;
    }
}

/* ---------------------------------------------------------------------------
 * Mock dwt_readrxdata
 *
 * Captures length/offset and copies the test-injected payload bytes into the
 * caller's buffer.
 * --------------------------------------------------------------------------- */
void dwt_readrxdata(uint8 *buffer, uint16 length, uint16 rxBufferOffset)
{
    uint16 copy_len = length;

    mock_readrxdata_state.called = 1;
    mock_readrxdata_state.length = length;
    mock_readrxdata_state.offset = rxBufferOffset;

    if (copy_len > MOCK_MAX_FRAME_LEN) {
        copy_len = MOCK_MAX_FRAME_LEN;
    }
    if (buffer != NULL) {
        memcpy(buffer, mock_readrxdata_state.injected_payload, copy_len);
    }
}

/* ---------------------------------------------------------------------------
 * Mock dwt_readrxtimestamp / dwt_readtxtimestamp
 * --------------------------------------------------------------------------- */
void dwt_readrxtimestamp(uint8 *timestamp)
{
    mock_timestamp_state.rx_called++;
    if (timestamp != NULL) {
        memcpy(timestamp, mock_timestamp_state.rx_ts_bytes, 5);
    }
}

void dwt_readtxtimestamp(uint8 *timestamp)
{
    mock_timestamp_state.tx_called++;
    if (timestamp != NULL) {
        memcpy(timestamp, mock_timestamp_state.tx_ts_bytes, 5);
    }
}

/* ---------------------------------------------------------------------------
 * Mock dwt_setdelayedtrxtime
 * --------------------------------------------------------------------------- */
void dwt_setdelayedtrxtime(uint32 starttime)
{
    mock_delayedtrxtime_state.called    = 1;
    mock_delayedtrxtime_state.starttime = starttime;
}

/* ---------------------------------------------------------------------------
 * Mock dwt_writetxdata
 * --------------------------------------------------------------------------- */
int dwt_writetxdata(uint16 txFrameLength, uint8 *txFrameBytes, uint16 txBufferOffset)
{
    uint16 copy_len = txFrameLength;

    mock_tx_state.writetxdata_called = 1;
    mock_tx_state.writetxdata_len    = txFrameLength;
    mock_tx_state.writetxdata_offset = txBufferOffset;

    if (copy_len > MOCK_MAX_FRAME_LEN) {
        copy_len = MOCK_MAX_FRAME_LEN;
    }
    if (txFrameBytes != NULL) {
        memcpy(mock_tx_state.writetxdata_buf, txFrameBytes, copy_len);
    }

    return mock_tx_state.writetxdata_return_value;
}

/* ---------------------------------------------------------------------------
 * Mock dwt_writetxfctrl
 * --------------------------------------------------------------------------- */
void dwt_writetxfctrl(uint16 txFrameLength, uint16 txBufferOffset, int ranging)
{
    mock_tx_state.writetxfctrl_called  = 1;
    mock_tx_state.writetxfctrl_len     = txFrameLength;
    mock_tx_state.writetxfctrl_offset  = txBufferOffset;
    mock_tx_state.writetxfctrl_ranging = ranging;
}

/* ---------------------------------------------------------------------------
 * Mock dwt_starttx
 * --------------------------------------------------------------------------- */
int dwt_starttx(uint8 mode)
{
    mock_starttx_state.called = 1;
    mock_starttx_state.mode   = mode;
    return mock_starttx_state.return_value;
}
```

## src/mock_deca_driver.h
```c
/*! ----------------------------------------------------------------------------
 * @file    mock_deca_driver.h
 * @brief   Mock state for the deca_driver API functions called by
 *          dw1000_ranging.c (UWB-231 unit tests).
 *
 * Captured/configurable state is reset by mock_deca_reset() before each test.
 * Tests pre-configure the register-read state (mock_reg_state, injected
 * timestamp/payload bytes) before calling the function under test, then
 * assert on the captured call arguments.
 *
 * @attention
 * SPDX-License-Identifier: MIT
 * Copyright (c) 2024 Fundamentals UWB project contributors.
 */

#ifndef MOCK_DECA_DRIVER_H_
#define MOCK_DECA_DRIVER_H_

#include "deca_device_api.h"

/** Size of the scratch buffers used to capture RX/TX payload bytes. */
#define MOCK_MAX_FRAME_LEN  128

/**
 * State captured from mock dwt_setrxtimeout() call.
 */
struct mock_rxtimeout_state {
    int    called;   /**< Non-zero if dwt_setrxtimeout() was called. */
    uint16 time;     /**< The 'time' argument passed (DW1000 RX_FWTO units). */
};

/**
 * State captured from mock dwt_rxenable() call, and its configurable
 * return value.
 */
struct mock_rxenable_state {
    int called;         /**< Non-zero if dwt_rxenable() was called. */
    int mode;            /**< The 'mode' argument passed. */
    int return_value;   /**< Value dwt_rxenable() should return (default DWT_SUCCESS). */
};

/**
 * Call counter for mock dwt_forcetrxoff().
 */
struct mock_forcetrxoff_state {
    int called;
};

/**
 * Configurable register-read values and captured register writes, used for
 * both dw1000_rx()'s and dw1000_tx_at()'s SYS_STATUS/RX_FINFO polling.
 *
 * Set sys_status / rx_finfo BEFORE calling the function under test to drive
 * a specific scenario (good frame / RX error / RX timeout / TXFRS / HPDWARN).
 */
struct mock_reg_state {
    uint32 sys_status;       /**< Value returned for dwt_read32bitreg(SYS_STATUS_ID). */
    uint32 rx_finfo;          /**< Value returned for dwt_read32bitreg(RX_FINFO_ID). */
    uint32 last_write_reg;    /**< Last regFileID written via dwt_write32bit{,offset}reg. */
    uint32 last_write_val;    /**< Last value written. */
    int    write_count;       /**< Number of register writes captured. */
};

/**
 * Captured dwt_readrxdata() call arguments, plus the payload bytes the mock
 * copies into the caller's buffer (set injected_payload before the call).
 */
struct mock_readrxdata_state {
    int    called;
    uint16 length;
    uint16 offset;
    uint8  injected_payload[MOCK_MAX_FRAME_LEN];
};

/**
 * Injected 5-byte RX/TX timestamp buffers returned by
 * dwt_readrxtimestamp() / dwt_readtxtimestamp(), plus call counters.
 */
struct mock_timestamp_state {
    uint8 rx_ts_bytes[5];
    uint8 tx_ts_bytes[5];
    int   rx_called;
    int   tx_called;
};

/**
 * State captured from mock dwt_setdelayedtrxtime() call.
 */
struct mock_delayedtrxtime_state {
    int    called;
    uint32 starttime;
};

/**
 * State captured from mock dwt_writetxdata() and dwt_writetxfctrl() calls,
 * and dwt_writetxdata()'s configurable return value.
 */
struct mock_tx_state {
    int    writetxdata_called;
    uint16 writetxdata_len;
    uint8  writetxdata_buf[MOCK_MAX_FRAME_LEN];
    uint16 writetxdata_offset;
    int    writetxdata_return_value;

    int    writetxfctrl_called;
    uint16 writetxfctrl_len;
    uint16 writetxfctrl_offset;
    int    writetxfctrl_ranging;
};

/**
 * State captured from mock dwt_starttx() call, and its configurable return
 * value (set to DWT_ERROR to simulate a missed/HPDWARN slot).
 */
struct mock_starttx_state {
    int    called;
    uint8  mode;
    int    return_value;
};

extern struct mock_rxtimeout_state       mock_rxtimeout_state;
extern struct mock_rxenable_state        mock_rxenable_state;
extern struct mock_forcetrxoff_state     mock_forcetrxoff_state;
extern struct mock_reg_state             mock_reg_state;
extern struct mock_readrxdata_state      mock_readrxdata_state;
extern struct mock_timestamp_state       mock_timestamp_state;
extern struct mock_delayedtrxtime_state  mock_delayedtrxtime_state;
extern struct mock_tx_state              mock_tx_state;
extern struct mock_starttx_state         mock_starttx_state;

/** Reset all captured/configurable state to defaults (all-success, all-zero). */
void mock_deca_reset(void);

#endif /* MOCK_DECA_DRIVER_H_ */
```

## src/mock_log.c
```c
/*! ----------------------------------------------------------------------------
 * @file    mock_log.c
 * @brief   Zephyr minimal-log stub for the dw1000_ranging unit test (UWB-231).
 *
 * Mirrors tests/dw1000_config/src/mock_port.c: the unit_testing defconfig
 * enables CONFIG_LOG=y, which causes the LOG_ERR() / LOG_DBG() macros in
 * dw1000_ranging.c to call z_log_minimal_printk() at link time. That function
 * lives in Zephyr's log_minimal.c, which is not compiled in the minimal
 * unit_testing link set. Stub it out here — unit tests do not need real log
 * output, only assertion correctness.
 *
 * @attention
 * SPDX-License-Identifier: MIT
 * Copyright (c) 2024 Fundamentals UWB project contributors.
 */

#include <stdarg.h>

void z_log_minimal_printk(const char *fmt, ...)
{
    (void)fmt;
    /* No-op: discard log messages in unit tests. */
}
```

## src/test_dw1000_ranging.c
```c
/*! ----------------------------------------------------------------------------
 * @file    test_dw1000_ranging.c
 * @brief   ztest suite: DW1000 ranging radio primitives (UWB-231)
 *
 * Platform: unit_testing (native-hosted, no Zephyr kernel, no real SPI).
 *
 * Covers:
 *   dw1000_tx_at()             delayed-time programming, frame write, mode
 *                               bits (plain vs DWT_RESPONSE_EXPECTED), and
 *                               the HPDWARN (missed slot) error path.
 *   dw1000_rx()                good-frame / RX-error / RX-timeout paths,
 *                               and the oversized-frame guard.
 *   dw1000_read_rx_timestamp() /
 *   dw1000_read_tx_timestamp() little-endian 40-bit assembly.
 *   dw1000_delayed_tx_time()   low-9-bit truncation, including 40-bit
 *                               wraparound.
 *
 * @attention
 * SPDX-License-Identifier: MIT
 * Copyright (c) 2024 Fundamentals UWB project contributors.
 */

#include <string.h>

#include <zephyr/ztest.h>

#include "deca_device_api.h"
#include "deca_regs.h"
#include "dw1000_ranging.h"
#include "mock_deca_driver.h"

/* ---------------------------------------------------------------------------
 * Suite setup / teardown
 * --------------------------------------------------------------------------- */
static void before_each(void *fixture)
{
    (void)fixture;
    mock_deca_reset();
}

ZTEST_SUITE(dw1000_ranging, NULL, NULL, before_each, NULL, NULL);

/* =============================================================================
 * dw1000_tx_at()
 * ========================================================================= */

/* ---------------------------------------------------------------------------
 * Test — delayed time is programmed, frame is written, plain delayed mode
 *
 * dwt_setdelayedtrxtime() must receive the HIGH 32 bits of tx_time_dtu
 * (tx_time_dtu >> 8). dwt_writetxdata()/dwt_writetxfctrl() must receive the
 * exact frame bytes/length, with the ranging bit set. dwt_starttx() must be
 * called with DWT_START_TX_DELAYED only (no DWT_RESPONSE_EXPECTED) when
 * expect_response is false.
 * --------------------------------------------------------------------------- */
ZTEST(dw1000_ranging, test_tx_at_programs_delayed_time_and_frame)
{
    const uint8_t frame[] = {0xDE, 0xAD, 0xBE, 0xEF};
    const uint64_t tx_time_dtu = 0x0123456789ULL;

    /* Let the post-starttx TXFRS poll succeed immediately. */
    mock_reg_state.sys_status = SYS_STATUS_TXFRS;

    int ret = dw1000_tx_at(frame, sizeof(frame), tx_time_dtu, false);

    zassert_equal(ret, 0, "dw1000_tx_at() returned %d (expected 0)", ret);

    zassert_equal(mock_delayedtrxtime_state.called, 1,
        "Expected dwt_setdelayedtrxtime() called once; got %d",
        mock_delayedtrxtime_state.called);
    zassert_equal(mock_delayedtrxtime_state.starttime,
        (uint32)(tx_time_dtu >> 8),
        "dwt_setdelayedtrxtime(): expected high 32 bits 0x%08X; got 0x%08X",
        (unsigned)(tx_time_dtu >> 8), (unsigned)mock_delayedtrxtime_state.starttime);

    zassert_equal(mock_tx_state.writetxdata_called, 1,
        "Expected dwt_writetxdata() called once; got %d",
        mock_tx_state.writetxdata_called);
    zassert_equal(mock_tx_state.writetxdata_len, (uint16)sizeof(frame),
        "writetxdata length: expected %u; got %u",
        (unsigned)sizeof(frame), (unsigned)mock_tx_state.writetxdata_len);
    zassert_equal(mock_tx_state.writetxdata_offset, 0,
        "writetxdata offset: expected 0; got %u",
        (unsigned)mock_tx_state.writetxdata_offset);
    zassert_mem_equal(mock_tx_state.writetxdata_buf, frame, sizeof(frame),
        "writetxdata: frame bytes do not match");

    zassert_equal(mock_tx_state.writetxfctrl_called, 1,
        "Expected dwt_writetxfctrl() called once; got %d",
        mock_tx_state.writetxfctrl_called);
    zassert_equal(mock_tx_state.writetxfctrl_len, (uint16)sizeof(frame),
        "writetxfctrl length: expected %u; got %u",
        (unsigned)sizeof(frame), (unsigned)mock_tx_state.writetxfctrl_len);
    zassert_equal(mock_tx_state.writetxfctrl_ranging, 1,
        "writetxfctrl: expected ranging=1; got %d",
        mock_tx_state.writetxfctrl_ranging);

    zassert_equal(mock_starttx_state.called, 1,
        "Expected dwt_starttx() called once; got %d", mock_starttx_state.called);
    zassert_equal(mock_starttx_state.mode, (uint8)DWT_START_TX_DELAYED,
        "dwt_starttx() mode: expected DWT_START_TX_DELAYED (0x%02X) only; "
        "got 0x%02X",
        (unsigned)DWT_START_TX_DELAYED, (unsigned)mock_starttx_state.mode);
}

/* ---------------------------------------------------------------------------
 * Test — expect_response=true also sets DWT_RESPONSE_EXPECTED
 * --------------------------------------------------------------------------- */
ZTEST(dw1000_ranging, test_tx_at_expect_response_sets_response_bit)
{
    const uint8_t frame[] = {0x01, 0x02};

    mock_reg_state.sys_status = SYS_STATUS_TXFRS;

    int ret = dw1000_tx_at(frame, sizeof(frame), 0x1000ULL, true);

    zassert_equal(ret, 0, "dw1000_tx_at() returned %d (expected 0)", ret);

    const uint8_t expected_mode =
        (uint8_t)(DWT_START_TX_DELAYED | DWT_RESPONSE_EXPECTED);

    zassert_equal(mock_starttx_state.mode, expected_mode,
        "dwt_starttx() mode: expected DELAYED|RESPONSE_EXPECTED (0x%02X); "
        "got 0x%02X", (unsigned)expected_mode, (unsigned)mock_starttx_state.mode);
}

/* ---------------------------------------------------------------------------
 * Test — a missed slot (HPDWARN) surfaces as -EIO
 *
 * When dwt_starttx() returns DWT_ERROR (the DW1000 latched HPDWARN because
 * the scheduled time had already passed), dw1000_tx_at() must return -EIO
 * and must NOT wait on TXFRS (no transmission occurred).
 * --------------------------------------------------------------------------- */
ZTEST(dw1000_ranging, test_tx_at_hpdwarn_returns_eio)
{
    const uint8_t frame[] = {0xAA};

    mock_starttx_state.return_value = DWT_ERROR;
    /* Deliberately leave sys_status without TXFRS set -- if dw1000_tx_at()
     * incorrectly proceeded to the TXFRS wait loop after an error, this test
     * would hang, which twister will report as a timeout/failure. */

    int ret = dw1000_tx_at(frame, sizeof(frame), 0x1000ULL, false);

    zassert_equal(ret, -EIO,
        "Expected dw1000_tx_at() to return -EIO on HPDWARN; got %d", ret);
    zassert_equal(mock_starttx_state.called, 1,
        "Expected dwt_starttx() to be called once; got %d",
        mock_starttx_state.called);
    zassert_equal(mock_forcetrxoff_state.called, 1,
        "Expected dwt_forcetrxoff() called once on HPDWARN; got %d",
        mock_forcetrxoff_state.called);
}

/* ---------------------------------------------------------------------------
 * Test — NULL buffer / zero length rejected before touching the driver
 * --------------------------------------------------------------------------- */
ZTEST(dw1000_ranging, test_tx_at_rejects_null_buf_and_zero_len)
{
    const uint8_t frame[] = {0xAA};

    zassert_equal(dw1000_tx_at(NULL, 1, 0x1000ULL, false), -EINVAL,
        "Expected -EINVAL for NULL buf");
    zassert_equal(dw1000_tx_at(frame, 0, 0x1000ULL, false), -EINVAL,
        "Expected -EINVAL for zero len");
    zassert_equal(mock_delayedtrxtime_state.called, 0,
        "dwt_setdelayedtrxtime() must not be called on an invalid argument");
}

/* =============================================================================
 * dw1000_rx()
 * ========================================================================= */

/* ---------------------------------------------------------------------------
 * Test — a good frame returns the injected bytes and assembled RX timestamp
 * --------------------------------------------------------------------------- */
ZTEST(dw1000_ranging, test_rx_good_frame_returns_bytes_and_timestamp)
{
    const uint8_t injected[] = {0x10, 0x11, 0x12, 0x13, 0x14};
    uint8_t buf[32] = {0};
    uint16_t len = sizeof(buf);
    uint64_t rx_ts = 0;

    mock_reg_state.sys_status = SYS_STATUS_RXFCG;
    mock_reg_state.rx_finfo   = (uint32)sizeof(injected);
    memcpy(mock_readrxdata_state.injected_payload, injected, sizeof(injected));

    /* rx_ts bytes little-endian: byte[0] = LSB ... byte[4] = MSB. */
    mock_timestamp_state.rx_ts_bytes[0] = 0x11;
    mock_timestamp_state.rx_ts_bytes[1] = 0x22;
    mock_timestamp_state.rx_ts_bytes[2] = 0x33;
    mock_timestamp_state.rx_ts_bytes[3] = 0x44;
    mock_timestamp_state.rx_ts_bytes[4] = 0x05;
    const uint64_t expected_rx_ts = 0x0544332211ULL;

    int ret = dw1000_rx(buf, &len, &rx_ts, 1000);

    zassert_equal(ret, 0, "dw1000_rx() returned %d (expected 0)", ret);
    zassert_equal(len, (uint16_t)sizeof(injected),
        "len: expected %u; got %u", (unsigned)sizeof(injected), (unsigned)len);
    zassert_mem_equal(buf, injected, sizeof(injected),
        "dw1000_rx(): received payload does not match injected bytes");
    zassert_equal(rx_ts, expected_rx_ts,
        "rx_ts: expected 0x%010llX; got 0x%010llX",
        (unsigned long long)expected_rx_ts, (unsigned long long)rx_ts);

    zassert_equal(mock_rxtimeout_state.called, 1,
        "Expected dwt_setrxtimeout() called once; got %d",
        mock_rxtimeout_state.called);
    zassert_equal(mock_rxenable_state.called, 1,
        "Expected dwt_rxenable() called once; got %d",
        mock_rxenable_state.called);
    zassert_equal(mock_rxenable_state.mode, DWT_START_RX_IMMEDIATE,
        "dwt_rxenable() mode: expected DWT_START_RX_IMMEDIATE (%d); got %d",
        DWT_START_RX_IMMEDIATE, mock_rxenable_state.mode);

    zassert_equal(mock_readrxdata_state.called, 1,
        "Expected dwt_readrxdata() called once; got %d",
        mock_readrxdata_state.called);
    zassert_equal(mock_readrxdata_state.length, (uint16)sizeof(injected),
        "dwt_readrxdata() length: expected %u; got %u",
        (unsigned)sizeof(injected), (unsigned)mock_readrxdata_state.length);
    zassert_equal(mock_readrxdata_state.offset, 0,
        "dwt_readrxdata() offset: expected 0; got %u",
        (unsigned)mock_readrxdata_state.offset);
}

/* ---------------------------------------------------------------------------
 * Test — an RX timeout event (SYS_STATUS_ALL_RX_TO) returns -ETIMEDOUT
 * --------------------------------------------------------------------------- */
ZTEST(dw1000_ranging, test_rx_timeout_returns_etimedout)
{
    uint8_t buf[16];
    uint16_t len = sizeof(buf);
    uint64_t rx_ts = 0;

    /* SYS_STATUS_RXRFTO (Receive Frame Wait Timeout) is part of
     * SYS_STATUS_ALL_RX_TO. */
    mock_reg_state.sys_status = SYS_STATUS_RXRFTO;

    int ret = dw1000_rx(buf, &len, &rx_ts, 1000);

    zassert_equal(ret, -ETIMEDOUT,
        "Expected -ETIMEDOUT on RX timeout; got %d", ret);
    zassert_equal(len, 0, "len must be reset to 0 on error; got %u", (unsigned)len);
    zassert_equal(mock_forcetrxoff_state.called, 1,
        "Expected dwt_forcetrxoff() called once on timeout; got %d",
        mock_forcetrxoff_state.called);
}

/* ---------------------------------------------------------------------------
 * Test — an RX error event (SYS_STATUS_ALL_RX_ERR) returns -EIO
 * --------------------------------------------------------------------------- */
ZTEST(dw1000_ranging, test_rx_error_returns_eio)
{
    uint8_t buf[16];
    uint16_t len = sizeof(buf);
    uint64_t rx_ts = 0;

    /* SYS_STATUS_RXFCE (Receiver FCS Error) is part of SYS_STATUS_ALL_RX_ERR. */
    mock_reg_state.sys_status = SYS_STATUS_RXFCE;

    int ret = dw1000_rx(buf, &len, &rx_ts, 1000);

    zassert_equal(ret, -EIO, "Expected -EIO on RX error; got %d", ret);
    zassert_equal(len, 0, "len must be reset to 0 on error; got %u", (unsigned)len);
    zassert_equal(mock_forcetrxoff_state.called, 1,
        "Expected dwt_forcetrxoff() called once on RX error; got %d",
        mock_forcetrxoff_state.called);
}

/* ---------------------------------------------------------------------------
 * Test — a frame larger than the caller's buffer capacity is rejected
 * --------------------------------------------------------------------------- */
ZTEST(dw1000_ranging, test_rx_frame_too_large_returns_einval)
{
    uint8_t buf[8];
    uint16_t len = sizeof(buf); /* capacity = 8 */
    uint64_t rx_ts = 0;

    mock_reg_state.sys_status = SYS_STATUS_RXFCG;
    mock_reg_state.rx_finfo   = 50u; /* frame claims 50 bytes -- exceeds capacity */

    int ret = dw1000_rx(buf, &len, &rx_ts, 1000);

    zassert_equal(ret, -EINVAL,
        "Expected -EINVAL when frame length exceeds buffer capacity; got %d", ret);
    zassert_equal(mock_readrxdata_state.called, 0,
        "dwt_readrxdata() must not be called when the frame doesn't fit");
    zassert_equal(mock_forcetrxoff_state.called, 1,
        "Expected dwt_forcetrxoff() called once on oversize-frame guard; got %d",
        mock_forcetrxoff_state.called);
}

/* ---------------------------------------------------------------------------
 * Test — NULL arguments rejected up front
 * --------------------------------------------------------------------------- */
ZTEST(dw1000_ranging, test_rx_rejects_null_args)
{
    uint8_t buf[8];
    uint16_t len = sizeof(buf);
    uint64_t rx_ts = 0;

    zassert_equal(dw1000_rx(NULL, &len, &rx_ts, 1000), -EINVAL, "NULL buf");
    zassert_equal(dw1000_rx(buf, NULL, &rx_ts, 1000), -EINVAL, "NULL len");
    zassert_equal(dw1000_rx(buf, &len, NULL, 1000), -EINVAL, "NULL rx_ts");
    zassert_equal(mock_rxenable_state.called, 0,
        "dwt_rxenable() must not be called on an invalid argument");
}

/* =============================================================================
 * 40-bit timestamp helpers
 * ========================================================================= */

ZTEST(dw1000_ranging, test_read_rx_timestamp_assembles_little_endian)
{
    mock_timestamp_state.rx_ts_bytes[0] = 0x01;
    mock_timestamp_state.rx_ts_bytes[1] = 0x02;
    mock_timestamp_state.rx_ts_bytes[2] = 0x03;
    mock_timestamp_state.rx_ts_bytes[3] = 0x04;
    mock_timestamp_state.rx_ts_bytes[4] = 0x05;

    uint64_t ts = dw1000_read_rx_timestamp();

    zassert_equal(ts, 0x0504030201ULL,
        "Expected 0x0504030201 (little-endian assembly); got 0x%010llX",
        (unsigned long long)ts);
    zassert_equal(mock_timestamp_state.rx_called, 1,
        "Expected dwt_readrxtimestamp() called once; got %d",
        mock_timestamp_state.rx_called);
}

ZTEST(dw1000_ranging, test_read_tx_timestamp_assembles_little_endian)
{
    mock_timestamp_state.tx_ts_bytes[0] = 0xAA;
    mock_timestamp_state.tx_ts_bytes[1] = 0xBB;
    mock_timestamp_state.tx_ts_bytes[2] = 0xCC;
    mock_timestamp_state.tx_ts_bytes[3] = 0xDD;
    mock_timestamp_state.tx_ts_bytes[4] = 0x0E;

    uint64_t ts = dw1000_read_tx_timestamp();

    zassert_equal(ts, 0x0EDDCCBBAAULL,
        "Expected 0x0EDDCCBBAA (little-endian assembly); got 0x%010llX",
        (unsigned long long)ts);
    zassert_equal(mock_timestamp_state.tx_called, 1,
        "Expected dwt_readtxtimestamp() called once; got %d",
        mock_timestamp_state.tx_called);
}

/* =============================================================================
 * dw1000_delayed_tx_time() -- low-9-bit truncation golden values
 * ========================================================================= */

ZTEST(dw1000_ranging, test_delayed_tx_time_truncates_low_9_bits)
{
    /* 0 + 0x2FF (767) = 767 -> masked to the nearest lower multiple of 512
     * (2^9): 767 & ~0x1FF = 0x200 (512). */
    zassert_equal(dw1000_delayed_tx_time(0, 0x2FFu), 0x200ULL,
        "anchor=0 delay=0x2FF: expected 0x200");

    /* 100 + 1000 = 1100 -> 1100 & ~0x1FF = 1024 (0x400). */
    zassert_equal(dw1000_delayed_tx_time(100, 1000u), 0x400ULL,
        "anchor=100 delay=1000: expected 0x400");

    /* Exact multiple of 512 is left unchanged. */
    zassert_equal(dw1000_delayed_tx_time(0, 1024u), 1024ULL,
        "anchor=0 delay=1024 (exact multiple of 512): expected unchanged");
}

ZTEST(dw1000_ranging, test_delayed_tx_time_wraps_at_40_bits)
{
    /* anchor_ts = 2^40 - 100; + delay 200 wraps to 100 (mod 2^40), which is
     * then truncated to the nearest lower multiple of 512: 100 & ~0x1FF = 0. */
    const uint64_t anchor_ts = (((uint64_t)1u) << 40) - 100u;

    zassert_equal(dw1000_delayed_tx_time(anchor_ts, 200u), 0ULL,
        "40-bit wraparound: anchor=2^40-100 delay=200 -> raw=100 -> expected 0");
}
```
