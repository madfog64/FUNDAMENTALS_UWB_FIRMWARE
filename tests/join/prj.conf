## CMakeLists.txt
```
cmake_minimum_required(VERSION 3.20.0)

# Zephyr unit test build for the tag-side Aloha join state machine (UWB-261).
#
# Mirrors tests/tracking's unit_testing pattern: a mocked deca_driver so
# assertions can inspect the exact register/API arguments the composed
# dw1000_sync_rx() (GATE phase), dw1000_rx() (AWAIT phase), and dw1000_tx_at()
# (REQUEST phase) calls drive, without any real SPI/hardware. A single
# uwb_join_step() call drives AT MOST one RX-family call OR one TX call (see
# uwb_join.h), so the simple single-shot mock state from tests/tracking/ /
# tests/dw1000_sync/ suffices -- no RX queueing is needed.
#
# What is compiled:
#   uwb_join.c              — the module under test (UWB-261)
#   uwb_join_codec.c         — Aloha join frame build/parse codec (UWB-259),
#                              reused (not reimplemented)
#   dw1000_sync.c            — tag-side SYNC RX + validate/parse (UWB-242),
#                              reused for the GATE phase
#   dw1000_ranging.c         — dw1000_rx() / dw1000_tx_at() / delayed-TX time
#                              helpers (UWB-231), reused (not reimplemented)
#   mock_deca_driver.c       — mocks the deca_driver API surface dw1000_rx()
#                              and dw1000_tx_at() call (copied verbatim from
#                              tests/tracking/)
#   mock_log.c               — stubs z_log_minimal_printk() (same rationale
#                              and pattern as tests/tracking/src/mock_log.c)
#   test_join.c               — ztest assertions
#
# Note: uwb_join.c has NO Kconfig dependency of its own (every tunable --
# gate/await/backoff cycles, timeouts, tx_margin_dtu -- is caller-injected via
# uwb_join_config_t, not read from CONFIG_* symbols), and it does not compile
# uwb_cycle_ref.c (the GATE phase only needs dw1000_sync_rx(), not the
# maintained cycle reference) -- so no Kconfig injection is needed here,
# unlike tests/tracking's CONFIG_UWB_SYNC_MAX_MISSED injection.
#
# Platform: unit_testing  (native host executable, no emulation)
# Run:  west twister -p unit_testing -T tests/join -v

project(test_join)
find_package(Zephyr COMPONENTS unittest REQUIRED HINTS $ENV{ZEPHYR_BASE})

set(DW1000_DIR ${CMAKE_CURRENT_SOURCE_DIR}/../../drivers/dw1000)

target_sources(testbinary PRIVATE
    src/test_join.c
    src/mock_deca_driver.c
    src/mock_log.c
    ${DW1000_DIR}/uwb_join.c
    ${DW1000_DIR}/uwb_join_codec.c
    ${DW1000_DIR}/dw1000_sync.c
    ${DW1000_DIR}/dw1000_ranging.c
)

target_include_directories(testbinary PRIVATE
    ${DW1000_DIR}/deca_driver        # deca_device_api.h, deca_regs.h
    ${DW1000_DIR}                    # uwb_join.h, uwb_join_codec.h, dw1000_sync.h, etc.
    ${CMAKE_CURRENT_SOURCE_DIR}/src  # mock_deca_driver.h
)
```

## prj.conf
```kconfig
# tests/join/prj.conf
# Minimal config for the unit_testing platform — only ztest is needed.
CONFIG_ZTEST=y
```

## src/mock_deca_driver.c
```c
/*! ----------------------------------------------------------------------------
 * @file    mock_deca_driver.c
 * @brief   Mock implementations of deca_driver API functions called by
 *          dw1000_ranging.c (dw1000_rx() + dw1000_tx_at(), driven here by
 *          uwb_join.c's per-phase gate/request/await steps -- UWB-261 unit
 *          tests). Copied verbatim from tests/tracking/ (UWB-252) /
 *          tests/dw1000_sync/ (UWB-242) / tests/dw1000_ranging/ (UWB-231).
 *
 * These stubs have no hardware or SPI dependencies. Register reads
 * (dwt_read32bitoffsetreg, via the dwt_read32bitreg() macro) return the
 * test-configured mock_reg_state.sys_status / mock_reg_state.rx_finfo values
 * depending on the requested register file ID (SYS_STATUS_ID / RX_FINFO_ID).
 * Register writes are captured, and additionally applied as a bit-clear
 * against mock_reg_state.sys_status when regFileID == SYS_STATUS_ID, mirroring
 * the DW1000's write-1-to-clear semantics for that register — this keeps a
 * test's pre-configured status word self-consistent if a test inspects it
 * again after the call under test returns.
 *
 * @attention
 * SPDX-License-Identifier: MIT
 * Copyright (c) 2024 Fundamentals UWB project contributors.
 */

#include <string.h>

#include "deca_device_api.h"
#include "deca_regs.h"
#include "mock_deca_driver.h"

/* ---------------------------------------------------------------------------
 * Captured / configurable state (inspected and pre-configured by tests)
 * --------------------------------------------------------------------------- */
struct mock_rxtimeout_state       mock_rxtimeout_state;
struct mock_rxenable_state        mock_rxenable_state;
struct mock_forcetrxoff_state     mock_forcetrxoff_state;
struct mock_reg_state             mock_reg_state;
struct mock_readrxdata_state      mock_readrxdata_state;
struct mock_timestamp_state       mock_timestamp_state;
struct mock_delayedtrxtime_state  mock_delayedtrxtime_state;
struct mock_tx_state              mock_tx_state;
struct mock_starttx_state         mock_starttx_state;

void mock_deca_reset(void)
{
    memset(&mock_rxtimeout_state,      0, sizeof(mock_rxtimeout_state));
    memset(&mock_rxenable_state,       0, sizeof(mock_rxenable_state));
    memset(&mock_forcetrxoff_state,    0, sizeof(mock_forcetrxoff_state));
    memset(&mock_reg_state,            0, sizeof(mock_reg_state));
    memset(&mock_readrxdata_state,     0, sizeof(mock_readrxdata_state));
    memset(&mock_timestamp_state,      0, sizeof(mock_timestamp_state));
    memset(&mock_delayedtrxtime_state, 0, sizeof(mock_delayedtrxtime_state));
    memset(&mock_tx_state,             0, sizeof(mock_tx_state));
    memset(&mock_starttx_state,        0, sizeof(mock_starttx_state));

    /* Defaults: every deca_driver call that can fail reports success. */
    mock_rxenable_state.return_value      = DWT_SUCCESS;
    mock_tx_state.writetxdata_return_value = DWT_SUCCESS;
    mock_starttx_state.return_value        = DWT_SUCCESS;
}

/* ---------------------------------------------------------------------------
 * Mock dwt_setrxtimeout
 * --------------------------------------------------------------------------- */
void dwt_setrxtimeout(uint16 time)
{
    mock_rxtimeout_state.called = 1;
    mock_rxtimeout_state.time   = time;
}

/* ---------------------------------------------------------------------------
 * Mock dwt_rxenable
 * --------------------------------------------------------------------------- */
int dwt_rxenable(int mode)
{
    mock_rxenable_state.called = 1;
    mock_rxenable_state.mode   = mode;
    return mock_rxenable_state.return_value;
}

/* ---------------------------------------------------------------------------
 * Mock dwt_forcetrxoff
 * --------------------------------------------------------------------------- */
void dwt_forcetrxoff(void)
{
    mock_forcetrxoff_state.called++;
}

/* ---------------------------------------------------------------------------
 * Mock dwt_read32bitoffsetreg (backs the dwt_read32bitreg() macro)
 *
 * Returns mock_reg_state.sys_status for SYS_STATUS_ID, mock_reg_state.rx_finfo
 * for RX_FINFO_ID, and 0 for anything else.
 * --------------------------------------------------------------------------- */
uint32 dwt_read32bitoffsetreg(int regFileID, int regOffset)
{
    (void)regOffset;

    if (regFileID == SYS_STATUS_ID) {
        return mock_reg_state.sys_status;
    }
    if (regFileID == RX_FINFO_ID) {
        return mock_reg_state.rx_finfo;
    }
    return 0u;
}

/* ---------------------------------------------------------------------------
 * Mock dwt_write32bitoffsetreg (backs the dwt_write32bitreg() macro)
 *
 * Captures the last register/value written. When writing SYS_STATUS_ID,
 * clears the written bits from mock_reg_state.sys_status (write-1-to-clear,
 * matching real DW1000 SYS_STATUS semantics).
 * --------------------------------------------------------------------------- */
void dwt_write32bitoffsetreg(int regFileID, int regOffset, uint32 regval)
{
    (void)regOffset;

    mock_reg_state.last_write_reg = (uint32)regFileID;
    mock_reg_state.last_write_val = regval;
    mock_reg_state.write_count++;

    if (regFileID == SYS_STATUS_ID) {
        mock_reg_state.sys_status &= ~regval;
    }
}

/* ---------------------------------------------------------------------------
 * Mock dwt_readrxdata
 *
 * Captures length/offset and copies the test-injected payload bytes into the
 * caller's buffer.
 * --------------------------------------------------------------------------- */
void dwt_readrxdata(uint8 *buffer, uint16 length, uint16 rxBufferOffset)
{
    uint16 copy_len = length;

    mock_readrxdata_state.called = 1;
    mock_readrxdata_state.length = length;
    mock_readrxdata_state.offset = rxBufferOffset;

    if (copy_len > MOCK_MAX_FRAME_LEN) {
        copy_len = MOCK_MAX_FRAME_LEN;
    }
    if (buffer != NULL) {
        memcpy(buffer, mock_readrxdata_state.injected_payload, copy_len);
    }
}

/* ---------------------------------------------------------------------------
 * Mock dwt_readrxtimestamp / dwt_readtxtimestamp
 * --------------------------------------------------------------------------- */
void dwt_readrxtimestamp(uint8 *timestamp)
{
    mock_timestamp_state.rx_called++;
    if (timestamp != NULL) {
        memcpy(timestamp, mock_timestamp_state.rx_ts_bytes, 5);
    }
}

void dwt_readtxtimestamp(uint8 *timestamp)
{
    mock_timestamp_state.tx_called++;
    if (timestamp != NULL) {
        memcpy(timestamp, mock_timestamp_state.tx_ts_bytes, 5);
    }
}

/* ---------------------------------------------------------------------------
 * Mock dwt_setdelayedtrxtime
 * --------------------------------------------------------------------------- */
void dwt_setdelayedtrxtime(uint32 starttime)
{
    mock_delayedtrxtime_state.called    = 1;
    mock_delayedtrxtime_state.starttime = starttime;
}

/* ---------------------------------------------------------------------------
 * Mock dwt_writetxdata
 * --------------------------------------------------------------------------- */
int dwt_writetxdata(uint16 txFrameLength, uint8 *txFrameBytes, uint16 txBufferOffset)
{
    uint16 copy_len = txFrameLength;

    mock_tx_state.writetxdata_called = 1;
    mock_tx_state.writetxdata_len    = txFrameLength;
    mock_tx_state.writetxdata_offset = txBufferOffset;

    if (copy_len > MOCK_MAX_FRAME_LEN) {
        copy_len = MOCK_MAX_FRAME_LEN;
    }
    if (txFrameBytes != NULL) {
        memcpy(mock_tx_state.writetxdata_buf, txFrameBytes, copy_len);
    }

    return mock_tx_state.writetxdata_return_value;
}

/* ---------------------------------------------------------------------------
 * Mock dwt_writetxfctrl
 * --------------------------------------------------------------------------- */
void dwt_writetxfctrl(uint16 txFrameLength, uint16 txBufferOffset, int ranging)
{
    mock_tx_state.writetxfctrl_called  = 1;
    mock_tx_state.writetxfctrl_len     = txFrameLength;
    mock_tx_state.writetxfctrl_offset  = txBufferOffset;
    mock_tx_state.writetxfctrl_ranging = ranging;
}

/* ---------------------------------------------------------------------------
 * Mock dwt_starttx
 * --------------------------------------------------------------------------- */
int dwt_starttx(uint8 mode)
{
    mock_starttx_state.called = 1;
    mock_starttx_state.mode   = mode;
    return mock_starttx_state.return_value;
}
```

## src/mock_deca_driver.h
```c
/*! ----------------------------------------------------------------------------
 * @file    mock_deca_driver.h
 * @brief   Mock state for the deca_driver API functions called by
 *          dw1000_ranging.c (dw1000_rx() + dw1000_tx_at(), driven here by
 *          uwb_join.c's per-phase gate/request/await steps -- UWB-261 unit
 *          tests). Copied verbatim from tests/tracking/ (UWB-252), which
 *          itself copied it from tests/dw1000_sync/ (UWB-242) /
 *          tests/dw1000_ranging/ (UWB-231) -- a single uwb_join_step() call
 *          drives AT MOST one dw1000_rx()-family call (via dw1000_sync_rx()
 *          in the GATE phase, or directly in the AWAIT phase) OR one
 *          dw1000_tx_at() call (in the REQUEST phase) -- never both in the
 *          same call -- so no RX-queueing beyond this suite's simple
 *          single-shot mock state is needed (contrast tests/twr_responder/,
 *          which needs an RX queue because one twr_responder_run_once() call
 *          drives dw1000_rx() twice).
 *
 * Captured/configurable state is reset by mock_deca_reset() before each test.
 * Tests pre-configure the register-read state (mock_reg_state, injected
 * timestamp/payload bytes) before calling the function under test, then
 * assert on the captured call arguments.
 *
 * @attention
 * SPDX-License-Identifier: MIT
 * Copyright (c) 2024 Fundamentals UWB project contributors.
 */

#ifndef MOCK_DECA_DRIVER_H_
#define MOCK_DECA_DRIVER_H_

#include "deca_device_api.h"

/** Size of the scratch buffers used to capture RX/TX payload bytes. */
#define MOCK_MAX_FRAME_LEN  128

/**
 * State captured from mock dwt_setrxtimeout() call.
 */
struct mock_rxtimeout_state {
    int    called;   /**< Non-zero if dwt_setrxtimeout() was called. */
    uint16 time;     /**< The 'time' argument passed (DW1000 RX_FWTO units). */
};

/**
 * State captured from mock dwt_rxenable() call, and its configurable
 * return value.
 */
struct mock_rxenable_state {
    int called;         /**< Non-zero if dwt_rxenable() was called. */
    int mode;            /**< The 'mode' argument passed. */
    int return_value;   /**< Value dwt_rxenable() should return (default DWT_SUCCESS). */
};

/**
 * Call counter for mock dwt_forcetrxoff().
 */
struct mock_forcetrxoff_state {
    int called;
};

/**
 * Configurable register-read values and captured register writes, used for
 * both dw1000_rx()'s and dw1000_tx_at()'s SYS_STATUS/RX_FINFO polling.
 *
 * Set sys_status / rx_finfo BEFORE calling the function under test to drive
 * a specific scenario (good frame / RX error / RX timeout / TXFRS / HPDWARN).
 */
struct mock_reg_state {
    uint32 sys_status;       /**< Value returned for dwt_read32bitreg(SYS_STATUS_ID). */
    uint32 rx_finfo;          /**< Value returned for dwt_read32bitreg(RX_FINFO_ID). */
    uint32 last_write_reg;    /**< Last regFileID written via dwt_write32bit{,offset}reg. */
    uint32 last_write_val;    /**< Last value written. */
    int    write_count;       /**< Number of register writes captured. */
};

/**
 * Captured dwt_readrxdata() call arguments, plus the payload bytes the mock
 * copies into the caller's buffer (set injected_payload before the call).
 */
struct mock_readrxdata_state {
    int    called;
    uint16 length;
    uint16 offset;
    uint8  injected_payload[MOCK_MAX_FRAME_LEN];
};

/**
 * Injected 5-byte RX/TX timestamp buffers returned by
 * dwt_readrxtimestamp() / dwt_readtxtimestamp(), plus call counters.
 */
struct mock_timestamp_state {
    uint8 rx_ts_bytes[5];
    uint8 tx_ts_bytes[5];
    int   rx_called;
    int   tx_called;
};

/**
 * State captured from mock dwt_setdelayedtrxtime() call.
 */
struct mock_delayedtrxtime_state {
    int    called;
    uint32 starttime;
};

/**
 * State captured from mock dwt_writetxdata() and dwt_writetxfctrl() calls,
 * and dwt_writetxdata()'s configurable return value.
 */
struct mock_tx_state {
    int    writetxdata_called;
    uint16 writetxdata_len;
    uint8  writetxdata_buf[MOCK_MAX_FRAME_LEN];
    uint16 writetxdata_offset;
    int    writetxdata_return_value;

    int    writetxfctrl_called;
    uint16 writetxfctrl_len;
    uint16 writetxfctrl_offset;
    int    writetxfctrl_ranging;
};

/**
 * State captured from mock dwt_starttx() call, and its configurable return
 * value (set to DWT_ERROR to simulate a missed/HPDWARN slot).
 */
struct mock_starttx_state {
    int    called;
    uint8  mode;
    int    return_value;
};

extern struct mock_rxtimeout_state       mock_rxtimeout_state;
extern struct mock_rxenable_state        mock_rxenable_state;
extern struct mock_forcetrxoff_state     mock_forcetrxoff_state;
extern struct mock_reg_state             mock_reg_state;
extern struct mock_readrxdata_state      mock_readrxdata_state;
extern struct mock_timestamp_state       mock_timestamp_state;
extern struct mock_delayedtrxtime_state  mock_delayedtrxtime_state;
extern struct mock_tx_state              mock_tx_state;
extern struct mock_starttx_state         mock_starttx_state;

/** Reset all captured/configurable state to defaults (all-success, all-zero). */
void mock_deca_reset(void);

#endif /* MOCK_DECA_DRIVER_H_ */
```

## src/mock_log.c
```c
/*! ----------------------------------------------------------------------------
 * @file    mock_log.c
 * @brief   Zephyr minimal-log stub for the uwb_join unit test (UWB-261).
 *
 * Copied from tests/tracking/src/mock_log.c (UWB-252) / originally
 * tests/dw1000_sync/src/mock_log.c (UWB-242) / tests/dw1000_ranging/src/mock_log.c
 * (UWB-231): the join test build compiles dw1000_ranging.c and dw1000_sync.c
 * alongside uwb_join.c itself, and the unit_testing defconfig enables
 * CONFIG_LOG=y, which causes every LOG_ERR()/LOG_DBG()/LOG_WRN()/LOG_INF()
 * macro in those modules to call z_log_minimal_printk() at link time. That
 * function lives in Zephyr's log_minimal.c, which is not compiled in the
 * minimal unit_testing link set. Stub it out here — unit tests do not need
 * real log output, only assertion correctness.
 *
 * @attention
 * SPDX-License-Identifier: MIT
 * Copyright (c) 2024 Fundamentals UWB project contributors.
 */

#include <stdarg.h>

void z_log_minimal_printk(const char *fmt, ...)
{
    (void)fmt;
    /* No-op: discard log messages in unit tests. */
}
```
