## CMakeLists.txt
```
cmake_minimum_required(VERSION 3.20.0)

# Zephyr unit test build — uses the 'unittest' CMake component.
#
# Key differences from regular Zephyr app builds:
#   - 'project()' comes BEFORE 'find_package()'
#   - 'COMPONENTS unittest' selects the minimal, kernel-free build
#   - The build target is 'testbinary' (not 'app')
#   - No device tree, no real SPI/GPIO — deca_port.c is excluded
#
# The test exercises:
#   1. readfromspi header framing: dwt_readdevid() must pass a 1-byte
#      header of 0x00 to readfromspi() (READ | no-subaddr | reg file 0).
#   2. dwt_readdevid() value decode: the driver assembles LE bytes
#      {0x30,0x01,0xCA,0xDE} into 0xDECA0130.
#
# Platform: unit_testing  (native host executable, no emulation).
# Run:  west twister -p unit_testing -T tests/dw1000_devid -v

project(test_dw1000_devid)
find_package(Zephyr COMPONENTS unittest REQUIRED HINTS $ENV{ZEPHYR_BASE})

# Vendored deca_driver sources compiled directly into the test binary.
# deca_device.c includes only standard C headers (<assert.h>, <stdlib.h>)
# and the deca_driver headers — it is safe to compile in a kernel-free env.
# deca_params_init.c provides the const config arrays deca_device.c needs.
# deca_port.c is NOT included — it has Zephyr SPI/GPIO includes.
set(DECA_DRIVER_DIR ${CMAKE_CURRENT_SOURCE_DIR}/../../drivers/dw1000/deca_driver)

target_sources(testbinary PRIVATE
    src/test_dw1000_devid.c
    src/mock_platform.c
    ${DECA_DRIVER_DIR}/deca_device.c
    ${DECA_DRIVER_DIR}/deca_params_init.c
)

target_include_directories(testbinary PRIVATE
    ${DECA_DRIVER_DIR}
    ${CMAKE_CURRENT_SOURCE_DIR}/src
)
```

## prj.conf
```kconfig
# tests/dw1000_devid/prj.conf
# Minimal config for the unit_testing platform — only ztest is needed.
CONFIG_ZTEST=y
```

## src/mock_platform.c
```c
/*! ----------------------------------------------------------------------------
 * @file    mock_platform.c
 * @brief   Mock implementations of the five deca_driver platform symbols.
 *
 * These replace deca_port.c in the unit_testing build.  They have no Zephyr
 * SPI/GPIO dependencies — the mock captures the SPI header that the driver
 * constructs for the DEV_ID read and fills the RX buffer with the expected
 * 0xDECA0130 device-ID bytes.
 *
 * The captured state is in mock_spi_state (declared in mock_platform.h) and
 * is reset by mock_spi_reset() before each test.
 *
 * @attention
 * SPDX-License-Identifier: MIT
 * Copyright (c) 2024 Fundamentals UWB project contributors.
 */

#include <string.h>

#include "deca_device_api.h"
#include "mock_platform.h"

/* ---------------------------------------------------------------------------
 * Captured SPI call state (inspected by the test assertions)
 * --------------------------------------------------------------------------- */
struct mock_spi_state mock_spi_state;

void mock_spi_reset(void)
{
	memset(&mock_spi_state, 0, sizeof(mock_spi_state));
}

/* ---------------------------------------------------------------------------
 * readfromspi — the key mock
 *
 * Captures the header the driver builds for the SPI read transaction (this is
 * what the framing test asserts), then fills readBuffer with the DEV_ID bytes
 * for 0xDECA0130 in little-endian order so that dwt_read32bitoffsetreg()
 * decodes the correct value.
 *
 * DW1000 registers are read little-endian on the wire:
 *   0xDECA0130 -> buffer[0]=0x30, [1]=0x01, [2]=0xCA, [3]=0xDE
 * --------------------------------------------------------------------------- */
int readfromspi(uint16 headerLength, const uint8 *headerBuffer,
		uint32 readlength, uint8 *readBuffer)
{
	/* Capture the header so the test can verify the framing. */
	mock_spi_state.read_header_len = headerLength;
	if (headerLength <= MOCK_SPI_MAX_HDR) {
		memcpy(mock_spi_state.read_header, headerBuffer, headerLength);
	}
	mock_spi_state.read_called = 1;

	/*
	 * Fill readBuffer with 0xDECA0130 in little-endian byte order.
	 * Any read of less than 4 bytes receives the appropriate prefix bytes.
	 */
	static const uint8 devid_le[4] = { 0x30U, 0x01U, 0xCAU, 0xDEU };
	uint32 to_fill = readlength < 4U ? readlength : 4U;
	uint32 i;

	for (i = 0U; i < to_fill; i++) {
		readBuffer[i] = devid_le[i];
	}
	/* Zero any remaining bytes beyond the devid pattern. */
	for (; i < readlength; i++) {
		readBuffer[i] = 0U;
	}

	return DWT_SUCCESS;
}

/* ---------------------------------------------------------------------------
 * writetospi — no-op stub (not exercised by dwt_readdevid)
 * --------------------------------------------------------------------------- */
int writetospi(uint16 headerLength, const uint8 *headerBuffer,
	       uint32 bodylength, const uint8 *bodyBuffer)
{
	(void)headerLength;
	(void)headerBuffer;
	(void)bodylength;
	(void)bodyBuffer;
	return DWT_SUCCESS;
}

/* ---------------------------------------------------------------------------
 * decamutexon / decamutexoff — no-op stubs (single-threaded test)
 * --------------------------------------------------------------------------- */
decaIrqStatus_t decamutexon(void)
{
	return 0;
}

void decamutexoff(decaIrqStatus_t s)
{
	(void)s;
}

/* ---------------------------------------------------------------------------
 * deca_sleep — no-op stub (no k_msleep available on unit_testing)
 * --------------------------------------------------------------------------- */
void deca_sleep(unsigned int time_ms)
{
	(void)time_ms;
}
```

## src/mock_platform.h
```c
/*! ----------------------------------------------------------------------------
 * @file    mock_platform.h
 * @brief   Shared state for the readfromspi mock (used by the ztest assertions).
 *
 * @attention
 * SPDX-License-Identifier: MIT
 * Copyright (c) 2024 Fundamentals UWB project contributors.
 */

#ifndef MOCK_PLATFORM_H_
#define MOCK_PLATFORM_H_

#include <stdint.h>
#include "deca_device_api.h"

#define MOCK_SPI_MAX_HDR 3U

/** Captured state from the most recent readfromspi() call. */
struct mock_spi_state {
	uint16 read_header_len;          /**< Header length passed to readfromspi. */
	uint8  read_header[MOCK_SPI_MAX_HDR]; /**< Header bytes passed to readfromspi. */
	int    read_called;              /**< Non-zero if readfromspi was called. */
};

/** Exposed for inspection by the ztest assertions. */
extern struct mock_spi_state mock_spi_state;

/** Reset captured state before each test. */
void mock_spi_reset(void);

#endif /* MOCK_PLATFORM_H_ */
```

## src/test_dw1000_devid.c
```c
/*! ----------------------------------------------------------------------------
 * @file    test_dw1000_devid.c
 * @brief   ztest suite: DW1000 device-ID SPI framing and decode (UWB-94)
 *
 * Platform: unit_testing (native-hosted, no Zephyr kernel, no real SPI).
 *
 * Two tests in the suite:
 *
 *   test_readfromspi_header_framing
 *       Verifies that dwt_readdevid() causes the deca_driver to call
 *       readfromspi() with the correct SPI header for the DEV_ID register:
 *         - headerLength == 1  (no sub-index; DEV_ID reg is at index 0)
 *         - header[0]    == 0x00  (READ | no-subaddr | reg file id 0x00)
 *       This tests the header encoding in dwt_readfromdevice().
 *
 *   test_devid_decode
 *       Verifies that when readfromspi() returns the correct little-endian
 *       bytes {0x30, 0x01, 0xCA, 0xDE}, dwt_readdevid() assembles them into
 *       0xDECA0130 and returns that value.
 *
 * @attention
 * SPDX-License-Identifier: MIT
 * Copyright (c) 2024 Fundamentals UWB project contributors.
 */

#include <zephyr/ztest.h>

#include "deca_device_api.h"
#include "mock_platform.h"

/* ---------------------------------------------------------------------------
 * Suite setup / teardown
 * --------------------------------------------------------------------------- */
static void *suite_setup(void)
{
	/* Nothing to allocate. */
	return NULL;
}

static void before_each(void *fixture)
{
	(void)fixture;
	mock_spi_reset();
}

ZTEST_SUITE(dw1000_devid, NULL, suite_setup, before_each, NULL, NULL);

/* ---------------------------------------------------------------------------
 * Test 1 — readfromspi header framing
 *
 * dwt_readdevid() -> dwt_read32bitoffsetreg(DEV_ID_ID=0, 0)
 *                 -> dwt_readfromdevice(recordNumber=0, index=0, length=4, buf)
 *                 -> readfromspi(cnt=1, header={0x00}, 4, buf)
 *
 * The header encoding (from deca_device.c dwt_readfromdevice):
 *   index == 0  =>  header[0] = (uint8) recordNumber = 0x00
 *                   (bit-7 = 0: READ op; bit-6 = 0: no sub-address; bits 5-0 = 0)
 * --------------------------------------------------------------------------- */
ZTEST(dw1000_devid, test_readfromspi_header_framing)
{
	(void)dwt_readdevid();

	zassert_equal(mock_spi_state.read_called, 1,
		      "Expected readfromspi() to be called exactly once");

	zassert_equal(mock_spi_state.read_header_len, 1,
		      "Expected 1-byte SPI header for DEV_ID (reg 0x00, index 0); "
		      "got %u", mock_spi_state.read_header_len);

	zassert_equal(mock_spi_state.read_header[0], 0x00U,
		      "Expected header byte 0x00 (READ | no-subaddr | reg-id=0); "
		      "got 0x%02X", mock_spi_state.read_header[0]);
}

/* ---------------------------------------------------------------------------
 * Test 2 — dwt_readdevid() value decode
 *
 * The mock fills readBuffer with {0x30, 0x01, 0xCA, 0xDE} (LE byte order for
 * 0xDECA0130).  dwt_read32bitoffsetreg() assembles them as:
 *   buf[0] | (buf[1]<<8) | (buf[2]<<16) | (buf[3]<<24) == 0xDECA0130
 * --------------------------------------------------------------------------- */
ZTEST(dw1000_devid, test_devid_decode)
{
	uint32 devid = dwt_readdevid();

	zassert_equal(devid, DWT_DEVICE_ID,
		      "Expected dwt_readdevid() == 0x%08X (DWT_DEVICE_ID); "
		      "got 0x%08X", DWT_DEVICE_ID, devid);
}
```
