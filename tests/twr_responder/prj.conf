## CMakeLists.txt
```
cmake_minimum_required(VERSION 3.20.0)

# Zephyr unit test build for the twr_responder module (UWB-232).
#
# Mirrors tests/dw1000_sync's unit_testing pattern: the module under test is
# compiled together with its real dependencies (dw1000_ranging.c, UWB-231;
# uwb_twr_codec.c, UWB-230) against a mocked deca_driver, so assertions can
# inspect exactly which frames were built/scheduled without any real
# SPI/hardware.
#
# What is compiled:
#   twr_responder.c         — the module under test (UWB-232)
#   dw1000_ranging.c         — dw1000_rx() / dw1000_tx_at() /
#                              dw1000_delayed_tx_time() (UWB-231), reused
#                              (not reimplemented) by twr_responder.c
#   uwb_twr_codec.c          — DS-TWR frame build/parse (UWB-230), reused by
#                              twr_responder.c
#   mock_deca_driver.c       — mocks the deca_driver API surface
#                              dw1000_ranging.c calls, extended with an RX
#                              queue (see src/mock_deca_driver.h) since a
#                              single twr_responder_run_once() attempt can
#                              call dw1000_rx() up to twice.
#   mock_log.c               — stubs z_log_minimal_printk() (same rationale
#                              as tests/dw1000_ranging/src/mock_log.c): the
#                              unit_testing defconfig enables CONFIG_LOG=y,
#                              so LOG_*() calls in dw1000_ranging.c and
#                              twr_responder.c need this symbol at link time.
#   test_twr_responder.c     — ztest assertions
#
# Note: deca_device.c is intentionally NOT compiled here (same rationale as
# tests/dw1000_ranging / tests/dw1000_sync): the mock replaces every
# deca_driver API function dw1000_ranging.c calls.
#
# Platform: unit_testing  (native host executable, no emulation)
# Run:  west twister -p unit_testing -T tests/twr_responder -v

project(test_twr_responder)
find_package(Zephyr COMPONENTS unittest REQUIRED HINTS $ENV{ZEPHYR_BASE})

set(DW1000_DIR ${CMAKE_CURRENT_SOURCE_DIR}/../../drivers/dw1000)

target_sources(testbinary PRIVATE
    src/test_twr_responder.c
    src/mock_deca_driver.c
    src/mock_log.c
    ${DW1000_DIR}/twr_responder.c
    ${DW1000_DIR}/dw1000_ranging.c
    ${DW1000_DIR}/uwb_twr_codec.c
)

target_include_directories(testbinary PRIVATE
    ${DW1000_DIR}/deca_driver        # deca_device_api.h, deca_regs.h
    ${DW1000_DIR}                    # twr_responder.h, dw1000_ranging.h, uwb_twr_codec.h, uwb_frames.h
    ${CMAKE_CURRENT_SOURCE_DIR}/src  # mock_deca_driver.h
)

# Inject the CONFIG_UWB_TWR_* compile-time constants twr_responder.c reads
# (via Kconfig in a normal Zephyr build; directly here in unit tests -- the
# unit_testing platform's Kconfig root does not include the
# drivers/dw1000/Kconfig hierarchy, same rationale as
# tests/dw1000_config/CMakeLists.txt).
#
# CONFIG_UWB_TWR_RESP_REPLY_DELAY_DTU matches the Kconfig default (~2 ms).
# CONFIG_UWB_TWR_RESPONDER_DEBUG_RANGE=1 enables the debug-range computation
# so test_twr_responder.c can assert uwb_twr_exchange_t::range_mm against a
# hand-calc fixture.
target_compile_definitions(testbinary PRIVATE
    CONFIG_UWB_TWR_RESP_REPLY_DELAY_DTU=127795200
    CONFIG_UWB_TWR_RESPONDER_POLL_TIMEOUT_US=100000
    CONFIG_UWB_TWR_RESPONDER_FINAL_TIMEOUT_US=10000
    CONFIG_UWB_TWR_RESPONDER_DEBUG_RANGE=1
)
```

## prj.conf
```kconfig
# tests/twr_responder/prj.conf
# Minimal config for the unit_testing platform — only ztest is needed.
# CONFIG_UWB_TWR_RESP_REPLY_DELAY_DTU / CONFIG_UWB_TWR_RESPONDER_* values are
# injected as compile definitions in CMakeLists.txt (the unit_testing
# platform's Kconfig root does not include the drivers/dw1000/Kconfig
# hierarchy — same rationale as tests/dw1000_config/prj.conf).
CONFIG_ZTEST=y
```

## src/mock_deca_driver.c
```c
/*! ----------------------------------------------------------------------------
 * @file    mock_deca_driver.c
 * @brief   Mock implementations of deca_driver API functions called by
 *          dw1000_ranging.c (UWB-231) and exercised transitively by
 *          twr_responder.c (UWB-232 unit tests).
 *
 * These stubs have no hardware or SPI dependencies. See mock_deca_driver.h
 * for the RX-queue rationale (a single twr_responder_run_once() attempt can
 * call dw1000_rx() up to twice).
 *
 * RX side: dwt_rxenable() advances mock_rx_queue_state to the next
 * programmed mock_rx_event (or a default frame-wait-timeout event if the
 * queue is exhausted); SYS_STATUS / RX_FINFO / dwt_readrxdata() /
 * dwt_readrxtimestamp() all read from that active event until the next
 * dwt_rxenable() call.
 *
 * TX side: unchanged single-shot mocking (dw1000_tx_at() is called at most
 * once per attempt) -- dwt_setdelayedtrxtime() / dwt_writetxdata() /
 * dwt_writetxfctrl() / dwt_starttx() capture their arguments directly.
 *
 * @attention
 * SPDX-License-Identifier: MIT
 * Copyright (c) 2024 Fundamentals UWB project contributors.
 */

#include <string.h>

#include "deca_device_api.h"
#include "deca_regs.h"
#include "mock_deca_driver.h"

/* ---------------------------------------------------------------------------
 * Captured / configurable state (inspected and pre-configured by tests)
 * --------------------------------------------------------------------------- */
struct mock_rx_queue_state        mock_rx_queue_state;
struct mock_rxtimeout_state       mock_rxtimeout_state;
struct mock_rxenable_state        mock_rxenable_state;
struct mock_forcetrxoff_state     mock_forcetrxoff_state;
struct mock_reg_state             mock_reg_state;
struct mock_readrxdata_state      mock_readrxdata_state;
struct mock_timestamp_state       mock_timestamp_state;
struct mock_delayedtrxtime_state  mock_delayedtrxtime_state;
struct mock_tx_state              mock_tx_state;
struct mock_starttx_state         mock_starttx_state;

/* Default event served when dwt_rxenable() is called more times than the
 * test programmed via mock_rx_queue_push(): a frame-wait timeout. */
static const struct mock_rx_event mock_rx_default_timeout_event = {
    .sys_status = SYS_STATUS_RXRFTO,
    .rx_finfo = 0u,
    .payload = {0},
    .payload_len = 0u,
    .rx_ts_bytes = {0, 0, 0, 0, 0},
};

/* The event the currently in-flight dw1000_rx() call (since its last
 * dwt_rxenable()) should be served from -- backs RX_FINFO / dwt_readrxdata()
 * / dwt_readrxtimestamp(), which are only read once RXFCG is already latched
 * (see mock_current_sys_status below for why SYS_STATUS itself is NOT read
 * from this directly). */
static const struct mock_rx_event *mock_rx_active = &mock_rx_default_timeout_event;

/*
 * The single "live" SYS_STATUS register value, shared by BOTH polling loops
 * in dw1000_ranging.c: dw1000_rx()'s good-frame/error/timeout poll AND
 * dw1000_tx_at()'s post-dwt_starttx() TXFRS poll (both read SYS_STATUS_ID via
 * the same dwt_read32bitreg() macro). It must therefore behave like the real
 * hardware register: whichever bits are relevant to the operation in
 * progress, with write-1-to-clear semantics.
 *
 *   - dwt_rxenable() (start of a dw1000_rx() call) loads the active RX
 *     event's sys_status here -- this is what dw1000_rx()'s polling loop
 *     will observe.
 *   - dwt_starttx() OR's in SYS_STATUS_TXFRS on success, simulating the
 *     DW1000 completing the (mocked, instantaneous) transmission by the time
 *     dw1000_tx_at()'s post-dwt_starttx() poll runs.
 *   - dwt_write32bitoffsetreg(SYS_STATUS_ID, ...) clears the written bits,
 *     matching real DW1000 write-1-to-clear semantics.
 *
 * Without this, a mock that only tracked the "active RX event" would leave
 * dw1000_tx_at()'s TXFRS poll spinning forever after a POLL RX event with
 * SYS_STATUS_RXFCG (no TXFRS bit) was left active from the preceding
 * dw1000_rx() call.
 */
static uint32 mock_current_sys_status;

void mock_deca_reset(void)
{
    memset(&mock_rx_queue_state,       0, sizeof(mock_rx_queue_state));
    memset(&mock_rxtimeout_state,      0, sizeof(mock_rxtimeout_state));
    memset(&mock_rxenable_state,       0, sizeof(mock_rxenable_state));
    memset(&mock_forcetrxoff_state,    0, sizeof(mock_forcetrxoff_state));
    memset(&mock_reg_state,            0, sizeof(mock_reg_state));
    memset(&mock_readrxdata_state,     0, sizeof(mock_readrxdata_state));
    memset(&mock_timestamp_state,      0, sizeof(mock_timestamp_state));
    memset(&mock_delayedtrxtime_state, 0, sizeof(mock_delayedtrxtime_state));
    memset(&mock_tx_state,             0, sizeof(mock_tx_state));
    memset(&mock_starttx_state,        0, sizeof(mock_starttx_state));

    mock_rx_active = &mock_rx_default_timeout_event;
    mock_current_sys_status = 0u;

    /* Defaults: every deca_driver call that can fail reports success. */
    mock_rxenable_state.return_value       = DWT_SUCCESS;
    mock_tx_state.writetxdata_return_value = DWT_SUCCESS;
    mock_starttx_state.return_value        = DWT_SUCCESS;
}

void mock_rx_queue_push(uint32 sys_status, uint32 rx_finfo,
                         const uint8 *payload, uint16 payload_len,
                         const uint8 rx_ts_bytes[5])
{
    struct mock_rx_event *ev;
    uint16 copy_len;

    if (mock_rx_queue_state.count >= MOCK_RX_QUEUE_DEPTH) {
        return; /* test authoring error -- silently drop rather than overflow */
    }

    ev = &mock_rx_queue_state.events[mock_rx_queue_state.count];
    memset(ev, 0, sizeof(*ev));

    ev->sys_status = sys_status;
    ev->rx_finfo = rx_finfo;
    ev->payload_len = payload_len;

    if (payload != NULL && payload_len > 0u) {
        copy_len = payload_len;
        if (copy_len > MOCK_MAX_FRAME_LEN) {
            copy_len = MOCK_MAX_FRAME_LEN;
        }
        memcpy(ev->payload, payload, copy_len);
    }

    if (rx_ts_bytes != NULL) {
        memcpy(ev->rx_ts_bytes, rx_ts_bytes, 5);
    }

    mock_rx_queue_state.count++;
}

/* ---------------------------------------------------------------------------
 * Mock dwt_setrxtimeout
 * --------------------------------------------------------------------------- */
void dwt_setrxtimeout(uint16 time)
{
    mock_rxtimeout_state.called++;
    mock_rxtimeout_state.time = time;
}

/* ---------------------------------------------------------------------------
 * Mock dwt_rxenable -- also advances the RX event queue
 * --------------------------------------------------------------------------- */
int dwt_rxenable(int mode)
{
    mock_rxenable_state.called++;
    mock_rxenable_state.mode = mode;

    if (mock_rx_queue_state.next_index < mock_rx_queue_state.count) {
        mock_rx_active = &mock_rx_queue_state.events[mock_rx_queue_state.next_index];
        mock_rx_queue_state.next_index++;
    } else {
        mock_rx_active = &mock_rx_default_timeout_event;
    }

    /* Load the live SYS_STATUS register with this attempt's outcome -- see
     * mock_current_sys_status's doc comment. */
    mock_current_sys_status = mock_rx_active->sys_status;

    return mock_rxenable_state.return_value;
}

/* ---------------------------------------------------------------------------
 * Mock dwt_forcetrxoff
 * --------------------------------------------------------------------------- */
void dwt_forcetrxoff(void)
{
    mock_forcetrxoff_state.called++;
}

/* ---------------------------------------------------------------------------
 * Mock dwt_read32bitoffsetreg (backs the dwt_read32bitreg() macro)
 *
 * Returns the live SYS_STATUS register for SYS_STATUS_ID (see
 * mock_current_sys_status's doc comment -- shared by dw1000_rx()'s and
 * dw1000_tx_at()'s polling loops), the active RX event's rx_finfo for
 * RX_FINFO_ID, 0 for anything else.
 * --------------------------------------------------------------------------- */
uint32 dwt_read32bitoffsetreg(int regFileID, int regOffset)
{
    (void)regOffset;

    if (regFileID == SYS_STATUS_ID) {
        return mock_current_sys_status;
    }
    if (regFileID == RX_FINFO_ID) {
        return mock_rx_active->rx_finfo;
    }
    return 0u;
}

/* ---------------------------------------------------------------------------
 * Mock dwt_write32bitoffsetreg (backs the dwt_write32bitreg() macro)
 *
 * Captures the last register/value written, and -- for SYS_STATUS_ID --
 * clears the written bits from the live SYS_STATUS register
 * (mock_current_sys_status), matching real DW1000 write-1-to-clear semantics.
 * --------------------------------------------------------------------------- */
void dwt_write32bitoffsetreg(int regFileID, int regOffset, uint32 regval)
{
    (void)regOffset;

    mock_reg_state.last_write_reg = (uint32)regFileID;
    mock_reg_state.last_write_val = regval;
    mock_reg_state.write_count++;

    if (regFileID == SYS_STATUS_ID) {
        mock_current_sys_status &= ~regval;
    }
}

/* ---------------------------------------------------------------------------
 * Mock dwt_readrxdata
 *
 * Captures length/offset and copies the active RX event's payload bytes into
 * the caller's buffer.
 * --------------------------------------------------------------------------- */
void dwt_readrxdata(uint8 *buffer, uint16 length, uint16 rxBufferOffset)
{
    uint16 copy_len = length;

    mock_readrxdata_state.called++;
    mock_readrxdata_state.length = length;
    mock_readrxdata_state.offset = rxBufferOffset;

    if (copy_len > MOCK_MAX_FRAME_LEN) {
        copy_len = MOCK_MAX_FRAME_LEN;
    }
    if (buffer != NULL) {
        memcpy(buffer, mock_rx_active->payload, copy_len);
    }
}

/* ---------------------------------------------------------------------------
 * Mock dwt_readrxtimestamp / dwt_readtxtimestamp
 * --------------------------------------------------------------------------- */
void dwt_readrxtimestamp(uint8 *timestamp)
{
    mock_timestamp_state.rx_called++;
    if (timestamp != NULL) {
        memcpy(timestamp, mock_rx_active->rx_ts_bytes, 5);
    }
}

void dwt_readtxtimestamp(uint8 *timestamp)
{
    mock_timestamp_state.tx_called++;
    if (timestamp != NULL) {
        memcpy(timestamp, mock_timestamp_state.tx_ts_bytes, 5);
    }
}

/* ---------------------------------------------------------------------------
 * Mock dwt_setdelayedtrxtime
 * --------------------------------------------------------------------------- */
void dwt_setdelayedtrxtime(uint32 starttime)
{
    mock_delayedtrxtime_state.called++;
    mock_delayedtrxtime_state.starttime = starttime;
}

/* ---------------------------------------------------------------------------
 * Mock dwt_writetxdata
 * --------------------------------------------------------------------------- */
int dwt_writetxdata(uint16 txFrameLength, uint8 *txFrameBytes, uint16 txBufferOffset)
{
    uint16 copy_len = txFrameLength;

    mock_tx_state.writetxdata_called++;
    mock_tx_state.writetxdata_len    = txFrameLength;
    mock_tx_state.writetxdata_offset = txBufferOffset;

    if (copy_len > MOCK_MAX_FRAME_LEN) {
        copy_len = MOCK_MAX_FRAME_LEN;
    }
    if (txFrameBytes != NULL) {
        memcpy(mock_tx_state.writetxdata_buf, txFrameBytes, copy_len);
    }

    return mock_tx_state.writetxdata_return_value;
}

/* ---------------------------------------------------------------------------
 * Mock dwt_writetxfctrl
 * --------------------------------------------------------------------------- */
void dwt_writetxfctrl(uint16 txFrameLength, uint16 txBufferOffset, int ranging)
{
    mock_tx_state.writetxfctrl_called++;
    mock_tx_state.writetxfctrl_len     = txFrameLength;
    mock_tx_state.writetxfctrl_offset  = txBufferOffset;
    mock_tx_state.writetxfctrl_ranging = ranging;
}

/* ---------------------------------------------------------------------------
 * Mock dwt_starttx
 *
 * On success, latches SYS_STATUS_TXFRS into the live SYS_STATUS register
 * (mock_current_sys_status) so dw1000_tx_at()'s post-dwt_starttx() polling
 * loop observes the transmission as instantly complete. On failure
 * (DWT_ERROR, simulating HPDWARN), leaves the register untouched --
 * dw1000_tx_at() does not enter the TXFRS wait loop in that case.
 * --------------------------------------------------------------------------- */
int dwt_starttx(uint8 mode)
{
    mock_starttx_state.called++;
    mock_starttx_state.mode = mode;

    if (mock_starttx_state.return_value == DWT_SUCCESS) {
        mock_current_sys_status |= SYS_STATUS_TXFRS;
    }

    return mock_starttx_state.return_value;
}
```

## src/mock_deca_driver.h
```c
/*! ----------------------------------------------------------------------------
 * @file    mock_deca_driver.h
 * @brief   Mock state for the deca_driver API functions called by
 *          dw1000_ranging.c (UWB-231) and exercised transitively by
 *          twr_responder.c (UWB-232 unit tests).
 *
 * Adapted from tests/dw1000_ranging/src/mock_deca_driver.{c,h} (same
 * function-level mocking approach, no hardware/SPI dependency) with one
 * addition: an RX *queue* (mock_rx_queue_push()), because a single
 * twr_responder_run_once() attempt can call dw1000_rx() up to twice (once
 * waiting for a POLL, once waiting for the matching FINAL) and each call
 * needs to be able to report a different frame/timestamp/status. TX-side
 * mocking (dw1000_tx_at() is called at most once per attempt) is unchanged
 * from the UWB-231 mock: single captured-call state, no queue needed.
 *
 * Reset by mock_deca_reset() before each test. Tests push the RX events they
 * want dw1000_rx() to observe (in call order) via mock_rx_queue_push() and/or
 * configure TX-side return values, then assert on the captured call
 * arguments.
 *
 * Note: dw1000_ranging.c's dw1000_rx() and dw1000_tx_at() both poll the same
 * hardware register (SYS_STATUS_ID) for different bits (RXFCG/timeout/error
 * vs TXFRS). The mock therefore models a single "live" SYS_STATUS value
 * internally (loaded from the active RX event on dwt_rxenable(), OR'd with
 * TXFRS by a successful dwt_starttx(), and write-1-to-clear on
 * dwt_write32bitoffsetreg()) -- see mock_deca_driver.c. Tests only interact
 * with this indirectly, via mock_rx_queue_push() and mock_starttx_state.
 *
 * @attention
 * SPDX-License-Identifier: MIT
 * Copyright (c) 2024 Fundamentals UWB project contributors.
 */

#ifndef MOCK_DECA_DRIVER_H_
#define MOCK_DECA_DRIVER_H_

#include "deca_device_api.h"

/** Size of the scratch buffers used to capture RX/TX payload bytes. */
#define MOCK_MAX_FRAME_LEN  128

/** Max number of RX events a single test can program. A DS-TWR responder
 *  attempt calls dw1000_rx() at most twice (POLL wait, FINAL wait); a small
 *  margin is kept for tests that call twr_responder_run_once() more than
 *  once in a row. */
#define MOCK_RX_QUEUE_DEPTH  6

/**
 * One programmed dw1000_rx() outcome: what SYS_STATUS / RX_FINFO /
 * dwt_readrxdata() / dwt_readrxtimestamp() should report for one call to
 * dw1000_rx().
 */
struct mock_rx_event {
    uint32 sys_status;                    /**< e.g. SYS_STATUS_RXFCG / *_RXRFTO / *_RXFCE. */
    uint32 rx_finfo;                       /**< Reported frame length (RX_FINFO_RXFLEN_MASK bits). */
    uint8  payload[MOCK_MAX_FRAME_LEN];    /**< Frame bytes dwt_readrxdata() copies out. */
    uint16 payload_len;                    /**< Valid bytes in payload[] (informational). */
    uint8  rx_ts_bytes[5];                 /**< 40-bit RX timestamp, little-endian. */
};

/**
 * Queue of programmed RX events, served strictly in order: each dwt_rxenable()
 * call (exactly one per dw1000_rx() call) advances to the next queued event.
 * If dw1000_rx() is called more times than were programmed, unprogrammed
 * calls report a frame-wait timeout (SYS_STATUS_RXRFTO) -- see
 * mock_deca_reset()/dwt_rxenable() in mock_deca_driver.c.
 */
struct mock_rx_queue_state {
    struct mock_rx_event events[MOCK_RX_QUEUE_DEPTH];
    int count;        /**< Number of events pushed via mock_rx_queue_push(). */
    int next_index;   /**< Index of the next event dwt_rxenable() will serve. */
};

/**
 * State captured from mock dwt_setrxtimeout() call. .called counts every
 * invocation (a run_once() attempt may call dw1000_rx() -> dwt_setrxtimeout()
 * up to twice); .time holds the most recent 'time' argument.
 */
struct mock_rxtimeout_state {
    int    called;
    uint16 time;
};

/**
 * State captured from mock dwt_rxenable() calls, and its configurable return
 * value. .called counts every invocation -- also used as the RX-queue
 * advance trigger (see mock_rx_queue_state).
 */
struct mock_rxenable_state {
    int called;
    int mode;           /**< Most recent 'mode' argument passed. */
    int return_value;   /**< Value dwt_rxenable() should return (default DWT_SUCCESS). */
};

/** Call counter for mock dwt_forcetrxoff(). */
struct mock_forcetrxoff_state {
    int called;
};

/**
 * Captured register-write state (SYS_STATUS / TXFRS clears etc.) -- write
 * side only. Read side (SYS_STATUS_ID / RX_FINFO_ID) is served from the
 * active mock_rx_event during dw1000_rx()'s polling loop instead; see
 * mock_deca_driver.c.
 */
struct mock_reg_state {
    uint32 last_write_reg;
    uint32 last_write_val;
    int    write_count;
};

/** Captured dwt_readrxdata() call arguments (payload bytes themselves come
 *  from the active mock_rx_event, not stored here). */
struct mock_readrxdata_state {
    int    called;
    uint16 length;
    uint16 offset;
};

/**
 * Captured dwt_readrxtimestamp() / dwt_readtxtimestamp() call counts. RX
 * timestamp bytes come from the active mock_rx_event; TX timestamp bytes are
 * a single injectable buffer (dw1000_tx_at() does not call
 * dwt_readtxtimestamp() itself -- kept for API parity with the UWB-231 mock
 * / dw1000_ranging.c's dw1000_read_tx_timestamp(), unused by this suite).
 */
struct mock_timestamp_state {
    uint8 tx_ts_bytes[5];
    int   rx_called;
    int   tx_called;
};

/** State captured from mock dwt_setdelayedtrxtime() call. */
struct mock_delayedtrxtime_state {
    int    called;
    uint32 starttime;
};

/**
 * State captured from mock dwt_writetxdata() and dwt_writetxfctrl() calls,
 * and dwt_writetxdata()'s configurable return value.
 */
struct mock_tx_state {
    int    writetxdata_called;
    uint16 writetxdata_len;
    uint8  writetxdata_buf[MOCK_MAX_FRAME_LEN];
    uint16 writetxdata_offset;
    int    writetxdata_return_value;

    int    writetxfctrl_called;
    uint16 writetxfctrl_len;
    uint16 writetxfctrl_offset;
    int    writetxfctrl_ranging;
};

/**
 * State captured from mock dwt_starttx() call, and its configurable return
 * value (set to DWT_ERROR to simulate a missed/HPDWARN slot).
 */
struct mock_starttx_state {
    int    called;
    uint8  mode;
    int    return_value;
};

extern struct mock_rx_queue_state        mock_rx_queue_state;
extern struct mock_rxtimeout_state       mock_rxtimeout_state;
extern struct mock_rxenable_state        mock_rxenable_state;
extern struct mock_forcetrxoff_state     mock_forcetrxoff_state;
extern struct mock_reg_state             mock_reg_state;
extern struct mock_readrxdata_state      mock_readrxdata_state;
extern struct mock_timestamp_state       mock_timestamp_state;
extern struct mock_delayedtrxtime_state  mock_delayedtrxtime_state;
extern struct mock_tx_state              mock_tx_state;
extern struct mock_starttx_state         mock_starttx_state;

/** Reset all captured/configurable state to defaults (all-success, all-zero,
 *  empty RX queue). */
void mock_deca_reset(void);

/**
 * @brief Program the outcome of the next (not-yet-served) dw1000_rx() call.
 *
 * Push events in the order the code under test is expected to call
 * dw1000_rx() -- e.g. for a full DS-TWR exchange: push the POLL event first,
 * then the FINAL event.
 *
 * @param sys_status    SYS_STATUS bits dw1000_rx()'s polling loop should see
 *                       (e.g. SYS_STATUS_RXFCG for a good frame,
 *                       SYS_STATUS_RXRFTO for a timeout, SYS_STATUS_RXFCE for
 *                       an RX/FCS error).
 * @param rx_finfo       Value RX_FINFO should report (frame length in the
 *                       RX_FINFO_RXFLEN_MASK bits). Ignored for
 *                       timeout/error events.
 * @param payload        Frame bytes dwt_readrxdata() should copy out (may be
 *                       NULL for timeout/error events).
 * @param payload_len    Number of valid bytes in @p payload (also informs
 *                       the copy length; capped to MOCK_MAX_FRAME_LEN).
 * @param rx_ts_bytes    5-byte little-endian RX timestamp dwt_readrxtimestamp()
 *                       should report (may be NULL -- treated as all-zero).
 */
void mock_rx_queue_push(uint32 sys_status, uint32 rx_finfo,
                         const uint8 *payload, uint16 payload_len,
                         const uint8 rx_ts_bytes[5]);

#endif /* MOCK_DECA_DRIVER_H_ */
```

## src/mock_log.c
```c
/*! ----------------------------------------------------------------------------
 * @file    mock_log.c
 * @brief   Zephyr minimal-log stub for the twr_responder unit test (UWB-232).
 *
 * Mirrors tests/dw1000_config/src/mock_port.c and tests/dw1000_ranging/src/
 * mock_log.c: the unit_testing defconfig enables CONFIG_LOG=y, which causes
 * the LOG_ERR()/LOG_WRN()/LOG_DBG()/LOG_INF() macros in dw1000_ranging.c and
 * twr_responder.c to call z_log_minimal_printk() at link time. That function
 * lives in Zephyr's log_minimal.c, which is not compiled in the minimal
 * unit_testing link set. Stub it out here — unit tests do not need real log
 * output, only assertion correctness.
 *
 * @attention
 * SPDX-License-Identifier: MIT
 * Copyright (c) 2024 Fundamentals UWB project contributors.
 */

#include <stdarg.h>

void z_log_minimal_printk(const char *fmt, ...)
{
    (void)fmt;
    /* No-op: discard log messages in unit tests. */
}
```

## src/test_twr_responder.c
```c
/*! ----------------------------------------------------------------------------
 * @file    test_twr_responder.c
 * @brief   ztest suite: DS-TWR responder mode state machine (UWB-232)
 *
 * Platform: unit_testing (native-hosted, no Zephyr kernel, no real SPI).
 * Compiles the real twr_responder.c + dw1000_ranging.c (UWB-231) +
 * uwb_twr_codec.c (UWB-230) against the extended deca_driver mock (see
 * mock_deca_driver.h) — an RX *queue*, since a single
 * twr_responder_run_once() attempt can call dw1000_rx() up to twice (POLL
 * wait, FINAL wait).
 *
 * Covers:
 *   - Full exchange happy path: POLL -> RESPONSE scheduled with the right
 *     exchange_id / T2 / T3=T2+delay, matching FINAL -> T1/T4/T5 extracted +
 *     T6 captured, debug-range formula matches a hand-calc fixture
 *     (CONFIG_UWB_TWR_RESPONDER_DEBUG_RANGE=1, injected in CMakeLists.txt).
 *   - No POLL heard (timeout) -> TWR_RESPONDER_NO_POLL, no RESPONSE built.
 *   - POLL heard but wrong destination address -> TWR_RESPONDER_FOREIGN_FRAME.
 *   - Malformed/wrong-frame-type frame while waiting for POLL ->
 *     TWR_RESPONDER_FOREIGN_FRAME.
 *   - RESPONSE scheduling fails (HPDWARN) -> TWR_RESPONDER_TX_ERROR, no FINAL
 *     wait attempted.
 *   - POLL answered but no FINAL before timeout -> TWR_RESPONDER_NO_FINAL.
 *   - FINAL heard but exchange_id mismatch -> TWR_RESPONDER_FINAL_MISMATCH.
 *   - out == NULL does not crash the happy path.
 *   - uwb_twr_range_mm() as a pure function: hand-calc fixture + degenerate
 *     (all-zero deltas) denominator guard.
 *
 * @attention
 * SPDX-License-Identifier: MIT
 * Copyright (c) 2024 Fundamentals UWB project contributors.
 */

#include <string.h>

#include <zephyr/ztest.h>

#include "deca_device_api.h"
#include "deca_regs.h"
#include "dw1000_ranging.h"
#include "mock_deca_driver.h"
#include "twr_responder.h"
#include "uwb_frames.h"
#include "uwb_twr_codec.h"

/* ---------------------------------------------------------------------------
 * Suite setup / teardown
 * --------------------------------------------------------------------------- */
static void before_each(void *fixture)
{
    (void)fixture;
    mock_deca_reset();
}

ZTEST_SUITE(twr_responder, NULL, NULL, before_each, NULL, NULL);

/* ---------------------------------------------------------------------------
 * Test frame builders -- hand-packed byte buffers, deliberately independent
 * of twr_responder.c's own use of uwb_build_twr_response()/uwb_parse_twr_*()
 * so these tests do not become tautological. Mirrors
 * tests/twr_codec/src/test_twr_codec.c's build_poll_frame()/build_final_frame().
 * --------------------------------------------------------------------------- */

static void local_write_le16(uint8_t out[2], uint16_t v)
{
    out[0] = (uint8_t)(v & 0xFFU);
    out[1] = (uint8_t)((v >> 8) & 0xFFU);
}

static uint16_t local_read_le16(const uint8_t *p)
{
    return (uint16_t)((uint16_t)p[0] | ((uint16_t)p[1] << 8));
}

static void ts_to_le5(uint8_t out[5], uint64_t ts)
{
    uwb_ts_write40(out, ts);
}

static void build_poll_frame(uint8_t out[UWB_TWR_POLL_FRAME_SIZE],
                              uint16_t initiator_addr, uint16_t responder_addr,
                              uint8_t seq, uint16_t exchange_id)
{
    uwb_twr_poll_frame_t *frame = (uwb_twr_poll_frame_t *)out;

    frame->hdr.mac.frame_ctrl[0] = UWB_FRAME_CTRL_LOW;
    frame->hdr.mac.frame_ctrl[1] = UWB_FRAME_CTRL_HIGH;
    frame->hdr.mac.seq_num = seq;
    local_write_le16(frame->hdr.mac.pan_id, UWB_PAN_ID);
    local_write_le16(frame->hdr.mac.dest_addr, responder_addr);
    local_write_le16(frame->hdr.mac.src_addr, initiator_addr);
    frame->hdr.frame_type = (uint8_t)UWB_FRAME_TYPE_TWR_POLL;
    local_write_le16(frame->payload.exchange_id, exchange_id);
}

static void build_final_frame(uint8_t out[UWB_TWR_FINAL_FRAME_SIZE],
                               uint16_t initiator_addr, uint16_t responder_addr,
                               uint8_t seq, uint16_t exchange_id,
                               uint64_t poll_tx_ts, uint64_t resp_rx_ts,
                               uint64_t final_tx_ts)
{
    uwb_twr_final_frame_t *frame = (uwb_twr_final_frame_t *)out;

    frame->hdr.mac.frame_ctrl[0] = UWB_FRAME_CTRL_LOW;
    frame->hdr.mac.frame_ctrl[1] = UWB_FRAME_CTRL_HIGH;
    frame->hdr.mac.seq_num = seq;
    local_write_le16(frame->hdr.mac.pan_id, UWB_PAN_ID);
    local_write_le16(frame->hdr.mac.dest_addr, responder_addr);
    local_write_le16(frame->hdr.mac.src_addr, initiator_addr);
    frame->hdr.frame_type = (uint8_t)UWB_FRAME_TYPE_TWR_FINAL;
    local_write_le16(frame->payload.exchange_id, exchange_id);
    uwb_ts_write40(frame->payload.poll_tx_ts, poll_tx_ts);
    uwb_ts_write40(frame->payload.resp_rx_ts, resp_rx_ts);
    uwb_ts_write40(frame->payload.final_tx_ts, final_tx_ts);
}

/* Convenience: push a well-formed good-frame RX event. */
static void push_good_frame(const uint8_t *buf, uint16_t len, uint64_t rx_ts)
{
    uint8_t ts_bytes[5];

    ts_to_le5(ts_bytes, rx_ts);
    mock_rx_queue_push(SYS_STATUS_RXFCG, (uint32)len, buf, len, ts_bytes);
}

/* ---------------------------------------------------------------------------
 * Test 1 -- full exchange happy path + debug-range formula
 * --------------------------------------------------------------------------- */
ZTEST(twr_responder, test_full_exchange_builds_response_and_captures_final)
{
    const uint16_t self_addr = 0x0002;
    const uint16_t initiator_addr = 0x0001;
    const uint16_t exchange_id = 0x1234;

    /* T2: this responder's POLL RX timestamp -- arbitrary but realistic
     * magnitude (well below the 40-bit range, no wraparound). */
    const uint64_t t2 = 1000000ULL;

    /* T3 is *derived*, not chosen: twr_responder.c computes it as
     * dw1000_delayed_tx_time(T2, CONFIG_UWB_TWR_RESP_REPLY_DELAY_DTU) --
     * calling the same (already unit-tested in tests/dw1000_ranging, UWB-231)
     * pure function here keeps this fixture correct even if the Kconfig
     * default reply delay changes. */
    const uint64_t t3 = dw1000_delayed_tx_time(t2, CONFIG_UWB_TWR_RESP_REPLY_DELAY_DTU);

    /* Construct T1/T4/T5/T6 for a clean hand-calc ToF: mirror the
     * initiator's reply delay (T5-T4) against the responder's own (T3-T2),
     * and use the same round-trip (T4-T1 == T6-T3) on both sides. Under that
     * symmetry the DS-TWR formula collapses to ToF = (T_round - T_reply)/2
     * (see uwb_frames.h's DS-TWR range formula comment for the general
     * form); picking T_round = T_reply + 2000 ticks gives an exact,
     * remainder-free ToF = 1000 ticks. */
    const uint64_t t_reply = t3 - t2;
    const uint64_t desired_tof_ticks = 1000ULL;
    const uint64_t t_round = t_reply + (2ULL * desired_tof_ticks);

    const uint64_t t1 = 500000ULL;             /* initiator's POLL TX timestamp */
    const uint64_t t4 = t1 + t_round;          /* initiator's RESPONSE RX timestamp */
    const uint64_t t5 = t4 + t_reply;          /* initiator's scheduled FINAL TX timestamp */
    const uint64_t t6 = t3 + t_round;          /* this responder's FINAL RX timestamp */

    uint8_t poll_buf[UWB_TWR_POLL_FRAME_SIZE];
    uint8_t final_buf[UWB_TWR_FINAL_FRAME_SIZE];

    build_poll_frame(poll_buf, initiator_addr, self_addr, 0x01, exchange_id);
    push_good_frame(poll_buf, sizeof(poll_buf), t2);

    build_final_frame(final_buf, initiator_addr, self_addr, 0x02, exchange_id,
                       t1, t4, t5);
    push_good_frame(final_buf, sizeof(final_buf), t6);

    uwb_twr_exchange_t out;
    twr_responder_status_t status = twr_responder_run_once(self_addr, &out);

    zassert_equal(status, TWR_RESPONDER_EXCHANGE_OK,
        "expected TWR_RESPONDER_EXCHANGE_OK, got %d", (int)status);

    zassert_equal(mock_rxenable_state.called, 2,
        "expected two dw1000_rx() attempts (POLL wait + FINAL wait); got %d",
        mock_rxenable_state.called);

    /* --- RESPONSE scheduling: right exchange_id, T2, T3=T2+delay --------- */
    zassert_equal(mock_delayedtrxtime_state.called, 1,
        "expected dwt_setdelayedtrxtime() called once; got %d",
        mock_delayedtrxtime_state.called);
    zassert_equal(mock_delayedtrxtime_state.starttime, (uint32)(t3 >> 8),
        "dwt_setdelayedtrxtime(): expected high 32 bits of T3 (0x%08X); got 0x%08X",
        (unsigned)(t3 >> 8), (unsigned)mock_delayedtrxtime_state.starttime);

    zassert_equal(mock_tx_state.writetxdata_called, 1,
        "expected dwt_writetxdata() called once; got %d",
        mock_tx_state.writetxdata_called);
    zassert_equal(mock_tx_state.writetxdata_len,
        (uint16)(UWB_TWR_RESPONSE_FRAME_SIZE + 2u),
        "writetxdata length must be the RESPONSE PSDU size + 2-byte CRC: "
        "expected %u; got %u",
        (unsigned)(UWB_TWR_RESPONSE_FRAME_SIZE + 2u),
        (unsigned)mock_tx_state.writetxdata_len);

    const uint8_t *resp = mock_tx_state.writetxdata_buf;

    zassert_equal(local_read_le16(&resp[UWB_OFF_DEST_ADDR]), initiator_addr,
        "RESPONSE dest_addr must be the initiator's address");
    zassert_equal(local_read_le16(&resp[UWB_OFF_SRC_ADDR]), self_addr,
        "RESPONSE src_addr must be this responder's address");
    zassert_equal(resp[UWB_OFF_FRAME_TYPE], (uint8_t)UWB_FRAME_TYPE_TWR_RESPONSE,
        "RESPONSE frame_type");
    zassert_equal(local_read_le16(&resp[UWB_OFF_TWR_EXCHANGE_ID]), exchange_id,
        "RESPONSE exchange_id must echo the POLL's exchange_id");
    zassert_equal(uwb_ts_read40(&resp[UWB_OFF_TWR_RESP_POLL_RX_TS]), t2,
        "RESPONSE poll_rx_ts (T2): expected 0x%llX, got 0x%llX",
        (unsigned long long)t2,
        (unsigned long long)uwb_ts_read40(&resp[UWB_OFF_TWR_RESP_POLL_RX_TS]));
    zassert_equal(uwb_ts_read40(&resp[UWB_OFF_TWR_RESP_RESP_TX_TS]), t3,
        "RESPONSE resp_tx_ts (T3): expected 0x%llX, got 0x%llX",
        (unsigned long long)t3,
        (unsigned long long)uwb_ts_read40(&resp[UWB_OFF_TWR_RESP_RESP_TX_TS]));

    zassert_equal(mock_starttx_state.called, 1,
        "expected dwt_starttx() called once; got %d", mock_starttx_state.called);
    zassert_true((mock_starttx_state.mode & (uint8_t)DWT_RESPONSE_EXPECTED) != 0,
        "dwt_starttx() mode must include DWT_RESPONSE_EXPECTED (0x%02X); got 0x%02X",
        (unsigned)DWT_RESPONSE_EXPECTED, (unsigned)mock_starttx_state.mode);
    zassert_true((mock_starttx_state.mode & (uint8_t)DWT_START_TX_DELAYED) != 0,
        "dwt_starttx() mode must include DWT_START_TX_DELAYED");

    /* --- FINAL capture: T1/T4/T5 extracted, T6 captured ------------------- */
    zassert_equal(out.initiator_addr, initiator_addr, "out.initiator_addr");
    zassert_equal(out.exchange_id, exchange_id, "out.exchange_id");
    zassert_equal(out.poll_tx_ts, t1, "out.poll_tx_ts (T1)");
    zassert_equal(out.poll_rx_ts, t2, "out.poll_rx_ts (T2)");
    zassert_equal(out.resp_tx_ts, t3, "out.resp_tx_ts (T3)");
    zassert_equal(out.resp_rx_ts, t4, "out.resp_rx_ts (T4)");
    zassert_equal(out.final_tx_ts, t5, "out.final_tx_ts (T5)");
    zassert_equal(out.final_rx_ts, t6, "out.final_rx_ts (T6)");

    /* --- Debug range: CONFIG_UWB_TWR_RESPONDER_DEBUG_RANGE=1 (injected in
     * CMakeLists.txt) -- 1000 ticks * 4.691763 mm/tick = 4691.763 mm,
     * truncates to 4691. Hand-calculated independently of the production
     * constant to avoid a tautological check; allow +/-1mm for any
     * double-rounding difference. --------------------------------------- */
    const int64_t expected_range_mm = 4691;
    int64_t diff = out.range_mm - expected_range_mm;

    if (diff < 0) {
        diff = -diff;
    }
    zassert_true(diff <= 1,
        "range_mm: expected ~%lld mm, got %lld mm",
        (long long)expected_range_mm, (long long)out.range_mm);
}

/* ---------------------------------------------------------------------------
 * Test 2 -- out == NULL does not crash the happy path
 * --------------------------------------------------------------------------- */
ZTEST(twr_responder, test_full_exchange_with_null_out_does_not_crash)
{
    const uint16_t self_addr = 0x0002;
    const uint16_t initiator_addr = 0x0001;
    const uint16_t exchange_id = 0x0042;
    const uint64_t t2 = 2000000ULL;
    const uint64_t t3 = dw1000_delayed_tx_time(t2, CONFIG_UWB_TWR_RESP_REPLY_DELAY_DTU);

    uint8_t poll_buf[UWB_TWR_POLL_FRAME_SIZE];
    uint8_t final_buf[UWB_TWR_FINAL_FRAME_SIZE];

    build_poll_frame(poll_buf, initiator_addr, self_addr, 0x01, exchange_id);
    push_good_frame(poll_buf, sizeof(poll_buf), t2);

    build_final_frame(final_buf, initiator_addr, self_addr, 0x02, exchange_id,
                       100ULL, t3 + 200ULL, t3 + 300ULL);
    push_good_frame(final_buf, sizeof(final_buf), t3 + 400ULL);

    twr_responder_status_t status = twr_responder_run_once(self_addr, NULL);

    zassert_equal(status, TWR_RESPONDER_EXCHANGE_OK,
        "expected TWR_RESPONDER_EXCHANGE_OK with out=NULL, got %d", (int)status);
}

/* ---------------------------------------------------------------------------
 * Test 3 -- no POLL heard before the RX timeout: stays armed, no error
 * --------------------------------------------------------------------------- */
ZTEST(twr_responder, test_no_poll_returns_no_poll_and_does_not_tx)
{
    /* No RX events pushed -- dwt_rxenable()'s first call falls through to
     * the mock's default frame-wait-timeout event. */
    uwb_twr_exchange_t out;

    twr_responder_status_t status = twr_responder_run_once(0x0002, &out);

    zassert_equal(status, TWR_RESPONDER_NO_POLL,
        "expected TWR_RESPONDER_NO_POLL, got %d", (int)status);
    zassert_equal(mock_rxenable_state.called, 1,
        "expected exactly one dw1000_rx() attempt; got %d",
        mock_rxenable_state.called);
    zassert_equal(mock_delayedtrxtime_state.called, 0,
        "no RESPONSE should be scheduled when no POLL was heard");
    zassert_equal(mock_tx_state.writetxdata_called, 0,
        "no RESPONSE should be built/sent when no POLL was heard");

    /* out must be left zeroed (memset at function entry). */
    zassert_equal(out.exchange_id, 0, "out must be zeroed on TWR_RESPONDER_NO_POLL");
    zassert_equal(out.poll_rx_ts, 0, "out must be zeroed on TWR_RESPONDER_NO_POLL");
}

/* ---------------------------------------------------------------------------
 * Test 4 -- POLL heard but addressed to a different short address: ignored
 * --------------------------------------------------------------------------- */
ZTEST(twr_responder, test_poll_wrong_dest_addr_is_foreign_frame)
{
    uint8_t poll_buf[UWB_TWR_POLL_FRAME_SIZE];

    /* Addressed to 0x0099, but we run the responder as 0x0002. */
    build_poll_frame(poll_buf, 0x0001, 0x0099, 0x01, 0x5555);
    push_good_frame(poll_buf, sizeof(poll_buf), 12345ULL);

    twr_responder_status_t status = twr_responder_run_once(0x0002, NULL);

    zassert_equal(status, TWR_RESPONDER_FOREIGN_FRAME,
        "expected TWR_RESPONDER_FOREIGN_FRAME for wrong dest_addr, got %d",
        (int)status);
    zassert_equal(mock_rxenable_state.called, 1,
        "expected exactly one dw1000_rx() attempt; got %d",
        mock_rxenable_state.called);
    zassert_equal(mock_delayedtrxtime_state.called, 0,
        "no RESPONSE should be scheduled for a POLL addressed elsewhere");
}

/* ---------------------------------------------------------------------------
 * Test 5 -- malformed / wrong-frame-type frame heard while waiting for POLL
 * --------------------------------------------------------------------------- */
ZTEST(twr_responder, test_wrong_frame_type_while_waiting_for_poll_is_foreign_frame)
{
    uint8_t poll_buf[UWB_TWR_POLL_FRAME_SIZE];

    build_poll_frame(poll_buf, 0x0001, 0x0002, 0x01, 0x5555);
    /* Corrupt the frame_type so uwb_parse_twr_poll() rejects it. */
    poll_buf[UWB_OFF_FRAME_TYPE] = (uint8_t)UWB_FRAME_TYPE_TWR_RESPONSE;
    push_good_frame(poll_buf, sizeof(poll_buf), 12345ULL);

    twr_responder_status_t status = twr_responder_run_once(0x0002, NULL);

    zassert_equal(status, TWR_RESPONDER_FOREIGN_FRAME,
        "expected TWR_RESPONDER_FOREIGN_FRAME for a malformed POLL, got %d",
        (int)status);
    zassert_equal(mock_delayedtrxtime_state.called, 0,
        "no RESPONSE should be scheduled for a malformed POLL");
}

/* ---------------------------------------------------------------------------
 * Test 6 -- a valid POLL is heard but dw1000_tx_at() misses the scheduled
 * slot (HPDWARN): abort, no FINAL wait attempted
 * --------------------------------------------------------------------------- */
ZTEST(twr_responder, test_response_tx_failure_aborts_without_waiting_for_final)
{
    uint8_t poll_buf[UWB_TWR_POLL_FRAME_SIZE];

    build_poll_frame(poll_buf, 0x0001, 0x0002, 0x01, 0x7777);
    push_good_frame(poll_buf, sizeof(poll_buf), 999ULL);

    mock_starttx_state.return_value = DWT_ERROR;

    twr_responder_status_t status = twr_responder_run_once(0x0002, NULL);

    zassert_equal(status, TWR_RESPONDER_TX_ERROR,
        "expected TWR_RESPONDER_TX_ERROR, got %d", (int)status);
    zassert_equal(mock_starttx_state.called, 1,
        "expected dwt_starttx() called once; got %d", mock_starttx_state.called);
    zassert_equal(mock_rxenable_state.called, 1,
        "no FINAL wait should be attempted after a failed RESPONSE tx; "
        "expected exactly one dw1000_rx() attempt, got %d",
        mock_rxenable_state.called);
}

/* ---------------------------------------------------------------------------
 * Test 7 -- POLL answered, but no FINAL heard before the RX timeout
 * --------------------------------------------------------------------------- */
ZTEST(twr_responder, test_no_final_after_response_returns_no_final)
{
    uint8_t poll_buf[UWB_TWR_POLL_FRAME_SIZE];

    build_poll_frame(poll_buf, 0x0001, 0x0002, 0x01, 0x8888);
    push_good_frame(poll_buf, sizeof(poll_buf), 555ULL);
    /* No second event pushed -- the FINAL-wait dw1000_rx() call falls
     * through to the mock's default frame-wait-timeout event. */

    twr_responder_status_t status = twr_responder_run_once(0x0002, NULL);

    zassert_equal(status, TWR_RESPONDER_NO_FINAL,
        "expected TWR_RESPONDER_NO_FINAL, got %d", (int)status);
    zassert_equal(mock_rxenable_state.called, 2,
        "expected two dw1000_rx() attempts (POLL wait + FINAL wait); got %d",
        mock_rxenable_state.called);
    zassert_equal(mock_tx_state.writetxdata_called, 1,
        "RESPONSE must still have been sent before the FINAL wait; got %d",
        mock_tx_state.writetxdata_called);
}

/* ---------------------------------------------------------------------------
 * Test 8 -- a FINAL is heard, but its exchange_id does not match the
 * pending exchange: ignored
 * --------------------------------------------------------------------------- */
ZTEST(twr_responder, test_final_exchange_id_mismatch_is_ignored)
{
    const uint16_t exchange_id = 0x1111;
    const uint16_t wrong_exchange_id = 0x2222;

    uint8_t poll_buf[UWB_TWR_POLL_FRAME_SIZE];
    uint8_t final_buf[UWB_TWR_FINAL_FRAME_SIZE];

    build_poll_frame(poll_buf, 0x0001, 0x0002, 0x01, exchange_id);
    push_good_frame(poll_buf, sizeof(poll_buf), 111ULL);

    build_final_frame(final_buf, 0x0001, 0x0002, 0x02, wrong_exchange_id,
                       10ULL, 20ULL, 30ULL);
    push_good_frame(final_buf, sizeof(final_buf), 40ULL);

    twr_responder_status_t status = twr_responder_run_once(0x0002, NULL);

    zassert_equal(status, TWR_RESPONDER_FINAL_MISMATCH,
        "expected TWR_RESPONDER_FINAL_MISMATCH, got %d", (int)status);
}

/* ---------------------------------------------------------------------------
 * Test 9 -- uwb_twr_range_mm(): pure function, hand-calc fixture
 * --------------------------------------------------------------------------- */
ZTEST(twr_responder, test_range_mm_hand_calc_fixture)
{
    /* T_round1 = T_round2 = 3000, T_reply1 = T_reply2 = 1000 ->
     * ToF = (3000*3000 - 1000*1000) / (3000+3000+1000+1000)
     *     = (9,000,000 - 1,000,000) / 8000 = 1000 ticks
     *     -> 1000 * 4.691763 mm/tick = 4691.763 mm -> truncates to 4691. */
    const uint64_t t1 = 10000ULL;
    const uint64_t t2 = 10300ULL;
    const uint64_t t3 = 11300ULL;
    const uint64_t t4 = 13000ULL;
    const uint64_t t5 = 14000ULL;
    const uint64_t t6 = 14300ULL;

    int64_t range_mm = uwb_twr_range_mm(t1, t2, t3, t4, t5, t6);
    int64_t diff = range_mm - 4691;

    if (diff < 0) {
        diff = -diff;
    }
    zassert_true(diff <= 1,
        "expected range_mm ~= 4691, got %lld", (long long)range_mm);
}

ZTEST(twr_responder, test_range_mm_degenerate_zero_denominator)
{
    /* All six timestamps equal -> every T_round/T_reply delta is 0 ->
     * denominator 0 -> the function must return 0, not divide by zero. */
    int64_t range_mm = uwb_twr_range_mm(42ULL, 42ULL, 42ULL, 42ULL, 42ULL, 42ULL);

    zassert_equal(range_mm, 0,
        "expected 0 for a degenerate (zero-denominator) input, got %lld",
        (long long)range_mm);
}
```
