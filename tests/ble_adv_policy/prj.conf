## CMakeLists.txt
```
cmake_minimum_required(VERSION 3.20.0)

# Zephyr unit test build for the BLE advertising duty-cycle policy decision
# function (UWB-320). Mirrors tests/image_health's pure-decision host-test
# pattern (UWB-266).
#
# What is compiled:
#   ble_adv_policy.c          — the module under test (UWB-320); pure
#                                decision logic, no Zephyr includes.
#   test_ble_adv_policy.c      — ztest assertions
#
# ble_adv_policy_zephyr.c (the real bt_le_adv_start/stop wiring, which needs
# the Zephyr BT stack) is intentionally NOT compiled here — that half is
# Zephyr/hardware-only and is exercised by the real board build + the
# README "Hardware bring-up checklist", not this host test.
#
# Platform: unit_testing  (native host executable, no emulation)
# Run:  west twister -p unit_testing -T tests/ble_adv_policy -v

project(test_ble_adv_policy)
find_package(Zephyr COMPONENTS unittest REQUIRED HINTS $ENV{ZEPHYR_BASE})

set(SRC_DIR ${CMAKE_CURRENT_SOURCE_DIR}/../../src)

target_sources(testbinary PRIVATE
    src/test_ble_adv_policy.c
    ${SRC_DIR}/ble_adv_policy.c
)

target_include_directories(testbinary PRIVATE
    ${SRC_DIR}  # ble_adv_policy.h
)
```

## prj.conf
```kconfig
# tests/ble_adv_policy/prj.conf
# Minimal config for the unit_testing platform — only ztest is needed.
CONFIG_ZTEST=y
```

## src/test_ble_adv_policy.c
```c
/*! ----------------------------------------------------------------------------
 * @file    test_ble_adv_policy.c
 * @brief   ztest suite: BLE advertising duty-cycle policy decision logic
 *          (UWB-320, ADR-0046 point 4)
 *
 * Platform: unit_testing (native-hosted, no Zephyr kernel, no real BLE
 * stack).
 *
 * Exercises only ble_adv_policy_should_advertise() -- the pure decision
 * function. ble_adv_policy_zephyr.c (the real bt_le_adv_start/stop wiring)
 * is not compiled into this test binary; it is exercised by the real board
 * build + the on-device bring-up checklist (README.md).
 *
 * Covers, per the UWB-320 acceptance criteria:
 *   - Bench profile (low_power_profile=false): advertising wanted in both
 *     ACTIVE and STANDBY -- "bench build advertising unchanged (always on)".
 *   - Low-power profile (low_power_profile=true): advertising suppressed in
 *     ACTIVE, wanted in STANDBY -- "low-power build does not advertise
 *     while ACTIVE and advertises in STANDBY".
 *
 * @attention
 * SPDX-License-Identifier: MIT
 * Copyright (c) 2024 Fundamentals UWB project contributors.
 */

#include <zephyr/ztest.h>

#include "ble_adv_policy.h"

ZTEST_SUITE(ble_adv_policy, NULL, NULL, NULL, NULL, NULL);

ZTEST(ble_adv_policy, test_bench_profile_advertises_while_active)
{
	zassert_true(
		ble_adv_policy_should_advertise(false, BLE_ADV_POLICY_STATE_ACTIVE),
		"bench profile must keep advertising even while ACTIVE");
}

ZTEST(ble_adv_policy, test_bench_profile_advertises_while_standby)
{
	zassert_true(
		ble_adv_policy_should_advertise(false, BLE_ADV_POLICY_STATE_STANDBY),
		"bench profile must advertise while STANDBY");
}

ZTEST(ble_adv_policy, test_low_power_profile_suppresses_while_active)
{
	zassert_false(
		ble_adv_policy_should_advertise(true, BLE_ADV_POLICY_STATE_ACTIVE),
		"low-power profile must suppress advertising while ACTIVE");
}

ZTEST(ble_adv_policy, test_low_power_profile_advertises_while_standby)
{
	zassert_true(
		ble_adv_policy_should_advertise(true, BLE_ADV_POLICY_STATE_STANDBY),
		"low-power profile must advertise while STANDBY");
}
```
