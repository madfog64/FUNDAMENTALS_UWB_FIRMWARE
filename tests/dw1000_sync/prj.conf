## CMakeLists.txt
```
cmake_minimum_required(VERSION 3.20.0)

# Zephyr unit test build for the dw1000_sync module (UWB-242).
#
# Mirrors tests/dw1000_ranging's unit_testing pattern: a mocked deca_driver so
# assertions can inspect the exact register/API arguments dw1000_rx() drives
# (dw1000_sync.c reuses dw1000_ranging.c's dw1000_rx() -- see dw1000_sync.h),
# without any real SPI/hardware.
#
# What is compiled:
#   dw1000_sync.c           — the module under test (UWB-242)
#   dw1000_ranging.c        — dw1000_rx() + 40-bit timestamp helpers (UWB-231),
#                             reused (not reimplemented) by dw1000_sync.c
#   mock_deca_driver.c      — mocks dwt_setrxtimeout(), dwt_rxenable(),
#                             dwt_forcetrxoff(), dwt_read32bitoffsetreg(),
#                             dwt_write32bitoffsetreg(), dwt_readrxdata(),
#                             dwt_readrxtimestamp(), dwt_readtxtimestamp(),
#                             dwt_setdelayedtrxtime(), dwt_writetxdata(),
#                             dwt_writetxfctrl(), dwt_starttx()
#                             (copied verbatim from tests/dw1000_ranging/ --
#                             dw1000_ranging.c is compiled unmodified here, so
#                             it needs the same mock surface, even though this
#                             suite only exercises the RX half.)
#   mock_log.c              — stubs z_log_minimal_printk() (same rationale and
#                             pattern as tests/dw1000_config/src/mock_port.c
#                             and tests/dw1000_ranging/src/mock_log.c): the
#                             unit_testing defconfig enables CONFIG_LOG=y, so
#                             dw1000_ranging.c's LOG_ERR()/LOG_DBG() calls need
#                             this symbol at link time.
#   test_dw1000_sync.c      — ztest assertions
#
# Note: deca_device.c is intentionally NOT compiled here (same rationale as
# tests/dw1000_ranging): the mock replaces every deca_driver API function
# dw1000_ranging.c calls, so assertions can verify argument values directly
# without SPI decoding.
#
# Platform: unit_testing  (native host executable, no emulation)
# Run:  west twister -p unit_testing -T tests/dw1000_sync -v

project(test_dw1000_sync)
find_package(Zephyr COMPONENTS unittest REQUIRED HINTS $ENV{ZEPHYR_BASE})

set(DW1000_DIR ${CMAKE_CURRENT_SOURCE_DIR}/../../drivers/dw1000)

target_sources(testbinary PRIVATE
    src/test_dw1000_sync.c
    src/mock_deca_driver.c
    src/mock_log.c
    ${DW1000_DIR}/dw1000_sync.c
    ${DW1000_DIR}/dw1000_ranging.c
)

target_include_directories(testbinary PRIVATE
    ${DW1000_DIR}/deca_driver        # deca_device_api.h, deca_regs.h
    ${DW1000_DIR}                    # dw1000_sync.h, dw1000_ranging.h, uwb_frames.h
    ${CMAKE_CURRENT_SOURCE_DIR}/src  # mock_deca_driver.h
)
```

## prj.conf
```kconfig
# tests/dw1000_sync/prj.conf
# Minimal config for the unit_testing platform — only ztest is needed.
CONFIG_ZTEST=y
```

## src/mock_deca_driver.c
```c
/*! ----------------------------------------------------------------------------
 * @file    mock_deca_driver.c
 * @brief   Mock implementations of deca_driver API functions called by
 *          dw1000_ranging.c (dw1000_rx(), reused by dw1000_sync.c -- UWB-242
 *          unit tests). Copied verbatim from tests/dw1000_ranging/ (UWB-231).
 *
 * These stubs have no hardware or SPI dependencies. Register reads
 * (dwt_read32bitoffsetreg, via the dwt_read32bitreg() macro) return the
 * test-configured mock_reg_state.sys_status / mock_reg_state.rx_finfo values
 * depending on the requested register file ID (SYS_STATUS_ID / RX_FINFO_ID).
 * Register writes are captured, and additionally applied as a bit-clear
 * against mock_reg_state.sys_status when regFileID == SYS_STATUS_ID, mirroring
 * the DW1000's write-1-to-clear semantics for that register — this keeps a
 * test's pre-configured status word self-consistent if a test inspects it
 * again after the call under test returns.
 *
 * @attention
 * SPDX-License-Identifier: MIT
 * Copyright (c) 2024 Fundamentals UWB project contributors.
 */

#include <string.h>

#include "deca_device_api.h"
#include "deca_regs.h"
#include "mock_deca_driver.h"

/* ---------------------------------------------------------------------------
 * Captured / configurable state (inspected and pre-configured by tests)
 * --------------------------------------------------------------------------- */
struct mock_rxtimeout_state       mock_rxtimeout_state;
struct mock_rxenable_state        mock_rxenable_state;
struct mock_forcetrxoff_state     mock_forcetrxoff_state;
struct mock_reg_state             mock_reg_state;
struct mock_readrxdata_state      mock_readrxdata_state;
struct mock_timestamp_state       mock_timestamp_state;
struct mock_delayedtrxtime_state  mock_delayedtrxtime_state;
struct mock_tx_state              mock_tx_state;
struct mock_starttx_state         mock_starttx_state;

void mock_deca_reset(void)
{
    memset(&mock_rxtimeout_state,      0, sizeof(mock_rxtimeout_state));
    memset(&mock_rxenable_state,       0, sizeof(mock_rxenable_state));
    memset(&mock_forcetrxoff_state,    0, sizeof(mock_forcetrxoff_state));
    memset(&mock_reg_state,            0, sizeof(mock_reg_state));
    memset(&mock_readrxdata_state,     0, sizeof(mock_readrxdata_state));
    memset(&mock_timestamp_state,      0, sizeof(mock_timestamp_state));
    memset(&mock_delayedtrxtime_state, 0, sizeof(mock_delayedtrxtime_state));
    memset(&mock_tx_state,             0, sizeof(mock_tx_state));
    memset(&mock_starttx_state,        0, sizeof(mock_starttx_state));

    /* Defaults: every deca_driver call that can fail reports success. */
    mock_rxenable_state.return_value      = DWT_SUCCESS;
    mock_tx_state.writetxdata_return_value = DWT_SUCCESS;
    mock_starttx_state.return_value        = DWT_SUCCESS;
}

/* ---------------------------------------------------------------------------
 * Mock dwt_setrxtimeout
 * --------------------------------------------------------------------------- */
void dwt_setrxtimeout(uint16 time)
{
    mock_rxtimeout_state.called = 1;
    mock_rxtimeout_state.time   = time;
}

/* ---------------------------------------------------------------------------
 * Mock dwt_rxenable
 * --------------------------------------------------------------------------- */
int dwt_rxenable(int mode)
{
    mock_rxenable_state.called = 1;
    mock_rxenable_state.mode   = mode;
    return mock_rxenable_state.return_value;
}

/* ---------------------------------------------------------------------------
 * Mock dwt_forcetrxoff
 * --------------------------------------------------------------------------- */
void dwt_forcetrxoff(void)
{
    mock_forcetrxoff_state.called++;
}

/* ---------------------------------------------------------------------------
 * Mock dwt_read32bitoffsetreg (backs the dwt_read32bitreg() macro)
 *
 * Returns mock_reg_state.sys_status for SYS_STATUS_ID, mock_reg_state.rx_finfo
 * for RX_FINFO_ID, and 0 for anything else.
 * --------------------------------------------------------------------------- */
uint32 dwt_read32bitoffsetreg(int regFileID, int regOffset)
{
    (void)regOffset;

    if (regFileID == SYS_STATUS_ID) {
        return mock_reg_state.sys_status;
    }
    if (regFileID == RX_FINFO_ID) {
        return mock_reg_state.rx_finfo;
    }
    return 0u;
}

/* ---------------------------------------------------------------------------
 * Mock dwt_write32bitoffsetreg (backs the dwt_write32bitreg() macro)
 *
 * Captures the last register/value written. When writing SYS_STATUS_ID,
 * clears the written bits from mock_reg_state.sys_status (write-1-to-clear,
 * matching real DW1000 SYS_STATUS semantics).
 * --------------------------------------------------------------------------- */
void dwt_write32bitoffsetreg(int regFileID, int regOffset, uint32 regval)
{
    (void)regOffset;

    mock_reg_state.last_write_reg = (uint32)regFileID;
    mock_reg_state.last_write_val = regval;
    mock_reg_state.write_count++;

    if (regFileID == SYS_STATUS_ID) {
        mock_reg_state.sys_status &= ~regval;
    }
}

/* ---------------------------------------------------------------------------
 * Mock dwt_readrxdata
 *
 * Captures length/offset and copies the test-injected payload bytes into the
 * caller's buffer.
 * --------------------------------------------------------------------------- */
void dwt_readrxdata(uint8 *buffer, uint16 length, uint16 rxBufferOffset)
{
    uint16 copy_len = length;

    mock_readrxdata_state.called = 1;
    mock_readrxdata_state.length = length;
    mock_readrxdata_state.offset = rxBufferOffset;

    if (copy_len > MOCK_MAX_FRAME_LEN) {
        copy_len = MOCK_MAX_FRAME_LEN;
    }
    if (buffer != NULL) {
        memcpy(buffer, mock_readrxdata_state.injected_payload, copy_len);
    }
}

/* ---------------------------------------------------------------------------
 * Mock dwt_readrxtimestamp / dwt_readtxtimestamp
 * --------------------------------------------------------------------------- */
void dwt_readrxtimestamp(uint8 *timestamp)
{
    mock_timestamp_state.rx_called++;
    if (timestamp != NULL) {
        memcpy(timestamp, mock_timestamp_state.rx_ts_bytes, 5);
    }
}

void dwt_readtxtimestamp(uint8 *timestamp)
{
    mock_timestamp_state.tx_called++;
    if (timestamp != NULL) {
        memcpy(timestamp, mock_timestamp_state.tx_ts_bytes, 5);
    }
}

/* ---------------------------------------------------------------------------
 * Mock dwt_setdelayedtrxtime
 * --------------------------------------------------------------------------- */
void dwt_setdelayedtrxtime(uint32 starttime)
{
    mock_delayedtrxtime_state.called    = 1;
    mock_delayedtrxtime_state.starttime = starttime;
}

/* ---------------------------------------------------------------------------
 * Mock dwt_writetxdata
 * --------------------------------------------------------------------------- */
int dwt_writetxdata(uint16 txFrameLength, uint8 *txFrameBytes, uint16 txBufferOffset)
{
    uint16 copy_len = txFrameLength;

    mock_tx_state.writetxdata_called = 1;
    mock_tx_state.writetxdata_len    = txFrameLength;
    mock_tx_state.writetxdata_offset = txBufferOffset;

    if (copy_len > MOCK_MAX_FRAME_LEN) {
        copy_len = MOCK_MAX_FRAME_LEN;
    }
    if (txFrameBytes != NULL) {
        memcpy(mock_tx_state.writetxdata_buf, txFrameBytes, copy_len);
    }

    return mock_tx_state.writetxdata_return_value;
}

/* ---------------------------------------------------------------------------
 * Mock dwt_writetxfctrl
 * --------------------------------------------------------------------------- */
void dwt_writetxfctrl(uint16 txFrameLength, uint16 txBufferOffset, int ranging)
{
    mock_tx_state.writetxfctrl_called  = 1;
    mock_tx_state.writetxfctrl_len     = txFrameLength;
    mock_tx_state.writetxfctrl_offset  = txBufferOffset;
    mock_tx_state.writetxfctrl_ranging = ranging;
}

/* ---------------------------------------------------------------------------
 * Mock dwt_starttx
 * --------------------------------------------------------------------------- */
int dwt_starttx(uint8 mode)
{
    mock_starttx_state.called = 1;
    mock_starttx_state.mode   = mode;
    return mock_starttx_state.return_value;
}
```

## src/mock_deca_driver.h
```c
/*! ----------------------------------------------------------------------------
 * @file    mock_deca_driver.h
 * @brief   Mock state for the deca_driver API functions called by
 *          dw1000_ranging.c (dw1000_rx(), reused by dw1000_sync.c -- UWB-242
 *          unit tests). Copied verbatim from tests/dw1000_ranging/ (UWB-231)
 *          since dw1000_sync_rx() drives the exact same dw1000_rx() code
 *          path -- see that suite for the original rationale.
 *
 * Captured/configurable state is reset by mock_deca_reset() before each test.
 * Tests pre-configure the register-read state (mock_reg_state, injected
 * timestamp/payload bytes) before calling the function under test, then
 * assert on the captured call arguments.
 *
 * @attention
 * SPDX-License-Identifier: MIT
 * Copyright (c) 2024 Fundamentals UWB project contributors.
 */

#ifndef MOCK_DECA_DRIVER_H_
#define MOCK_DECA_DRIVER_H_

#include "deca_device_api.h"

/** Size of the scratch buffers used to capture RX/TX payload bytes. */
#define MOCK_MAX_FRAME_LEN  128

/**
 * State captured from mock dwt_setrxtimeout() call.
 */
struct mock_rxtimeout_state {
    int    called;   /**< Non-zero if dwt_setrxtimeout() was called. */
    uint16 time;     /**< The 'time' argument passed (DW1000 RX_FWTO units). */
};

/**
 * State captured from mock dwt_rxenable() call, and its configurable
 * return value.
 */
struct mock_rxenable_state {
    int called;         /**< Non-zero if dwt_rxenable() was called. */
    int mode;            /**< The 'mode' argument passed. */
    int return_value;   /**< Value dwt_rxenable() should return (default DWT_SUCCESS). */
};

/**
 * Call counter for mock dwt_forcetrxoff().
 */
struct mock_forcetrxoff_state {
    int called;
};

/**
 * Configurable register-read values and captured register writes, used for
 * both dw1000_rx()'s and dw1000_tx_at()'s SYS_STATUS/RX_FINFO polling.
 *
 * Set sys_status / rx_finfo BEFORE calling the function under test to drive
 * a specific scenario (good frame / RX error / RX timeout / TXFRS / HPDWARN).
 */
struct mock_reg_state {
    uint32 sys_status;       /**< Value returned for dwt_read32bitreg(SYS_STATUS_ID). */
    uint32 rx_finfo;          /**< Value returned for dwt_read32bitreg(RX_FINFO_ID). */
    uint32 last_write_reg;    /**< Last regFileID written via dwt_write32bit{,offset}reg. */
    uint32 last_write_val;    /**< Last value written. */
    int    write_count;       /**< Number of register writes captured. */
};

/**
 * Captured dwt_readrxdata() call arguments, plus the payload bytes the mock
 * copies into the caller's buffer (set injected_payload before the call).
 */
struct mock_readrxdata_state {
    int    called;
    uint16 length;
    uint16 offset;
    uint8  injected_payload[MOCK_MAX_FRAME_LEN];
};

/**
 * Injected 5-byte RX/TX timestamp buffers returned by
 * dwt_readrxtimestamp() / dwt_readtxtimestamp(), plus call counters.
 */
struct mock_timestamp_state {
    uint8 rx_ts_bytes[5];
    uint8 tx_ts_bytes[5];
    int   rx_called;
    int   tx_called;
};

/**
 * State captured from mock dwt_setdelayedtrxtime() call.
 */
struct mock_delayedtrxtime_state {
    int    called;
    uint32 starttime;
};

/**
 * State captured from mock dwt_writetxdata() and dwt_writetxfctrl() calls,
 * and dwt_writetxdata()'s configurable return value.
 */
struct mock_tx_state {
    int    writetxdata_called;
    uint16 writetxdata_len;
    uint8  writetxdata_buf[MOCK_MAX_FRAME_LEN];
    uint16 writetxdata_offset;
    int    writetxdata_return_value;

    int    writetxfctrl_called;
    uint16 writetxfctrl_len;
    uint16 writetxfctrl_offset;
    int    writetxfctrl_ranging;
};

/**
 * State captured from mock dwt_starttx() call, and its configurable return
 * value (set to DWT_ERROR to simulate a missed/HPDWARN slot).
 */
struct mock_starttx_state {
    int    called;
    uint8  mode;
    int    return_value;
};

extern struct mock_rxtimeout_state       mock_rxtimeout_state;
extern struct mock_rxenable_state        mock_rxenable_state;
extern struct mock_forcetrxoff_state     mock_forcetrxoff_state;
extern struct mock_reg_state             mock_reg_state;
extern struct mock_readrxdata_state      mock_readrxdata_state;
extern struct mock_timestamp_state       mock_timestamp_state;
extern struct mock_delayedtrxtime_state  mock_delayedtrxtime_state;
extern struct mock_tx_state              mock_tx_state;
extern struct mock_starttx_state         mock_starttx_state;

/** Reset all captured/configurable state to defaults (all-success, all-zero). */
void mock_deca_reset(void);

#endif /* MOCK_DECA_DRIVER_H_ */
```

## src/mock_log.c
```c
/*! ----------------------------------------------------------------------------
 * @file    mock_log.c
 * @brief   Zephyr minimal-log stub for the dw1000_sync unit test (UWB-242).
 *
 * Copied from tests/dw1000_ranging/src/mock_log.c (UWB-231): dw1000_sync's
 * test build also compiles dw1000_ranging.c (dw1000_rx() is reused), and the
 * unit_testing defconfig enables CONFIG_LOG=y, which causes the LOG_ERR() /
 * LOG_DBG() macros in dw1000_ranging.c to call z_log_minimal_printk() at link
 * time. That function lives in Zephyr's log_minimal.c, which is not compiled
 * in the minimal unit_testing link set. Stub it out here — unit tests do not
 * need real log output, only assertion correctness.
 *
 * @attention
 * SPDX-License-Identifier: MIT
 * Copyright (c) 2024 Fundamentals UWB project contributors.
 */

#include <stdarg.h>

void z_log_minimal_printk(const char *fmt, ...)
{
    (void)fmt;
    /* No-op: discard log messages in unit tests. */
}
```

## src/test_dw1000_sync.c
```c
/*! ----------------------------------------------------------------------------
 * @file    test_dw1000_sync.c
 * @brief   ztest suite: tag-side SYNC-frame RX + validate/parse (UWB-242)
 *
 * Platform: unit_testing (native-hosted, no Zephyr kernel, no real SPI).
 *
 * Covers:
 *   uwb_sync_parse()   Radio-free validate/decode: golden-value LE decode of
 *                        a well-formed SYNC frame, and each individual
 *                        validation failure (wrong length / frame type / PAN
 *                        ID / destination address), plus NULL-argument
 *                        rejection.
 *   dw1000_sync_rx()    Composition over the mocked dw1000_rx(): good SYNC
 *                        frame -> 0 with rx_ts/cycle_seq/master_tx_ts
 *                        populated; wrong frame heard -> -EBADMSG; mock
 *                        timeout -> -ETIMEDOUT (passthrough); mock RX/FCS
 *                        error -> -EIO (passthrough); NULL out -> -EINVAL.
 *
 * @attention
 * SPDX-License-Identifier: MIT
 * Copyright (c) 2024 Fundamentals UWB project contributors.
 */

#include <errno.h>
#include <string.h>

#include <zephyr/ztest.h>

#include "deca_device_api.h"
#include "deca_regs.h"
#include "dw1000_sync.h"
#include "mock_deca_driver.h"
#include "uwb_frames.h"

/* ---------------------------------------------------------------------------
 * Suite setup / teardown
 * --------------------------------------------------------------------------- */
static void before_each(void *fixture)
{
    (void)fixture;
    mock_deca_reset();
}

ZTEST_SUITE(dw1000_sync, NULL, NULL, before_each, NULL, NULL);

/* ---------------------------------------------------------------------------
 * Test frame builder
 *
 * Hand-packs a raw SYNC frame buffer byte-by-byte from the UWB_OFF_SYNC_*
 * offsets in uwb_frames.h -- deliberately independent of dw1000_sync.c's own
 * encode/decode logic so the test does not become tautological.
 *
 * @p buf must have capacity for at least UWB_SYNC_FRAME_SIZE bytes.
 * --------------------------------------------------------------------------- */
static void build_sync_frame(uint8_t *buf, uint16_t pan_id, uint16_t dest_addr,
                              uint8_t frame_type, uint16_t cycle_seq,
                              uint64_t master_tx_ts)
{
    int i;

    memset(buf, 0, UWB_SYNC_FRAME_SIZE);

    buf[UWB_OFF_FRAME_CTRL]     = UWB_FRAME_CTRL_LOW;
    buf[UWB_OFF_FRAME_CTRL + 1] = UWB_FRAME_CTRL_HIGH;
    buf[UWB_OFF_SEQ_NUM]        = 0x07u;

    buf[UWB_OFF_PAN_ID]     = (uint8_t)(pan_id & 0xFFu);
    buf[UWB_OFF_PAN_ID + 1] = (uint8_t)((pan_id >> 8) & 0xFFu);

    buf[UWB_OFF_DEST_ADDR]     = (uint8_t)(dest_addr & 0xFFu);
    buf[UWB_OFF_DEST_ADDR + 1] = (uint8_t)((dest_addr >> 8) & 0xFFu);

    /* Master's short address -- arbitrary, not validated by uwb_sync_parse(). */
    buf[UWB_OFF_SRC_ADDR]     = 0x01u;
    buf[UWB_OFF_SRC_ADDR + 1] = 0x00u;

    buf[UWB_OFF_FRAME_TYPE] = frame_type;

    buf[UWB_OFF_SYNC_CYCLE_SEQ]     = (uint8_t)(cycle_seq & 0xFFu);
    buf[UWB_OFF_SYNC_CYCLE_SEQ + 1] = (uint8_t)((cycle_seq >> 8) & 0xFFu);

    for (i = 0; i < 5; i++) {
        buf[UWB_OFF_SYNC_MASTER_TX_TS + i] =
            (uint8_t)((master_tx_ts >> (8 * i)) & 0xFFu);
    }
}

/* =============================================================================
 * uwb_sync_parse() -- radio-free validate/decode
 * ========================================================================= */

ZTEST(dw1000_sync, test_parse_valid_sync_decodes_golden_values)
{
    uint8_t buf[UWB_SYNC_FRAME_SIZE];
    uint16_t cycle_seq = 0;
    uint64_t master_tx_ts = 0;
    const uint16_t golden_cycle_seq = 0x1234u;
    const uint64_t golden_master_tx_ts = 0x0102030405ULL;

    build_sync_frame(buf, UWB_PAN_ID, UWB_ADDR_BROADCAST, UWB_FRAME_TYPE_SYNC,
                      golden_cycle_seq, golden_master_tx_ts);

    int ret = uwb_sync_parse(buf, sizeof(buf), &cycle_seq, &master_tx_ts);

    zassert_equal(ret, 0, "uwb_sync_parse() returned %d (expected 0)", ret);
    zassert_equal(cycle_seq, golden_cycle_seq,
        "cycle_seq: expected 0x%04X; got 0x%04X",
        golden_cycle_seq, cycle_seq);
    zassert_equal(master_tx_ts, golden_master_tx_ts,
        "master_tx_ts: expected 0x%010llX; got 0x%010llX",
        (unsigned long long)golden_master_tx_ts,
        (unsigned long long)master_tx_ts);
}

ZTEST(dw1000_sync, test_parse_wrong_length_returns_ebadmsg)
{
    uint8_t buf[UWB_SYNC_FRAME_SIZE];
    uint16_t cycle_seq = 0;
    uint64_t master_tx_ts = 0;

    build_sync_frame(buf, UWB_PAN_ID, UWB_ADDR_BROADCAST, UWB_FRAME_TYPE_SYNC,
                      0x0001u, 0x01ULL);

    int ret = uwb_sync_parse(buf, (uint16_t)(UWB_SYNC_FRAME_SIZE - 1u),
                              &cycle_seq, &master_tx_ts);

    zassert_equal(ret, -EBADMSG,
        "Expected -EBADMSG for wrong length; got %d", ret);
}

ZTEST(dw1000_sync, test_parse_wrong_frame_type_returns_ebadmsg)
{
    uint8_t buf[UWB_SYNC_FRAME_SIZE];
    uint16_t cycle_seq = 0;
    uint64_t master_tx_ts = 0;

    build_sync_frame(buf, UWB_PAN_ID, UWB_ADDR_BROADCAST,
                      UWB_FRAME_TYPE_TAG_BLINK, 0x0001u, 0x01ULL);

    int ret = uwb_sync_parse(buf, sizeof(buf), &cycle_seq, &master_tx_ts);

    zassert_equal(ret, -EBADMSG,
        "Expected -EBADMSG for wrong frame type; got %d", ret);
}

ZTEST(dw1000_sync, test_parse_wrong_pan_returns_ebadmsg)
{
    uint8_t buf[UWB_SYNC_FRAME_SIZE];
    uint16_t cycle_seq = 0;
    uint64_t master_tx_ts = 0;
    const uint16_t wrong_pan = (uint16_t)(UWB_PAN_ID ^ 0xFFFFu);

    build_sync_frame(buf, wrong_pan, UWB_ADDR_BROADCAST, UWB_FRAME_TYPE_SYNC,
                      0x0001u, 0x01ULL);

    int ret = uwb_sync_parse(buf, sizeof(buf), &cycle_seq, &master_tx_ts);

    zassert_equal(ret, -EBADMSG,
        "Expected -EBADMSG for wrong PAN ID; got %d", ret);
}

ZTEST(dw1000_sync, test_parse_wrong_dest_returns_ebadmsg)
{
    uint8_t buf[UWB_SYNC_FRAME_SIZE];
    uint16_t cycle_seq = 0;
    uint64_t master_tx_ts = 0;
    const uint16_t unicast_dest = 0x0042u;

    build_sync_frame(buf, UWB_PAN_ID, unicast_dest, UWB_FRAME_TYPE_SYNC,
                      0x0001u, 0x01ULL);

    int ret = uwb_sync_parse(buf, sizeof(buf), &cycle_seq, &master_tx_ts);

    zassert_equal(ret, -EBADMSG,
        "Expected -EBADMSG for non-broadcast destination; got %d", ret);
}

ZTEST(dw1000_sync, test_parse_rejects_null_args)
{
    uint8_t buf[UWB_SYNC_FRAME_SIZE];
    uint16_t cycle_seq = 0;
    uint64_t master_tx_ts = 0;

    build_sync_frame(buf, UWB_PAN_ID, UWB_ADDR_BROADCAST, UWB_FRAME_TYPE_SYNC,
                      0x0001u, 0x01ULL);

    zassert_equal(uwb_sync_parse(NULL, sizeof(buf), &cycle_seq, &master_tx_ts),
        -EINVAL, "NULL buf");
    zassert_equal(uwb_sync_parse(buf, sizeof(buf), NULL, &master_tx_ts),
        -EINVAL, "NULL cycle_seq");
    zassert_equal(uwb_sync_parse(buf, sizeof(buf), &cycle_seq, NULL),
        -EINVAL, "NULL master_tx_ts");
}

/* =============================================================================
 * dw1000_sync_rx() -- composition over the mocked dw1000_rx()
 * ========================================================================= */

ZTEST(dw1000_sync, test_sync_rx_valid_frame_returns_zero_and_populates_out)
{
    uint8_t frame[UWB_SYNC_FRAME_SIZE];
    uwb_sync_info_t info = {0};
    const uint16_t golden_cycle_seq = 0x0203u;
    const uint64_t golden_master_tx_ts = 0x0A0B0C0D0EULL;

    build_sync_frame(frame, UWB_PAN_ID, UWB_ADDR_BROADCAST, UWB_FRAME_TYPE_SYNC,
                      golden_cycle_seq, golden_master_tx_ts);

    mock_reg_state.sys_status = SYS_STATUS_RXFCG;
    mock_reg_state.rx_finfo   = (uint32)UWB_SYNC_FRAME_SIZE;
    memcpy(mock_readrxdata_state.injected_payload, frame, sizeof(frame));

    /* rx_ts bytes little-endian: byte[0] = LSB ... byte[4] = MSB. */
    mock_timestamp_state.rx_ts_bytes[0] = 0x11u;
    mock_timestamp_state.rx_ts_bytes[1] = 0x22u;
    mock_timestamp_state.rx_ts_bytes[2] = 0x33u;
    mock_timestamp_state.rx_ts_bytes[3] = 0x44u;
    mock_timestamp_state.rx_ts_bytes[4] = 0x05u;
    const uint64_t expected_rx_ts = 0x0544332211ULL;

    int ret = dw1000_sync_rx(&info, 1000);

    zassert_equal(ret, 0, "dw1000_sync_rx() returned %d (expected 0)", ret);
    zassert_equal(info.rx_ts, expected_rx_ts,
        "rx_ts: expected 0x%010llX; got 0x%010llX",
        (unsigned long long)expected_rx_ts, (unsigned long long)info.rx_ts);
    zassert_equal(info.cycle_seq, golden_cycle_seq,
        "cycle_seq: expected 0x%04X; got 0x%04X",
        golden_cycle_seq, info.cycle_seq);
    zassert_equal(info.master_tx_ts, golden_master_tx_ts,
        "master_tx_ts: expected 0x%010llX; got 0x%010llX",
        (unsigned long long)golden_master_tx_ts,
        (unsigned long long)info.master_tx_ts);
}

ZTEST(dw1000_sync, test_sync_rx_wrong_frame_type_returns_ebadmsg)
{
    uint8_t frame[UWB_SYNC_FRAME_SIZE];
    uwb_sync_info_t info = {0};

    build_sync_frame(frame, UWB_PAN_ID, UWB_ADDR_BROADCAST,
                      UWB_FRAME_TYPE_TAG_BLINK, 0x0001u, 0x01ULL);

    mock_reg_state.sys_status = SYS_STATUS_RXFCG;
    mock_reg_state.rx_finfo   = (uint32)UWB_SYNC_FRAME_SIZE;
    memcpy(mock_readrxdata_state.injected_payload, frame, sizeof(frame));

    int ret = dw1000_sync_rx(&info, 1000);

    zassert_equal(ret, -EBADMSG,
        "Expected -EBADMSG for wrong frame type; got %d", ret);
}

ZTEST(dw1000_sync, test_sync_rx_wrong_pan_returns_ebadmsg)
{
    uint8_t frame[UWB_SYNC_FRAME_SIZE];
    uwb_sync_info_t info = {0};
    const uint16_t wrong_pan = (uint16_t)(UWB_PAN_ID ^ 0xFFFFu);

    build_sync_frame(frame, wrong_pan, UWB_ADDR_BROADCAST, UWB_FRAME_TYPE_SYNC,
                      0x0001u, 0x01ULL);

    mock_reg_state.sys_status = SYS_STATUS_RXFCG;
    mock_reg_state.rx_finfo   = (uint32)UWB_SYNC_FRAME_SIZE;
    memcpy(mock_readrxdata_state.injected_payload, frame, sizeof(frame));

    int ret = dw1000_sync_rx(&info, 1000);

    zassert_equal(ret, -EBADMSG,
        "Expected -EBADMSG for wrong PAN ID; got %d", ret);
}

ZTEST(dw1000_sync, test_sync_rx_wrong_dest_returns_ebadmsg)
{
    uint8_t frame[UWB_SYNC_FRAME_SIZE];
    uwb_sync_info_t info = {0};
    const uint16_t unicast_dest = 0x0042u;

    build_sync_frame(frame, UWB_PAN_ID, unicast_dest, UWB_FRAME_TYPE_SYNC,
                      0x0001u, 0x01ULL);

    mock_reg_state.sys_status = SYS_STATUS_RXFCG;
    mock_reg_state.rx_finfo   = (uint32)UWB_SYNC_FRAME_SIZE;
    memcpy(mock_readrxdata_state.injected_payload, frame, sizeof(frame));

    int ret = dw1000_sync_rx(&info, 1000);

    zassert_equal(ret, -EBADMSG,
        "Expected -EBADMSG for non-broadcast destination; got %d", ret);
}

ZTEST(dw1000_sync, test_sync_rx_wrong_length_returns_ebadmsg)
{
    uint8_t frame[UWB_SYNC_FRAME_SIZE];
    uwb_sync_info_t info = {0};

    build_sync_frame(frame, UWB_PAN_ID, UWB_ADDR_BROADCAST, UWB_FRAME_TYPE_SYNC,
                      0x0001u, 0x01ULL);

    mock_reg_state.sys_status = SYS_STATUS_RXFCG;
    /* Report one byte short of a valid SYNC frame -- dw1000_rx() itself
     * succeeds (it has no opinion on application-layer framing), and
     * uwb_sync_parse()'s length check must reject it. */
    mock_reg_state.rx_finfo = (uint32)(UWB_SYNC_FRAME_SIZE - 1u);
    memcpy(mock_readrxdata_state.injected_payload, frame,
           UWB_SYNC_FRAME_SIZE - 1u);

    int ret = dw1000_sync_rx(&info, 1000);

    zassert_equal(ret, -EBADMSG,
        "Expected -EBADMSG for wrong length; got %d", ret);
}

ZTEST(dw1000_sync, test_sync_rx_mock_timeout_returns_etimedout)
{
    uwb_sync_info_t info = {0};

    /* SYS_STATUS_RXRFTO (Receive Frame Wait Timeout) is part of
     * SYS_STATUS_ALL_RX_TO -- see tests/dw1000_ranging for the same pattern. */
    mock_reg_state.sys_status = SYS_STATUS_RXRFTO;

    int ret = dw1000_sync_rx(&info, 1000);

    zassert_equal(ret, -ETIMEDOUT,
        "Expected -ETIMEDOUT (passthrough) on RX timeout; got %d", ret);
}

ZTEST(dw1000_sync, test_sync_rx_mock_rx_error_returns_eio)
{
    uwb_sync_info_t info = {0};

    /* SYS_STATUS_RXFCE (Receiver FCS Error) is part of SYS_STATUS_ALL_RX_ERR. */
    mock_reg_state.sys_status = SYS_STATUS_RXFCE;

    int ret = dw1000_sync_rx(&info, 1000);

    zassert_equal(ret, -EIO,
        "Expected -EIO (passthrough) on RX/FCS error; got %d", ret);
}

ZTEST(dw1000_sync, test_sync_rx_rejects_null_out)
{
    zassert_equal(dw1000_sync_rx(NULL, 1000), -EINVAL,
        "Expected -EINVAL for NULL out");
    zassert_equal(mock_rxenable_state.called, 0,
        "dwt_rxenable() must not be called on an invalid argument");
}
```
