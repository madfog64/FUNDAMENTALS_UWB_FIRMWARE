## CMakeLists.txt
```
cmake_minimum_required(VERSION 3.20.0)

# Zephyr unit test build for the STANDBY power-state machine (UWB-319).
#
# Key differences from regular Zephyr app builds:
#   - 'project()' comes BEFORE 'find_package()'
#   - 'COMPONENTS unittest' selects the minimal, kernel-free build
#   - The build target is 'testbinary' (not 'app')
#   - No device tree, no real SPI/GPIO, no deca_driver
#
# What is compiled:
#   uwb_standby.c         — the module under test (UWB-319)
#   dw1000_sleep.c        — the UWB-316 sleep/wake seam this module drives
#   dw1000_config.c       — dw1000_wake()'s reconfigure-on-wake dependency
#                            (UWB-155/UWB-156), exercised for pass-through
#                            only (own detailed assertions live in
#                            tests/dw1000_config/ and tests/dw1000_sleep/)
#   dw1000_sync.c          — tag-side SYNC RX + validate/parse (UWB-242),
#                            reused (not reimplemented) for the ASLEEP-phase
#                            presence-check listen
#   dw1000_ranging.c        — dw1000_rx() (UWB-231), reused for the same
#                            presence-check listen
#   mock_deca_driver.c     — union of tests/dw1000_sleep's and tests/join's
#                            deca_driver mocks (see mock_deca_driver.h)
#   mock_port.c            — mocks reset_DW1000(), port_set_dw1000_slowrate/
#                            fastrate(), port_wakeup_dw1000() (copied from
#                            tests/dw1000_sleep/)
#   mock_seq.c             — shared call-order sequence counter (copied from
#                            tests/dw1000_sleep/)
#   test_uwb_standby.c      — ztest assertions
#
# Note: deca_device.c and deca_params_init.c are intentionally NOT compiled
# here, same as tests/dw1000_sleep/ / tests/join/ — all deca_driver API
# functions are replaced with mocks.
#
# CONFIG_DW1000_PHY_* / CONFIG_UWB_SYNC_MAX_MISSED /
# CONFIG_UWB_STANDBY_WAKE_CADENCE_MS are injected as target_compile_definitions
# below rather than via Kconfig, because the unit_testing platform's Kconfig
# root does not include the drivers/dw1000/Kconfig hierarchy (same rationale
# as tests/dw1000_config/, tests/dw1000_sleep/, and tests/uwb_cycle_ref/
# CMakeLists.txt). Values match the Kconfig defaults in drivers/dw1000/Kconfig.
#
# Platform: unit_testing  (native host executable, no emulation)
# Run:  west twister -p unit_testing -T tests/uwb_standby -v

project(test_uwb_standby)
find_package(Zephyr COMPONENTS unittest REQUIRED HINTS $ENV{ZEPHYR_BASE})

set(DW1000_DIR ${CMAKE_CURRENT_SOURCE_DIR}/../../drivers/dw1000)

target_sources(testbinary PRIVATE
    src/test_uwb_standby.c
    src/mock_deca_driver.c
    src/mock_port.c
    src/mock_seq.c
    ${DW1000_DIR}/uwb_standby.c
    ${DW1000_DIR}/dw1000_sleep.c
    ${DW1000_DIR}/dw1000_config.c
    ${DW1000_DIR}/dw1000_sync.c
    ${DW1000_DIR}/dw1000_ranging.c
)

target_include_directories(testbinary PRIVATE
    ${DW1000_DIR}/deca_driver     # deca_device_api.h, deca_regs.h
    ${DW1000_DIR}                 # uwb_standby.h, dw1000_sleep.h, dw1000_sync.h, etc.
    ${CMAKE_CURRENT_SOURCE_DIR}/src  # mock_deca_driver.h, mock_port.h, mock_seq.h
)

# Inject the CONFIG_DW1000_PHY_* compile-time constants that dw1000_config.c
# (dw1000_wake()'s reconfigure dependency) reads. Values match
# contracts/uwb/phy_config.h v0.6 / Kconfig defaults in drivers/dw1000/Kconfig
# — identical to tests/dw1000_sleep/CMakeLists.txt.
target_compile_definitions(testbinary PRIVATE
    CONFIG_DW1000=1
    CONFIG_DW1000_PHY_CHANNEL=5
    CONFIG_DW1000_PHY_PRF=2
    CONFIG_DW1000_PHY_TX_PLEN=0x04
    CONFIG_DW1000_PHY_PAC=0
    CONFIG_DW1000_PHY_TX_CODE=9
    CONFIG_DW1000_PHY_RX_CODE=9
    CONFIG_DW1000_PHY_NS_SFD=0
    CONFIG_DW1000_PHY_DATA_RATE=2
    CONFIG_DW1000_PHY_PHR_MODE=0
    CONFIG_DW1000_PHY_SFD_TIMEOUT=65
    CONFIG_DW1000_PHY_TX_PGDELAY=0xC0
    CONFIG_DW1000_PHY_TX_POWER=0x0E082848
    CONFIG_DW1000_ANTENNA_DELAY_TX=16436
    CONFIG_DW1000_ANTENNA_DELAY_RX=16436

    # uwb_standby.c's own Kconfig-provisioned constants (see
    # drivers/dw1000/Kconfig) — CONFIG_UWB_SYNC_MAX_MISSED is shared/reused
    # from uwb_cycle_ref.c (UWB-243); CONFIG_UWB_STANDBY_WAKE_CADENCE_MS is
    # new (UWB-319). Values match the Kconfig defaults.
    CONFIG_UWB_SYNC_MAX_MISSED=3
    CONFIG_UWB_STANDBY_WAKE_CADENCE_MS=10000
)
```

## prj.conf
```kconfig
# tests/uwb_standby/prj.conf
# Minimal config for the unit_testing platform — only ztest is needed.
# CONFIG_DW1000_PHY_* / CONFIG_UWB_SYNC_MAX_MISSED /
# CONFIG_UWB_STANDBY_WAKE_CADENCE_MS are injected as compile definitions in
# CMakeLists.txt so they do not require Kconfig symbol registration.
CONFIG_ZTEST=y
```

## src/mock_deca_driver.c
```c
/*! ----------------------------------------------------------------------------
 * @file    mock_deca_driver.c
 * @brief   Mock implementations of the deca_driver API surface exercised by
 *          uwb_standby.c's composed dependencies (UWB-319). See
 *          mock_deca_driver.h for provenance -- this is the union of
 *          tests/dw1000_sleep/src/mock_deca_driver.c (UWB-316) and
 *          tests/join/src/mock_deca_driver.c (UWB-261).
 *
 * These stubs replace deca_device.c and deca_params_init.c in the
 * unit_testing build. They have no hardware or SPI dependencies.
 *
 * @attention
 * SPDX-License-Identifier: MIT
 * Copyright (c) 2024 Fundamentals UWB project contributors.
 */

#include <string.h>

#include "deca_device_api.h"
#include "deca_regs.h"
#include "dw1000_config.h"
#include "mock_deca_driver.h"
#include "mock_seq.h"

/* ---------------------------------------------------------------------------
 * Captured / configurable state (inspected and pre-configured by tests)
 * --------------------------------------------------------------------------- */
struct mock_dwt_init_state       mock_init_state;
struct mock_dwt_cfg_state        mock_cfg_state;
struct mock_dwt_txrf_state       mock_txrf_state;
struct mock_dwt_antenna_state    mock_antenna_state;
struct mock_dwt_otp_state        mock_otp_state;
struct mock_dwt_sleep_state      mock_sleep_state;

struct mock_rxtimeout_state      mock_rxtimeout_state;
struct mock_rxenable_state       mock_rxenable_state;
struct mock_forcetrxoff_state    mock_forcetrxoff_state;
struct mock_reg_state            mock_reg_state;
struct mock_readrxdata_state     mock_readrxdata_state;
struct mock_timestamp_state      mock_timestamp_state;
struct mock_delayedtrxtime_state mock_delayedtrxtime_state;
struct mock_tx_state             mock_tx_state;
struct mock_starttx_state        mock_starttx_state;

void mock_deca_reset(void)
{
    memset(&mock_init_state,    0, sizeof(mock_init_state));
    memset(&mock_cfg_state,     0, sizeof(mock_cfg_state));
    memset(&mock_txrf_state,    0, sizeof(mock_txrf_state));
    memset(&mock_antenna_state, 0, sizeof(mock_antenna_state));
    memset(&mock_otp_state,     0, sizeof(mock_otp_state));
    memset(&mock_sleep_state,   0, sizeof(mock_sleep_state));

    memset(&mock_rxtimeout_state,      0, sizeof(mock_rxtimeout_state));
    memset(&mock_rxenable_state,       0, sizeof(mock_rxenable_state));
    memset(&mock_forcetrxoff_state,    0, sizeof(mock_forcetrxoff_state));
    memset(&mock_reg_state,            0, sizeof(mock_reg_state));
    memset(&mock_readrxdata_state,     0, sizeof(mock_readrxdata_state));
    memset(&mock_timestamp_state,      0, sizeof(mock_timestamp_state));
    memset(&mock_delayedtrxtime_state, 0, sizeof(mock_delayedtrxtime_state));
    memset(&mock_tx_state,              0, sizeof(mock_tx_state));
    memset(&mock_starttx_state,         0, sizeof(mock_starttx_state));

    /* Defaults: every deca_driver call that can fail reports success; OTP is
     * unprogrammed (0). */
    mock_init_state.return_value           = DWT_SUCCESS;
    mock_rxenable_state.return_value        = DWT_SUCCESS;
    mock_tx_state.writetxdata_return_value  = DWT_SUCCESS;
    mock_starttx_state.return_value         = DWT_SUCCESS;
}

/* ---------------------------------------------------------------------------
 * Mock dwt_initialise -- the "device-id re-read" step of the reconfigure path.
 * --------------------------------------------------------------------------- */
int dwt_initialise(uint16 config)
{
    mock_init_state.called     = 1;
    mock_init_state.config_arg = config;
    mock_init_state.seq        = mock_seq_next();
    return mock_init_state.return_value;
}

/* ---------------------------------------------------------------------------
 * Mock dwt_configure
 * --------------------------------------------------------------------------- */
void dwt_configure(dwt_config_t *config)
{
    mock_cfg_state.called = 1;
    mock_cfg_state.seq    = mock_seq_next();
    if (config != NULL) {
        memcpy(&mock_cfg_state.config, config, sizeof(dwt_config_t));
    }
}

/* ---------------------------------------------------------------------------
 * Mock dwt_configuretxrf
 * --------------------------------------------------------------------------- */
void dwt_configuretxrf(dwt_txconfig_t *config)
{
    mock_txrf_state.called = 1;
    mock_txrf_state.seq    = mock_seq_next();
    if (config != NULL) {
        memcpy(&mock_txrf_state.config, config, sizeof(dwt_txconfig_t));
    }
}

/* ---------------------------------------------------------------------------
 * Mock dwt_settxantennadelay / dwt_setrxantennadelay
 * --------------------------------------------------------------------------- */
void dwt_settxantennadelay(uint16 txDelay)
{
    mock_antenna_state.tx_called++;
    mock_antenna_state.tx_delay = txDelay;
}

void dwt_setrxantennadelay(uint16 rxDelay)
{
    mock_antenna_state.rx_called++;
    mock_antenna_state.rx_delay = rxDelay;
}

/* ---------------------------------------------------------------------------
 * Mock dwt_otpread
 * --------------------------------------------------------------------------- */
void dwt_otpread(uint32 address, uint32 *array, uint8 length)
{
    uint8 i;

    if (array == NULL || length == 0u) {
        return;
    }
    for (i = 0u; i < length; i++) {
        if (address + i == (uint32)DW1000_OTP_ANTDLY_ADDRESS) {
            array[i] = mock_otp_state.antdly_word;
        } else {
            array[i] = 0u;
        }
    }
}

/* ---------------------------------------------------------------------------
 * Mock dwt_configuresleep / dwt_entersleep (UWB-316)
 * --------------------------------------------------------------------------- */
void dwt_configuresleep(uint16 mode, uint8 wake)
{
    /* Unlike tests/dw1000_sleep's own mock (a single sleep/wake round trip
     * per test, so a 0/1 "called" flag suffices), uwb_standby_step() drives
     * dw1000_sleep() repeatedly across one test (entry, then a re-sleep per
     * absent/failed wake) -- these are counters, not flags, so tests can
     * assert exactly how many sleep/wake cycles happened. */
    mock_sleep_state.configuresleep_called++;
    mock_sleep_state.configuresleep_mode   = mode;
    mock_sleep_state.configuresleep_wake   = wake;
    mock_sleep_state.configuresleep_seq    = mock_seq_next();
}

void dwt_entersleep(void)
{
    mock_sleep_state.entersleep_called++;
    mock_sleep_state.entersleep_seq    = mock_seq_next();
}

/* ---------------------------------------------------------------------------
 * Mock dwt_setrxtimeout
 * --------------------------------------------------------------------------- */
void dwt_setrxtimeout(uint16 time)
{
    mock_rxtimeout_state.called = 1;
    mock_rxtimeout_state.time   = time;
}

/* ---------------------------------------------------------------------------
 * Mock dwt_rxenable
 * --------------------------------------------------------------------------- */
int dwt_rxenable(int mode)
{
    mock_rxenable_state.called = 1;
    mock_rxenable_state.mode   = mode;
    return mock_rxenable_state.return_value;
}

/* ---------------------------------------------------------------------------
 * Mock dwt_forcetrxoff
 * --------------------------------------------------------------------------- */
void dwt_forcetrxoff(void)
{
    mock_forcetrxoff_state.called++;
}

/* ---------------------------------------------------------------------------
 * Mock dwt_read32bitoffsetreg (backs the dwt_read32bitreg() macro)
 *
 * Returns mock_reg_state.sys_status for SYS_STATUS_ID, mock_reg_state.rx_finfo
 * for RX_FINFO_ID, and 0 for anything else.
 * --------------------------------------------------------------------------- */
uint32 dwt_read32bitoffsetreg(int regFileID, int regOffset)
{
    (void)regOffset;

    if (regFileID == SYS_STATUS_ID) {
        return mock_reg_state.sys_status;
    }
    if (regFileID == RX_FINFO_ID) {
        return mock_reg_state.rx_finfo;
    }
    return 0u;
}

/* ---------------------------------------------------------------------------
 * Mock dwt_write32bitoffsetreg (backs the dwt_write32bitreg() macro)
 *
 * Captures the last register/value written. When writing SYS_STATUS_ID,
 * clears the written bits from mock_reg_state.sys_status (write-1-to-clear,
 * matching real DW1000 SYS_STATUS semantics).
 * --------------------------------------------------------------------------- */
void dwt_write32bitoffsetreg(int regFileID, int regOffset, uint32 regval)
{
    (void)regOffset;

    mock_reg_state.last_write_reg = (uint32)regFileID;
    mock_reg_state.last_write_val = regval;
    mock_reg_state.write_count++;

    if (regFileID == SYS_STATUS_ID) {
        mock_reg_state.sys_status &= ~regval;
    }
}

/* ---------------------------------------------------------------------------
 * Mock dwt_readrxdata
 * --------------------------------------------------------------------------- */
void dwt_readrxdata(uint8 *buffer, uint16 length, uint16 rxBufferOffset)
{
    uint16 copy_len = length;

    mock_readrxdata_state.called = 1;
    mock_readrxdata_state.length = length;
    mock_readrxdata_state.offset = rxBufferOffset;

    if (copy_len > MOCK_MAX_FRAME_LEN) {
        copy_len = MOCK_MAX_FRAME_LEN;
    }
    if (buffer != NULL) {
        memcpy(buffer, mock_readrxdata_state.injected_payload, copy_len);
    }
}

/* ---------------------------------------------------------------------------
 * Mock dwt_readrxtimestamp / dwt_readtxtimestamp
 * --------------------------------------------------------------------------- */
void dwt_readrxtimestamp(uint8 *timestamp)
{
    mock_timestamp_state.rx_called++;
    if (timestamp != NULL) {
        memcpy(timestamp, mock_timestamp_state.rx_ts_bytes, 5);
    }
}

void dwt_readtxtimestamp(uint8 *timestamp)
{
    mock_timestamp_state.tx_called++;
    if (timestamp != NULL) {
        memcpy(timestamp, mock_timestamp_state.tx_ts_bytes, 5);
    }
}

/* ---------------------------------------------------------------------------
 * Mock dwt_setdelayedtrxtime (link-time only -- see mock_deca_driver.h)
 * --------------------------------------------------------------------------- */
void dwt_setdelayedtrxtime(uint32 starttime)
{
    mock_delayedtrxtime_state.called    = 1;
    mock_delayedtrxtime_state.starttime = starttime;
}

/* ---------------------------------------------------------------------------
 * Mock dwt_writetxdata (link-time only -- see mock_deca_driver.h)
 * --------------------------------------------------------------------------- */
int dwt_writetxdata(uint16 txFrameLength, uint8 *txFrameBytes, uint16 txBufferOffset)
{
    uint16 copy_len = txFrameLength;

    mock_tx_state.writetxdata_called = 1;
    mock_tx_state.writetxdata_len    = txFrameLength;
    mock_tx_state.writetxdata_offset = txBufferOffset;

    if (copy_len > MOCK_MAX_FRAME_LEN) {
        copy_len = MOCK_MAX_FRAME_LEN;
    }
    if (txFrameBytes != NULL) {
        memcpy(mock_tx_state.writetxdata_buf, txFrameBytes, copy_len);
    }

    return mock_tx_state.writetxdata_return_value;
}

/* ---------------------------------------------------------------------------
 * Mock dwt_writetxfctrl (link-time only -- see mock_deca_driver.h)
 * --------------------------------------------------------------------------- */
void dwt_writetxfctrl(uint16 txFrameLength, uint16 txBufferOffset, int ranging)
{
    mock_tx_state.writetxfctrl_called  = 1;
    mock_tx_state.writetxfctrl_len     = txFrameLength;
    mock_tx_state.writetxfctrl_offset  = txBufferOffset;
    mock_tx_state.writetxfctrl_ranging = ranging;
}

/* ---------------------------------------------------------------------------
 * Mock dwt_starttx (link-time only -- see mock_deca_driver.h)
 * --------------------------------------------------------------------------- */
int dwt_starttx(uint8 mode)
{
    mock_starttx_state.called = 1;
    mock_starttx_state.mode   = mode;
    return mock_starttx_state.return_value;
}

/* ---------------------------------------------------------------------------
 * Additional deca_driver stubs required at link time.
 * These functions are not exercised by this suite's assertions but may be
 * pulled in by deca_device_api.h declarations or the linker.
 * --------------------------------------------------------------------------- */

uint32 dwt_readdevid(void)         { return DWT_DEVICE_ID; }
uint32 dwt_getpartid(void)         { return 0; }
uint32 dwt_getlotid(void)          { return 0; }
uint8  dwt_otprevision(void)       { return 0; }
int    dwt_setlocaldataptr(unsigned int index) { (void)index; return DWT_SUCCESS; }
uint16 dwt_read16bitoffsetreg(int regFileID, int regOffset) {
    (void)regFileID; (void)regOffset; return 0;
}
void   dwt_write16bitoffsetreg(int regFileID, int regOffset, uint16 regval) {
    (void)regFileID; (void)regOffset; (void)regval;
}
uint8  dwt_read8bitoffsetreg(int regFileID, int regOffset) {
    (void)regFileID; (void)regOffset; return 0;
}
void   dwt_write8bitoffsetreg(int regFileID, int regOffset, uint8 regval) {
    (void)regFileID; (void)regOffset; (void)regval;
}
void   dwt_readfromdevice(uint16 r, uint16 i, uint32 l, uint8 *b) {
    (void)r; (void)i; (void)l; (void)b;
}
void   dwt_writetodevice(uint16 r, uint16 i, uint32 l, const uint8 *b) {
    (void)r; (void)i; (void)l; (void)b;
}
```

## src/mock_deca_driver.h
```c
/*! ----------------------------------------------------------------------------
 * @file    mock_deca_driver.h
 * @brief   Mock state for the deca_driver API surface exercised by
 *          uwb_standby.c's composed dependencies (UWB-319 ztest suite):
 *          dw1000_sleep.c (dwt_configuresleep/entersleep), dw1000_config.c
 *          (dw1000_wake()'s reconfigure-on-wake path -- dwt_initialise/
 *          configure/configuretxrf/settxantennadelay/setrxantennadelay/
 *          otpread), and dw1000_ranging.c + dw1000_sync.c (the
 *          presence-check dw1000_sync_rx() -> dw1000_rx() call).
 *
 * This is the union of tests/dw1000_sleep/src/mock_deca_driver.h (UWB-316)
 * and tests/join/src/mock_deca_driver.h (UWB-261) -- uwb_standby.c is the
 * first module to compose both seams in the same call path (ASLEEP: wake
 * -- the UWB-316 reconfigure path -- immediately followed by one
 * dw1000_sync_rx() presence-check listen), so its test build needs both
 * mock surfaces linked together. Only dwt_read32bitoffsetreg() /
 * dwt_write32bitoffsetreg() overlap between the two sources; this merge
 * keeps the tests/join richer register-state version (SYS_STATUS_ID /
 * RX_FINFO_ID awareness, needed for the RX poll loop in dw1000_rx()) rather
 * than tests/dw1000_sleep's always-returns-0 stub.
 *
 * Captured/configurable state is reset by mock_deca_reset() before each
 * test. Each sleep/wake-side struct carries a `seq` field (see mock_seq.h)
 * stamped at call time so tests can assert call ORDER, not just call
 * presence/count, mirroring tests/dw1000_sleep's own convention.
 *
 * @attention
 * SPDX-License-Identifier: MIT
 * Copyright (c) 2024 Fundamentals UWB project contributors.
 */

#ifndef MOCK_DECA_DRIVER_H_
#define MOCK_DECA_DRIVER_H_

#include "deca_device_api.h"

/** Size of the scratch buffers used to capture RX/TX payload bytes. */
#define MOCK_MAX_FRAME_LEN  128

/* ---------------------------------------------------------------------------
 * dw1000_config.c / dw1000_sleep.c side (reconfigure-on-wake path)
 * --------------------------------------------------------------------------- */

/** State captured from mock dwt_initialise() -- the "device-id re-read". */
struct mock_dwt_init_state {
    int    called;
    uint16 config_arg;
    int    return_value;
    int    seq;
};

/** State captured from mock dwt_configure(). */
struct mock_dwt_cfg_state {
    int          called;
    dwt_config_t config;
    int          seq;
};

/** State captured from mock dwt_configuretxrf(). */
struct mock_dwt_txrf_state {
    int            called;
    dwt_txconfig_t config;
    int            seq;
};

/** State captured from mock dwt_settxantennadelay() / dwt_setrxantennadelay(). */
struct mock_dwt_antenna_state {
    int    tx_called;
    uint16 tx_delay;
    int    rx_called;
    uint16 rx_delay;
};

/** Configurable OTP state for mock dwt_otpread(). */
struct mock_dwt_otp_state {
    uint32 antdly_word;
};

/** State captured from mock dwt_configuresleep() / dwt_entersleep() (UWB-316).
 *
 * configuresleep_called / entersleep_called are CALL COUNTS here (not the
 * 0/1 flags tests/dw1000_sleep's own mock uses) -- uwb_standby_step() drives
 * dw1000_sleep() repeatedly across a single test (STANDBY entry, then a
 * re-sleep per absent-presence or failed-wake outcome), so tests need to
 * assert exactly how many sleep cycles happened, not just whether at least
 * one did. *_seq is stamped from the LAST call in each case. */
struct mock_dwt_sleep_state {
    int    configuresleep_called;
    uint16 configuresleep_mode;
    uint8  configuresleep_wake;
    int    configuresleep_seq;

    int    entersleep_called;
    int    entersleep_seq;
};

/* ---------------------------------------------------------------------------
 * dw1000_ranging.c side (dw1000_rx(), via dw1000_sync_rx() presence check)
 * --------------------------------------------------------------------------- */

/** State captured from mock dwt_setrxtimeout() call. */
struct mock_rxtimeout_state {
    int    called;
    uint16 time;
};

/** State captured from mock dwt_rxenable() call, and its configurable
 *  return value. */
struct mock_rxenable_state {
    int called;
    int mode;
    int return_value;
};

/** Call counter for mock dwt_forcetrxoff(). */
struct mock_forcetrxoff_state {
    int called;
};

/**
 * Configurable register-read values and captured register writes, used for
 * dw1000_rx()'s SYS_STATUS/RX_FINFO polling.
 *
 * Set sys_status / rx_finfo BEFORE calling the function under test to drive
 * a specific scenario (good frame / RX error / RX timeout).
 */
struct mock_reg_state {
    uint32 sys_status;
    uint32 rx_finfo;
    uint32 last_write_reg;
    uint32 last_write_val;
    int    write_count;
};

/** Captured dwt_readrxdata() call arguments, plus the payload bytes the
 *  mock copies into the caller's buffer (set injected_payload before the
 *  call). */
struct mock_readrxdata_state {
    int    called;
    uint16 length;
    uint16 offset;
    uint8  injected_payload[MOCK_MAX_FRAME_LEN];
};

/** Injected 5-byte RX/TX timestamp buffers returned by
 *  dwt_readrxtimestamp() / dwt_readtxtimestamp(), plus call counters. */
struct mock_timestamp_state {
    uint8 rx_ts_bytes[5];
    uint8 tx_ts_bytes[5];
    int   rx_called;
    int   tx_called;
};

/** State captured from mock dwt_setdelayedtrxtime() call (link-time only --
 *  uwb_standby.c never TXes, so dw1000_tx_at()'s half of dw1000_ranging.c
 *  is never exercised in this suite). */
struct mock_delayedtrxtime_state {
    int    called;
    uint32 starttime;
};

/** State captured from mock dwt_writetxdata() and dwt_writetxfctrl() calls
 *  (link-time only -- see mock_delayedtrxtime_state). */
struct mock_tx_state {
    int    writetxdata_called;
    uint16 writetxdata_len;
    uint8  writetxdata_buf[MOCK_MAX_FRAME_LEN];
    uint16 writetxdata_offset;
    int    writetxdata_return_value;

    int    writetxfctrl_called;
    uint16 writetxfctrl_len;
    uint16 writetxfctrl_offset;
    int    writetxfctrl_ranging;
};

/** State captured from mock dwt_starttx() call (link-time only -- see
 *  mock_delayedtrxtime_state). */
struct mock_starttx_state {
    int    called;
    uint8  mode;
    int    return_value;
};

extern struct mock_dwt_init_state       mock_init_state;
extern struct mock_dwt_cfg_state        mock_cfg_state;
extern struct mock_dwt_txrf_state       mock_txrf_state;
extern struct mock_dwt_antenna_state    mock_antenna_state;
extern struct mock_dwt_otp_state        mock_otp_state;
extern struct mock_dwt_sleep_state      mock_sleep_state;

extern struct mock_rxtimeout_state      mock_rxtimeout_state;
extern struct mock_rxenable_state       mock_rxenable_state;
extern struct mock_forcetrxoff_state    mock_forcetrxoff_state;
extern struct mock_reg_state            mock_reg_state;
extern struct mock_readrxdata_state     mock_readrxdata_state;
extern struct mock_timestamp_state      mock_timestamp_state;
extern struct mock_delayedtrxtime_state mock_delayedtrxtime_state;
extern struct mock_tx_state             mock_tx_state;
extern struct mock_starttx_state        mock_starttx_state;

/** Reset all captured/configurable state to defaults (all-success, all-zero). */
void mock_deca_reset(void);

#endif /* MOCK_DECA_DRIVER_H_ */
```

## src/mock_port.c
```c
/*! ----------------------------------------------------------------------------
 * @file    mock_port.c
 * @brief   Mock implementations of port functions called by dw1000_sleep() /
 *          dw1000_wake() and the dw1000_configure() path dw1000_wake()
 *          drives (UWB-319 ztest suite). Copied verbatim from
 *          tests/dw1000_sleep/src/mock_port.c (UWB-316).
 *
 * These stubs replace deca_port.c in the unit_testing build. They are
 * no-ops with call counters + call-order sequence numbers (mock_seq.h) so
 * the test can verify the expected call sequence.
 *
 * @attention
 * SPDX-License-Identifier: MIT
 * Copyright (c) 2024 Fundamentals UWB project contributors.
 */

#include <string.h>
#include "mock_port.h"
#include "mock_seq.h"

/* ---------------------------------------------------------------------------
 * Captured call state
 * --------------------------------------------------------------------------- */
struct mock_port_state mock_port_state;

void mock_port_reset(void)
{
    memset(&mock_port_state, 0, sizeof(mock_port_state));
}

/* ---------------------------------------------------------------------------
 * Port function stubs
 * --------------------------------------------------------------------------- */

void reset_DW1000(void)
{
    mock_port_state.reset_called++;
    mock_port_state.reset_seq = mock_seq_next();
}

void port_set_dw1000_slowrate(void)
{
    mock_port_state.slowrate_called++;
}

void port_set_dw1000_fastrate(void)
{
    mock_port_state.fastrate_called++;
}

/**
 * @brief Mock WAKEUP pin toggle (UWB-316).
 *
 * The real implementation (deca_port.c) drives a GPIO and busy-waits/sleeps;
 * this mock only records that it was called and where in the call sequence,
 * so the test can assert the WAKEUP toggle happens before the
 * reconfigure-on-wake sequence (dwt_initialise/dwt_configure).
 */
void port_wakeup_dw1000(void)
{
    mock_port_state.wakeup_called++;
    mock_port_state.wakeup_seq = mock_seq_next();
}

/* ---------------------------------------------------------------------------
 * deca_driver SPI/mutex stubs -- required at link time by the mock driver.
 * --------------------------------------------------------------------------- */

int writetospi(uint16 headerLength, const uint8 *headerBuffer,
               uint32 bodylength, const uint8 *bodyBuffer)
{
    (void)headerLength; (void)headerBuffer;
    (void)bodylength;   (void)bodyBuffer;
    return DWT_SUCCESS;
}

int readfromspi(uint16 headerLength, const uint8 *headerBuffer,
                uint32 readlength, uint8 *readBuffer)
{
    (void)headerLength; (void)headerBuffer;
    (void)readlength;   (void)readBuffer;
    return DWT_SUCCESS;
}

decaIrqStatus_t decamutexon(void)  { return 0; }
void decamutexoff(decaIrqStatus_t s) { (void)s; }
void deca_sleep(unsigned int time_ms) { (void)time_ms; }

/* ---------------------------------------------------------------------------
 * Zephyr logging stubs.
 *
 * The unit_testing defconfig enables CONFIG_LOG=y which causes LOG_ERR() /
 * LOG_DBG() / LOG_INF() macros in dw1000_config.c / dw1000_sleep.c /
 * dw1000_ranging.c / dw1000_sync.c / uwb_standby.c to call
 * z_log_minimal_printk() at link time. That function lives in Zephyr's
 * log_minimal.c which is not compiled in the minimal unit_testing link set.
 * Stub it out here -- unit tests do not need real log output, only assertion
 * correctness.
 * --------------------------------------------------------------------------- */
#include <stdarg.h>

void z_log_minimal_printk(const char *fmt, ...)
{
    (void)fmt;
    /* No-op: discard log messages in unit tests. */
}
```

## src/mock_port.h
```c
/*! ----------------------------------------------------------------------------
 * @file    mock_port.h
 * @brief   Shared state for the port function mocks (UWB-319 ztest suite).
 *          Copied verbatim from tests/dw1000_sleep/src/mock_port.h (UWB-316).
 *
 * @attention
 * SPDX-License-Identifier: MIT
 * Copyright (c) 2024 Fundamentals UWB project contributors.
 */

#ifndef MOCK_PORT_H_
#define MOCK_PORT_H_

#include "deca_device_api.h"

/** Call counters + call-order sequence numbers for port functions. */
struct mock_port_state {
    int reset_called;
    int reset_seq;

    int slowrate_called;
    int fastrate_called;

    /** port_wakeup_dw1000() -- the WAKEUP pin toggle (UWB-316). */
    int wakeup_called;
    int wakeup_seq;
};

extern struct mock_port_state mock_port_state;

/** Reset call counters before each test. */
void mock_port_reset(void);

#endif /* MOCK_PORT_H_ */
```

## src/mock_seq.c
```c
/*! ----------------------------------------------------------------------------
 * @file    mock_seq.c
 * @brief   Shared call-order sequence counter (UWB-319 ztest suite). Copied
 *          verbatim from tests/dw1000_sleep/src/mock_seq.c (UWB-316).
 *
 * @attention
 * SPDX-License-Identifier: MIT
 * Copyright (c) 2024 Fundamentals UWB project contributors.
 */

#include "mock_seq.h"

int mock_seq_counter;

void mock_seq_reset(void)
{
    mock_seq_counter = 0;
}

int mock_seq_next(void)
{
    return mock_seq_counter++;
}
```

## src/mock_seq.h
```c
/*! ----------------------------------------------------------------------------
 * @file    mock_seq.h
 * @brief   Shared call-order sequence counter for the uwb_standby ztest
 *          suite (UWB-319). Copied verbatim from
 *          tests/dw1000_sleep/src/mock_seq.h (UWB-316).
 *
 * mock_deca_driver.c and mock_port.c are separate compilation units that
 * both need to stamp captured calls with a monotonically increasing sequence
 * number, so the test assertions can verify call ORDER and not just call
 * presence/count.
 *
 * @attention
 * SPDX-License-Identifier: MIT
 * Copyright (c) 2024 Fundamentals UWB project contributors.
 */

#ifndef MOCK_SEQ_H_
#define MOCK_SEQ_H_

/** Monotonically increasing counter; mock_seq_next() returns then increments. */
extern int mock_seq_counter;

/** Reset the counter to 0. Call before each test (mock_seq_reset()). */
void mock_seq_reset(void);

/** Return the next sequence number (0, 1, 2, ...). */
int mock_seq_next(void);

#endif /* MOCK_SEQ_H_ */
```

## src/test_uwb_standby.c
```c
/*! ----------------------------------------------------------------------------
 * @file    test_uwb_standby.c
 * @brief   ztest suite: STANDBY power-state machine (UWB-319)
 *
 * Platform: unit_testing (native-hosted, no Zephyr kernel, no real SPI).
 *
 * Covers, per the UWB-319 acceptance criteria:
 *   - MONITORING: input->session_active == false enters STANDBY immediately
 *     (dw1000_sleep() called), regardless of the missed count.
 *   - MONITORING: CONFIG_UWB_SYNC_MAX_MISSED consecutive
 *     input->sync_ok == false reports stay MONITORING; one more enters
 *     STANDBY ("enter on N misses").
 *   - MONITORING: an input->sync_ok == true report resets the missed
 *     counter.
 *   - ASLEEP: uwb_standby_step() returns ASLEEP_WAITING (no radio touched)
 *     until CONFIG_UWB_STANDBY_WAKE_CADENCE_MS has elapsed per the injected
 *     clock ("wake-cadence honoured").
 *   - ASLEEP: once the cadence deadline is reached and a SYNC is heard,
 *     exits STANDBY back to MONITORING ("exit on presence").
 *   - ASLEEP: once the cadence deadline is reached and no SYNC is heard,
 *     re-sleeps and stays ASLEEP ("re-sleep on absence").
 *   - ASLEEP: a dw1000_wake() failure re-sleeps without a presence check and
 *     reports UWB_STANDBY_STEP_WAKE_ERROR.
 *   - NULL-argument rejection.
 *
 * @attention
 * SPDX-License-Identifier: MIT
 * Copyright (c) 2024 Fundamentals UWB project contributors.
 */

#include <string.h>

#include <zephyr/ztest.h>

#include "deca_device_api.h"
#include "deca_regs.h"
#include "mock_deca_driver.h"
#include "mock_port.h"
#include "mock_seq.h"
#include "uwb_frames.h"
#include "uwb_standby.h"

/* ---------------------------------------------------------------------------
 * Fake injected clock
 * --------------------------------------------------------------------------- */
static uint32_t g_fake_now_ms;

static uint32_t fake_now_get(void)
{
    return g_fake_now_ms;
}

/* ---------------------------------------------------------------------------
 * Suite setup / teardown
 * --------------------------------------------------------------------------- */
static uwb_standby_config_t cfg;
static uwb_standby_state_t  state;

static void before_each(void *fixture)
{
    (void)fixture;

    mock_deca_reset();
    mock_port_reset();
    mock_seq_reset();

    g_fake_now_ms = 0;

    cfg.now_get = fake_now_get;
    cfg.sync_timeout_us = 10000;

    uwb_standby_state_init(&state);
}

ZTEST_SUITE(uwb_standby, NULL, NULL, before_each, NULL, NULL);

/* ---------------------------------------------------------------------------
 * Helper: build a raw SYNC frame (deliberately independent of
 * dw1000_sync.c's own encode/decode logic -- mirrors
 * tests/dw1000_sync/src/test_dw1000_sync.c's build_sync_frame()).
 * --------------------------------------------------------------------------- */
static void build_sync_frame(uint8_t *buf)
{
    memset(buf, 0, UWB_SYNC_FRAME_SIZE);

    buf[UWB_OFF_FRAME_CTRL]     = UWB_FRAME_CTRL_LOW;
    buf[UWB_OFF_FRAME_CTRL + 1] = UWB_FRAME_CTRL_HIGH;
    buf[UWB_OFF_SEQ_NUM]        = 0x07u;

    buf[UWB_OFF_PAN_ID]     = (uint8_t)(UWB_PAN_ID & 0xFFu);
    buf[UWB_OFF_PAN_ID + 1] = (uint8_t)((UWB_PAN_ID >> 8) & 0xFFu);

    buf[UWB_OFF_DEST_ADDR]     = (uint8_t)(UWB_ADDR_BROADCAST & 0xFFu);
    buf[UWB_OFF_DEST_ADDR + 1] = (uint8_t)((UWB_ADDR_BROADCAST >> 8) & 0xFFu);

    buf[UWB_OFF_SRC_ADDR]     = 0x01u;
    buf[UWB_OFF_SRC_ADDR + 1] = 0x00u;

    buf[UWB_OFF_FRAME_TYPE] = UWB_FRAME_TYPE_SYNC;

    buf[UWB_OFF_SYNC_CYCLE_SEQ]     = 0x01u;
    buf[UWB_OFF_SYNC_CYCLE_SEQ + 1] = 0x00u;
    /* master_tx_ts left zeroed -- not consulted by this suite. */
}

/** Arm the mocked RX path to deliver a valid SYNC frame on the next
 *  dw1000_rx() call. */
static void mock_arm_sync_present(void)
{
    static uint8_t frame[UWB_SYNC_FRAME_SIZE];

    build_sync_frame(frame);
    mock_reg_state.sys_status = SYS_STATUS_RXFCG;
    mock_reg_state.rx_finfo   = (uint32)UWB_SYNC_FRAME_SIZE;
    memcpy(mock_readrxdata_state.injected_payload, frame, sizeof(frame));
}

/** Arm the mocked RX path to report a hardware RX timeout (no frame heard)
 *  on the next dw1000_rx() call. */
static void mock_arm_sync_absent(void)
{
    mock_reg_state.sys_status = SYS_STATUS_RXRFTO;
}

/* =============================================================================
 * MONITORING -- entry triggers
 * ========================================================================= */

ZTEST(uwb_standby, test_no_active_session_enters_standby_immediately)
{
    uwb_standby_input_t input = { .session_active = false, .sync_ok = false };

    uwb_standby_step_outcome_t ret = uwb_standby_step(&cfg, &state, &input);

    zassert_equal(ret, UWB_STANDBY_STEP_ENTERED,
        "Expected UWB_STANDBY_STEP_ENTERED on 'no active session'; got %d", ret);
    zassert_true(uwb_standby_is_asleep(&state),
        "Expected phase == ASLEEP after entry");
    zassert_equal(mock_sleep_state.entersleep_called, 1,
        "Expected dw1000_sleep() (dwt_entersleep()) to be called on entry; "
        "got %d calls", mock_sleep_state.entersleep_called);
}

ZTEST(uwb_standby, test_sync_ok_reports_stay_monitoring_and_reset_missed)
{
    uwb_standby_input_t miss = { .session_active = true, .sync_ok = false };
    uwb_standby_input_t ok   = { .session_active = true, .sync_ok = true };
    int i;

    /* Rack up some misses, short of the threshold. */
    for (i = 0; i < (int)CONFIG_UWB_SYNC_MAX_MISSED - 1; i++) {
        uwb_standby_step_outcome_t ret = uwb_standby_step(&cfg, &state, &miss);
        zassert_equal(ret, UWB_STANDBY_STEP_MONITORING,
            "Expected MONITORING while under threshold (i=%d); got %d", i, ret);
    }

    /* A good SYNC resets the counter. */
    uwb_standby_step_outcome_t ret = uwb_standby_step(&cfg, &state, &ok);
    zassert_equal(ret, UWB_STANDBY_STEP_MONITORING,
        "Expected MONITORING on sync_ok; got %d", ret);
    zassert_equal(state.missed, 0, "Expected missed counter reset to 0");

    /* Now it takes a full fresh run of misses to enter STANDBY -- confirms
     * the reset actually took effect (not just cosmetic). */
    for (i = 0; i < (int)CONFIG_UWB_SYNC_MAX_MISSED; i++) {
        ret = uwb_standby_step(&cfg, &state, &miss);
        zassert_equal(ret, UWB_STANDBY_STEP_MONITORING,
            "Expected MONITORING at missed=%d (<= max); got %d",
            i + 1, ret);
    }
    zassert_false(uwb_standby_is_asleep(&state),
        "Must still be MONITORING at exactly CONFIG_UWB_SYNC_MAX_MISSED misses");
}

ZTEST(uwb_standby, test_n_plus_one_missed_syncs_enters_standby)
{
    uwb_standby_input_t miss = { .session_active = true, .sync_ok = false };
    int i;

    for (i = 0; i < (int)CONFIG_UWB_SYNC_MAX_MISSED; i++) {
        uwb_standby_step_outcome_t ret = uwb_standby_step(&cfg, &state, &miss);
        zassert_equal(ret, UWB_STANDBY_STEP_MONITORING,
            "Expected MONITORING at missed=%d; got %d", i + 1, ret);
    }

    /* One more than the tolerance. */
    uwb_standby_step_outcome_t ret = uwb_standby_step(&cfg, &state, &miss);

    zassert_equal(ret, UWB_STANDBY_STEP_ENTERED,
        "Expected UWB_STANDBY_STEP_ENTERED after exceeding "
        "CONFIG_UWB_SYNC_MAX_MISSED consecutive misses; got %d", ret);
    zassert_true(uwb_standby_is_asleep(&state), "Expected phase == ASLEEP");
    zassert_equal(mock_sleep_state.entersleep_called, 1,
        "Expected dw1000_sleep() called exactly once on entry");
}

ZTEST(uwb_standby, test_monitoring_rejects_null_input)
{
    uwb_standby_step_outcome_t ret = uwb_standby_step(&cfg, &state, NULL);

    zassert_equal(ret, UWB_STANDBY_STEP_INVALID_ARGS,
        "Expected INVALID_ARGS for NULL input while MONITORING; got %d", ret);
    zassert_equal(mock_sleep_state.entersleep_called, 0,
        "No radio call expected on invalid args");
}

/* =============================================================================
 * ASLEEP -- wake cadence
 * ========================================================================= */

ZTEST(uwb_standby, test_asleep_waits_for_wake_cadence)
{
    uwb_standby_input_t no_session = { .session_active = false, .sync_ok = false };

    (void)uwb_standby_step(&cfg, &state, &no_session);
    zassert_true(uwb_standby_is_asleep(&state), "precondition: must be ASLEEP");

    mock_sleep_state.entersleep_called = 0;  /* isolate the next assertion */

    /* Not yet at the cadence deadline. */
    g_fake_now_ms = (uint32_t)CONFIG_UWB_STANDBY_WAKE_CADENCE_MS - 1u;

    uwb_standby_step_outcome_t ret = uwb_standby_step(&cfg, &state, NULL);

    zassert_equal(ret, UWB_STANDBY_STEP_ASLEEP_WAITING,
        "Expected ASLEEP_WAITING before the cadence deadline; got %d", ret);
    zassert_equal(mock_port_state.wakeup_called, 0,
        "No WAKEUP pulse expected before the cadence deadline");
    zassert_true(uwb_standby_is_asleep(&state), "Must still be ASLEEP");
}

ZTEST(uwb_standby, test_asleep_wakes_at_cadence_deadline)
{
    uwb_standby_input_t no_session = { .session_active = false, .sync_ok = false };

    (void)uwb_standby_step(&cfg, &state, &no_session);

    mock_arm_sync_absent();
    g_fake_now_ms = (uint32_t)CONFIG_UWB_STANDBY_WAKE_CADENCE_MS;

    uwb_standby_step_outcome_t ret = uwb_standby_step(&cfg, &state, NULL);

    zassert_equal(ret, UWB_STANDBY_STEP_WOKE_NO_PRESENCE,
        "Expected WOKE_NO_PRESENCE at the cadence deadline with no SYNC "
        "heard; got %d", ret);
    zassert_equal(mock_port_state.wakeup_called, 1,
        "Expected exactly one WAKEUP pulse at the cadence deadline");
}

/* =============================================================================
 * ASLEEP -- exit on presence / re-sleep on absence
 * ========================================================================= */

ZTEST(uwb_standby, test_asleep_exits_to_monitoring_on_presence)
{
    uwb_standby_input_t no_session = { .session_active = false, .sync_ok = false };

    (void)uwb_standby_step(&cfg, &state, &no_session);

    mock_arm_sync_present();
    g_fake_now_ms = (uint32_t)CONFIG_UWB_STANDBY_WAKE_CADENCE_MS;

    uwb_standby_step_outcome_t ret = uwb_standby_step(&cfg, &state, NULL);

    zassert_equal(ret, UWB_STANDBY_STEP_WOKE_PRESENT,
        "Expected WOKE_PRESENT when a SYNC frame is heard on wake; got %d", ret);
    zassert_false(uwb_standby_is_asleep(&state),
        "Expected phase -> MONITORING on presence");
    zassert_equal(state.missed, 0,
        "Expected the missed counter reset on the MONITORING re-entry");

    /* No re-sleep on the presence path. */
    zassert_equal(mock_sleep_state.entersleep_called, 1,
        "Expected dw1000_sleep() called exactly once (the original STANDBY "
        "entry) -- no re-sleep on the presence-exit path; got %d calls",
        mock_sleep_state.entersleep_called);
}

ZTEST(uwb_standby, test_asleep_resleeps_on_absence_and_stays_asleep)
{
    uwb_standby_input_t no_session = { .session_active = false, .sync_ok = false };

    (void)uwb_standby_step(&cfg, &state, &no_session);
    zassert_equal(mock_sleep_state.entersleep_called, 1,
        "precondition: one dw1000_sleep() call from entry");

    mock_arm_sync_absent();
    g_fake_now_ms = (uint32_t)CONFIG_UWB_STANDBY_WAKE_CADENCE_MS;

    uwb_standby_step_outcome_t ret = uwb_standby_step(&cfg, &state, NULL);

    zassert_equal(ret, UWB_STANDBY_STEP_WOKE_NO_PRESENCE,
        "Expected WOKE_NO_PRESENCE; got %d", ret);
    zassert_true(uwb_standby_is_asleep(&state),
        "Expected phase to stay ASLEEP after a no-presence wake");
    zassert_equal(mock_sleep_state.entersleep_called, 2,
        "Expected a second dw1000_sleep() call (re-sleep) after no presence "
        "was heard; got %d calls", mock_sleep_state.entersleep_called);

    /* The cadence deadline must have been pushed out again -- immediately
     * re-stepping (without advancing g_fake_now_ms further) must wait. */
    ret = uwb_standby_step(&cfg, &state, NULL);
    zassert_equal(ret, UWB_STANDBY_STEP_ASLEEP_WAITING,
        "Expected ASLEEP_WAITING immediately after a re-sleep (cadence "
        "deadline pushed out); got %d", ret);
}

/* =============================================================================
 * ASLEEP -- wake failure
 * ========================================================================= */

ZTEST(uwb_standby, test_wake_failure_resleeps_without_presence_check)
{
    uwb_standby_input_t no_session = { .session_active = false, .sync_ok = false };

    (void)uwb_standby_step(&cfg, &state, &no_session);

    /* Force dw1000_wake()'s reconfigure (dwt_initialise()) to fail. */
    mock_init_state.return_value = DWT_ERROR;
    g_fake_now_ms = (uint32_t)CONFIG_UWB_STANDBY_WAKE_CADENCE_MS;

    uwb_standby_step_outcome_t ret = uwb_standby_step(&cfg, &state, NULL);

    zassert_equal(ret, UWB_STANDBY_STEP_WAKE_ERROR,
        "Expected WAKE_ERROR when dw1000_wake() fails; got %d", ret);
    zassert_true(uwb_standby_is_asleep(&state),
        "Expected phase to stay ASLEEP after a wake failure");

    /* No presence check attempted -- dwt_rxenable() (the RX-arm call) must
     * not have been reached. */
    zassert_equal(mock_rxenable_state.called, 0,
        "No RX attempt expected when the wake itself failed");

    /* A best-effort re-sleep must still have been issued (entry + retry). */
    zassert_equal(mock_sleep_state.entersleep_called, 2,
        "Expected a best-effort re-sleep after the wake failure; got %d calls",
        mock_sleep_state.entersleep_called);
}

/* =============================================================================
 * NULL-argument rejection
 * ========================================================================= */

ZTEST(uwb_standby, test_step_rejects_null_cfg_and_state)
{
    uwb_standby_input_t input = { .session_active = true, .sync_ok = true };

    zassert_equal(uwb_standby_step(NULL, &state, &input),
        UWB_STANDBY_STEP_INVALID_ARGS, "NULL cfg must be rejected");
    zassert_equal(uwb_standby_step(&cfg, NULL, &input),
        UWB_STANDBY_STEP_INVALID_ARGS, "NULL state must be rejected");

    uwb_standby_config_t bad_cfg = { .now_get = NULL, .sync_timeout_us = 0 };
    zassert_equal(uwb_standby_step(&bad_cfg, &state, &input),
        UWB_STANDBY_STEP_INVALID_ARGS, "NULL cfg->now_get must be rejected");
}

ZTEST(uwb_standby, test_is_asleep_rejects_null_state)
{
    zassert_false(uwb_standby_is_asleep(NULL),
        "uwb_standby_is_asleep(NULL) must return false");
}

/* =============================================================================
 * uwb_standby_state_init
 * ========================================================================= */

ZTEST(uwb_standby, test_state_init_starts_monitoring)
{
    uwb_standby_state_t fresh;

    /* Poison the struct first so init() must actually set every field. */
    memset(&fresh, 0xAA, sizeof(fresh));

    uwb_standby_state_init(&fresh);

    zassert_false(uwb_standby_is_asleep(&fresh),
        "A freshly-initialised state must start MONITORING, not ASLEEP");
    zassert_equal(fresh.missed, 0, "missed must start at 0");
}

ZTEST(uwb_standby, test_state_init_ignores_null)
{
    /* Must not crash. */
    uwb_standby_state_init(NULL);
}
```
